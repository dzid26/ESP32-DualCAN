VERSION ""

NS_ :

BS_:

BU_: ETH

BO_ 1513 APP_alertLog: 8 Vector__XXX
 SG_ APP_alertID M : 0|14@1+ (1,0) [0|0] "" Vector__XXX
 SG_ APP_alertSource : 14|1@1+ (1,0) [0|0] "" Vector__XXX
 SG_ APP_alertState : 15|1@1+ (1,0) [0|0] "" Vector__XXX
 SG_ APP_sw001_APP_alertDataW0 m1 : 16|16@1+ (1,0) [0|0] "" Vector__XXX
 SG_ APP_sw004_radIssue m4 : 16|1@1+ (1,0) [0|0] "" Vector__XXX
 SG_ APP_sw005_AutofixOutOfCalib m5 : 16|1@1+ (1,0) [0|0] "" Vector__XXX
 SG_ APP_sw006_RadarLowVisibility m6 : 16|1@1+ (1,0) [0|0] "" Vector__XXX
 SG_ APP_sw009_DIaebState_fault m9 : 16|1@1+ (1,0) [0|0] "" Vector__XXX
 SG_ APP_sw010_a04calibNotDone m10 : 16|1@1+ (1,0) [0|0] "" Vector__XXX
 SG_ APP_sw011_scaState m11 : 16|3@1+ (1,0) [0|0] "" Vector__XXX
 SG_ APP_sw012_bootTestResults m12 : 16|16@1+ (1,0) [0|0] "" Vector__XXX
 SG_ APP_sw013_stateBeforeWatchdog m13 : 16|5@1+ (1,0) [0|0] "" Vector__XXX
 SG_ APP_sw014_fileNameHash m14 : 16|16@1+ (1,0) [0|0] "" Vector__XXX
 SG_ APP_sw015_RadarLowVisibility m15 : 16|2@1+ (1,0) [0|0] "" Vector__XXX
 SG_ APP_sw016_targetDist m16 : 16|9@1+ (0.2,0) [0|0] "" Vector__XXX
 SG_ APP_sw017_Camera_Msg_Lanes_MIA m17 : 16|1@1+ (1,0) [0|0] "" Vector__XXX
 SG_ APP_sw018_minThreshold m18 : 16|13@1+ (1,0) [0|0] "" Vector__XXX
 SG_ APP_sw019_taskId m19 : 16|8@1+ (1,0) [0|0] "" Vector__XXX
 SG_ APP_sw020_unusedW0 m20 : 16|16@1+ (1,0) [0|0] "" Vector__XXX
 SG_ APP_sw021_tempSensorId m21 : 16|8@1+ (1,0) [0|0] "" Vector__XXX
 SG_ APP_sw022_operation m22 : 16|4@1+ (1,0) [0|0] "" Vector__XXX
 SG_ APP_sw024_Task_ID m24 : 16|4@1+ (1,0) [0|0] "" Vector__XXX
 SG_ APP_sw025_state_before_override m25 : 16|4@1+ (1,0) [0|0] "" Vector__XXX
 SG_ APP_sw026_task_id m26 : 16|2@1+ (1,0) [0|0] "" Vector__XXX
 SG_ APP_sw027_JTAG_Reset m27 : 16|1@1+ (1,0) [0|0] "" Vector__XXX
 SG_ APP_sw028_rx_buffer_full m28 : 16|1@1+ (1,0) [0|0] "" Vector__XXX
 SG_ APP_sw029_tx_buffer_full m29 : 16|1@1+ (1,0) [0|0] "" Vector__XXX
 SG_ APP_sw030_heaterState m30 : 16|8@1+ (1,0) [0|0] "" Vector__XXX
 SG_ APP_sw031_canBus m31 : 16|4@1+ (1,0) [0|0] "" Vector__XXX
 SG_ APP_sw032_canBus m32 : 16|4@1+ (1,0) [0|0] "" Vector__XXX
 SG_ APP_sw033_carConfig m33 : 16|1@1+ (1,0) [0|0] "" Vector__XXX
 SG_ APP_sw034_sccmMia m34 : 16|8@1+ (1,0) [0|0] "" Vector__XXX
 SG_ APP_sw035_status m35 : 16|1@1+ (1,0) [0|0] "" Vector__XXX
 SG_ APP_sw036_bdyMia m36 : 16|8@1+ (1,0) [0|0] "" Vector__XXX
 SG_ APP_sw037_camera m37 : 16|8@1+ (1,0) [0|0] "" Vector__XXX
 SG_ APP_sw038_RadarMisalignment m38 : 16|1@1+ (1,0) [0|0] "" Vector__XXX
 SG_ APP_sw039_sdm_rcm_Mia m39 : 16|8@1+ (1,0) [0|0] "" Vector__XXX
 SG_ APP_sw040_accel_pedal_pos m40 : 16|8@1+ (0.5,0) [0|0] "" Vector__XXX
 SG_ APP_sw041_rate m41 : 16|10@1- (1,0) [0|0] "" Vector__XXX
 SG_ APP_sw042_health_state m42 : 16|3@1+ (1,0) [0|0] "" Vector__XXX
 SG_ APP_sw043_mobileye_status m43 : 16|16@1+ (1,0) [0|0] "" Vector__XXX
 SG_ APP_sw044_countLSB m44 : 16|8@1+ (1,0) [0|0] "" Vector__XXX
 SG_ APP_sw045_radcAlertMatrix m45 : 16|1@1+ (1,0) [0|0] "" Vector__XXX
 SG_ APP_sw046_recordId m46 : 16|16@1+ (1,0) [0|0] "" Vector__XXX
 SG_ APP_sw047_edrStatus m47 : 16|4@1+ (1,0) [0|0] "" Vector__XXX
 SG_ APP_sw048_swAssert m48 : 16|1@1+ (1,0) [0|0] "" Vector__XXX
 SG_ APP_sw049_boot_version_msw m49 : 16|16@1+ (1,0) [0|0] "" Vector__XXX
 SG_ APP_sw050_targetDist m50 : 16|9@1+ (0.2,0) [0|0] "" Vector__XXX
 SG_ APP_sw051_a01ecuInternalPerf m51 : 16|1@1+ (1,0) [0|0] "" Vector__XXX
 SG_ APP_sw052_a07sensorBlinded m52 : 16|1@1+ (1,0) [0|0] "" Vector__XXX
 SG_ APP_sw053_a10canBusOff m53 : 16|1@1+ (1,0) [0|0] "" Vector__XXX
 SG_ APP_sw054_Autofix_cnvrgnceStatus m54 : 16|8@1+ (1,0) [0|0] "" Vector__XXX
 SG_ APP_sw055_detectedRadcVersion m55 : 16|32@1+ (1,0) [0|0] "" Vector__XXX
 SG_ APP_sw056_diMia m56 : 16|8@1+ (1,0) [0|0] "" Vector__XXX
 SG_ APP_sw057_csaOfframpCurvature m57 : 16|1@1+ (1,0) [0|0] "" Vector__XXX
 SG_ APP_sw058_epbMia m58 : 16|8@1+ (1,0) [0|0] "" Vector__XXX
 SG_ APP_sw059_oloDict m59 : 16|1@1+ (1,0) [0|0] "" Vector__XXX
 SG_ APP_sw060_targetDist m60 : 16|9@1+ (0.2,0) [0|0] "" Vector__XXX
 SG_ APP_sw061_states m61 : 16|1@1+ (1,0) [0|0] "" Vector__XXX
 SG_ APP_sw062_HorizontalMisalignment m62 : 16|16@1+ (0.00137332,-45) [0|0] "" Vector__XXX
 SG_ APP_sw063_expectedMajorVer m63 : 16|8@1+ (1,0) [0|0] "" Vector__XXX
 SG_ APP_sw064_sysStatus m64 : 16|1@1+ (1,0) [0|0] "" Vector__XXX
 SG_ APP_sw065_app_mobileye_status m65 : 16|8@1+ (1,0) [0|0] "" Vector__XXX
 SG_ APP_sw066_app_mobileye_status m66 : 16|8@1+ (1,0) [0|0] "" Vector__XXX
 SG_ APP_sw067_sccmSTW m67 : 16|14@1+ (0.1,-819.2) [0|0] "" Vector__XXX
 SG_ APP_sw068_percentConsistency m68 : 16|10@1+ (0.1,0) [0|0] "" Vector__XXX
 SG_ APP_sw069_epasMia m69 : 16|1@1+ (1,0) [0|0] "" Vector__XXX
 SG_ APP_sw070_currTireFitment m70 : 16|3@1+ (1,0) [0|0] "" Vector__XXX
 SG_ APP_sw071_selfParkType m71 : 16|4@1+ (1,0) [0|0] "" Vector__XXX
 SG_ APP_sw072_vehicleX m72 : 16|10@1+ (0.05,-25.6) [0|0] "" Vector__XXX
 SG_ APP_sw073_escalateLDWs m73 : 16|1@1+ (1,0) [0|0] "" Vector__XXX
 SG_ APP_sw074_ipsoDx m74 : 16|6@1+ (2,0) [0|0] "" Vector__XXX
 SG_ APP_sw075_scMia m75 : 16|8@1+ (1,0) [0|0] "" Vector__XXX
 SG_ APP_sw076_targetDist m76 : 16|9@1+ (0.2,0) [0|0] "" Vector__XXX
 SG_ APP_sw077_oocDistance m77 : 16|9@1+ (1,0) [0|0] "" Vector__XXX
 SG_ APP_sw078_camCipv_dx m78 : 16|8@1+ (0.2,0) [0|0] "" Vector__XXX
 SG_ APP_sw080_sensors_healty_check m80 : 16|1@1+ (1,0) [0|0] "" Vector__XXX
 SG_ APP_sw081_radarDistance m81 : 16|8@1+ (0.0625,0) [0|0] "" Vector__XXX
 SG_ APP_sw082_L_VL m82 : 16|8@1+ (0.05,-6.4) [0|0] "" Vector__XXX
 SG_ APP_sw083_Targ5_RCS m83 : 16|16@1+ (0.0039063096,0) [0|0] "" Vector__XXX
 SG_ APP_sw084_ipsoTTC m84 : 16|8@1+ (0.02,0) [0|0] "" Vector__XXX
 SG_ APP_sw085_radarDistance m85 : 16|8@1+ (0.0625,0) [0|0] "" Vector__XXX
 SG_ APP_sw086_distanceException m86 : 16|8@1+ (1,90) [0|0] "" Vector__XXX
 SG_ APP_sw103_objectDx m103 : 16|8@1+ (0.5,0) [0|0] "" Vector__XXX
 SG_ APP_sw106_torsionBarOffset m106 : 16|8@1+ (0.005,-0.64) [0|0] "" Vector__XXX
 SG_ APP_sw129_mainCamExtNoCalFile m129 : 16|1@1+ (1,0) [0|0] "" Vector__XXX
 SG_ APP_sw130_narrowCamExtNoCalFile m130 : 16|1@1+ (1,0) [0|0] "" Vector__XXX
 SG_ APP_sw131_mainCamExtPitchCal m131 : 16|9@1- (0.05,0) [0|0] "" Vector__XXX
 SG_ APP_sw132_narrowCamExtPitchCal m132 : 16|9@1- (0.05,0) [0|0] "" Vector__XXX
 SG_ APP_sw133_mainCamDeserFault m133 : 16|3@1+ (1,0) [0|0] "" Vector__XXX
 SG_ APP_sw134_narrowCamDeserFault m134 : 16|3@1+ (1,0) [0|0] "" Vector__XXX
 SG_ APP_sw135_fisheyeCamDeserFault m135 : 16|3@1+ (1,0) [0|0] "" Vector__XXX
 SG_ APP_sw136_lPillarCamDeserFault m136 : 16|3@1+ (1,0) [0|0] "" Vector__XXX
 SG_ APP_sw137_rPillarCamDeserFault m137 : 16|3@1+ (1,0) [0|0] "" Vector__XXX
 SG_ APP_sw138_lRepeatCamDeserFault m138 : 16|3@1+ (1,0) [0|0] "" Vector__XXX
 SG_ APP_sw139_rRepeatCamDeserFault m139 : 16|3@1+ (1,0) [0|0] "" Vector__XXX
 SG_ APP_sw140_backupCamCSIBridgeFlt m140 : 16|3@1+ (1,0) [0|0] "" Vector__XXX
 SG_ APP_sw141_maxThreshold m141 : 16|8@1- (1,0) [0|0] "" Vector__XXX
 SG_ APP_sw142_camExtPitchCal m142 : 16|9@1+ (0.05,-12.5) [0|0] "" Vector__XXX
 SG_ APP_sw143_timeToImpact m143 : 16|9@1+ (1,0) [0|0] "" Vector__XXX
 SG_ APP_sw144_fanctrldErrorType m144 : 16|8@1+ (1,0) [0|0] "" Vector__XXX
 SG_ APP_sw145_pitchSpike m145 : 16|1@1+ (1,0) [0|0] "" Vector__XXX
 SG_ APP_sw146_telemProblemType m146 : 16|3@1+ (1,0) [0|0] "" Vector__XXX
 SG_ APP_sw147_selfieCamDeserFault m147 : 16|3@1+ (1,0) [0|0] "" Vector__XXX
 SG_ APP_sw148_unusedW0 m148 : 16|16@1+ (1,0) [0|0] "" Vector__XXX
 SG_ APP_sw149_diskUsageVar m149 : 16|8@1+ (1,0) [0|0] "" Vector__XXX
 SG_ APP_sw150_locStatus m150 : 16|1@1+ (1,0) [0|0] "" Vector__XXX
 SG_ APP_sw151_sysStatus m151 : 16|1@1+ (1,0) [0|0] "" Vector__XXX
 SG_ APP_sw152_status m152 : 16|1@1+ (1,0) [0|0] "" Vector__XXX
 SG_ APP_sw153_inertial1 m153 : 16|1@1+ (1,0) [0|0] "" Vector__XXX
 SG_ APP_sw154_restraintStatus m154 : 16|1@1+ (1,0) [0|0] "" Vector__XXX
 SG_ APP_sw155_restraintStatus m155 : 16|1@1+ (1,0) [0|0] "" Vector__XXX
 SG_ APP_sw156_status m156 : 16|1@1+ (1,0) [0|0] "" Vector__XXX
 SG_ APP_sw157_leftStalk m157 : 16|1@1+ (1,0) [0|0] "" Vector__XXX
 SG_ APP_sw158_lvPowerState m158 : 16|1@1+ (1,0) [0|0] "" Vector__XXX
 SG_ APP_sw159_doorStatus m159 : 16|1@1+ (1,0) [0|0] "" Vector__XXX
 SG_ APP_sw160_doorStatus m160 : 16|1@1+ (1,0) [0|0] "" Vector__XXX
 SG_ APP_sw161_frameTimeout m161 : 16|1@1+ (1,0) [0|0] "" Vector__XXX
 SG_ APP_sw162_colorFilterMismatch m162 : 16|1@1+ (1,0) [0|0] "" Vector__XXX
 SG_ APP_sw163_colorFilterMismatch m163 : 16|1@1+ (1,0) [0|0] "" Vector__XXX
 SG_ APP_sw164_colorFilterMismatch m164 : 16|1@1+ (1,0) [0|0] "" Vector__XXX
 SG_ APP_sw165_colorFilterMismatch m165 : 16|1@1+ (1,0) [0|0] "" Vector__XXX
 SG_ APP_sw166_colorFilterMismatch m166 : 16|1@1+ (1,0) [0|0] "" Vector__XXX
 SG_ APP_sw167_colorFilterMismatch m167 : 16|1@1+ (1,0) [0|0] "" Vector__XXX
 SG_ APP_sw168_colorFilterMismatch m168 : 16|1@1+ (1,0) [0|0] "" Vector__XXX
 SG_ APP_sw169_colorFilterMismatch m169 : 16|1@1+ (1,0) [0|0] "" Vector__XXX
 SG_ APP_sw170_colorFilterMismatch m170 : 16|1@1+ (1,0) [0|0] "" Vector__XXX
 SG_ APP_sw171_APP_parkerATemp m171 : 16|8@1+ (1,-128) [0|0] "" Vector__XXX
 SG_ APP_sw172_fisheyeCamExtNoCalFile m172 : 16|1@1+ (1,0) [0|0] "" Vector__XXX
 SG_ APP_sw173_lPillarCamExtNoCalFile m173 : 16|1@1+ (1,0) [0|0] "" Vector__XXX
 SG_ APP_sw174_rPillarCamExtNoCalFile m174 : 16|1@1+ (1,0) [0|0] "" Vector__XXX
 SG_ APP_sw175_lRepeatCamExtNoCalFile m175 : 16|1@1+ (1,0) [0|0] "" Vector__XXX
 SG_ APP_sw176_rRepeatCamExtNoCalFile m176 : 16|1@1+ (1,0) [0|0] "" Vector__XXX
 SG_ APP_sw177_fisheyeCamExtPitchCal m177 : 16|9@1- (0.05,0) [0|0] "" Vector__XXX
 SG_ APP_sw178_lPillarCamExtPitchCal m178 : 16|9@1- (0.05,0) [0|0] "" Vector__XXX
 SG_ APP_sw179_rPillarCamExtPitchCal m179 : 16|9@1- (0.05,0) [0|0] "" Vector__XXX
 SG_ APP_sw180_lRepeatCamExtPitchCal m180 : 16|9@1- (0.05,0) [0|0] "" Vector__XXX
 SG_ APP_sw181_rRepeatCamExtPitchCal m181 : 16|9@1- (0.05,0) [0|0] "" Vector__XXX
 SG_ APP_sw182_exitStatus m182 : 16|1@1+ (1,0) [0|0] "" Vector__XXX
 SG_ APP_sw183_exitStatus m183 : 16|1@1+ (1,0) [0|0] "" Vector__XXX
 SG_ APP_sw184_exitStatus m184 : 16|1@1+ (1,0) [0|0] "" Vector__XXX
 SG_ APP_sw185_exitStatus m185 : 16|1@1+ (1,0) [0|0] "" Vector__XXX
 SG_ APP_sw186_exitStatus m186 : 16|1@1+ (1,0) [0|0] "" Vector__XXX
 SG_ APP_sw187_exitStatus m187 : 16|1@1+ (1,0) [0|0] "" Vector__XXX
 SG_ APP_sw188_exitStatus m188 : 16|1@1+ (1,0) [0|0] "" Vector__XXX
 SG_ APP_sw189_exitStatus m189 : 16|1@1+ (1,0) [0|0] "" Vector__XXX
 SG_ APP_sw190_exitStatus m190 : 16|1@1+ (1,0) [0|0] "" Vector__XXX
 SG_ APP_sw191_abortReason m191 : 16|8@1+ (1,0) [0|0] "" Vector__XXX
 SG_ APP_sw192_speakerFailureType m192 : 16|3@1+ (1,0) [0|0] "" Vector__XXX
 SG_ APP_sw193_blurredImage m193 : 16|1@1+ (1,0) [0|0] "" Vector__XXX
 SG_ APP_sw194_leadAx m194 : 16|6@1- (0.2,0) [0|0] "" Vector__XXX
 SG_ APP_sw195_s1Blocked m195 : 16|1@1+ (1,0) [0|0] "" Vector__XXX
 SG_ APP_sw198_fullBlockage m198 : 16|1@1+ (1,0) [0|0] "" Vector__XXX
 SG_ APP_sw199_abortCodeDas m199 : 16|6@1+ (1,0) [0|0] "" Vector__XXX
 SG_ APP_sw200_autopilotIntState m200 : 16|4@1+ (1,0) [0|0] "" Vector__XXX
 SG_ APP_sw201_virtualLaneInputOAL m201 : 16|3@1+ (1,0) [0|0] "" Vector__XXX
 SG_ APP_sw202_s1Blocked m202 : 16|1@1+ (1,0) [0|0] "" Vector__XXX
 SG_ APP_sw203_controlType m203 : 16|4@1+ (1,0) [0|0] "" Vector__XXX
 SG_ APP_sw204_frLeft m204 : 16|8@1+ (1,0) [0|0] "" Vector__XXX
 SG_ APP_sw205_oocDistance m205 : 16|8@1+ (1,0) [0|0] "" Vector__XXX
 SG_ APP_sw207_appMobileyeStatus m207 : 16|8@1+ (1,0) [0|0] "" Vector__XXX
 SG_ APP_sw213_autopilotIntState m213 : 16|4@1+ (1,0) [0|0] "" Vector__XXX
 SG_ APP_sw218_cipvDist m218 : 16|8@1+ (0.2,0) [0|0] "" Vector__XXX
 SG_ APP_sw219_controlledAccess m219 : 16|1@1+ (1,0) [0|0] "" Vector__XXX
 SG_ APP_sw220_controlledAccess m220 : 16|1@1+ (1,0) [0|0] "" Vector__XXX
 SG_ APP_sw227_sensorSide m227 : 16|1@1+ (1,0) [0|0] "" Vector__XXX
 SG_ APP_sw230_sensor1Blocked m230 : 16|1@1+ (1,0) [0|0] "" Vector__XXX
 SG_ APP_sw231_timeToImpact m231 : 16|9@1+ (1,0) [0|0] "" Vector__XXX
 SG_ APP_sw234_autosteerEnabled m234 : 16|1@1+ (1,0) [0|0] "" Vector__XXX
 SG_ APP_sw257_target_dx m257 : 16|8@1+ (0.5,0) [0|0] "" Vector__XXX
 SG_ APP_sw258_target_dx m258 : 16|8@1+ (0.5,0) [0|0] "" Vector__XXX
 SG_ APP_sw259_do_turn_indicator m259 : 16|1@1+ (1,0) [0|0] "" Vector__XXX
 SG_ APP_sw260_target_dx m260 : 16|8@1+ (0.5,0) [0|0] "" Vector__XXX
 SG_ APP_sw261_correctableErrors m261 : 16|8@1+ (1,0) [0|0] "" Vector__XXX
 SG_ APP_sw263_torsionThreshold m263 : 16|1@1+ (1,0) [0|0] "" Vector__XXX
 SG_ APP_sw264_faultReason m264 : 16|5@1+ (1,0) [0|0] "" Vector__XXX
 SG_ APP_sw265_mpHasRoute m265 : 16|1@1+ (1,0) [0|0] "" Vector__XXX
 SG_ APP_sw266_lPillarStreamStatus m266 : 16|3@1+ (1,0) [0|0] "" Vector__XXX
 SG_ APP_sw268_backupCamExtNoCalFile m268 : 16|1@1+ (1,0) [0|0] "" Vector__XXX
 SG_ APP_sw269_mainStreamExit m269 : 16|1@1+ (1,0) [0|0] "" Vector__XXX
 SG_ APP_sw270_mainStreamExit m270 : 16|1@1+ (1,0) [0|0] "" Vector__XXX
 SG_ APP_sw271_abortReason m271 : 16|5@1+ (1,0) [0|0] "" Vector__XXX
 SG_ APP_sw272_unavailableReason m272 : 16|4@1+ (1,0) [0|0] "" Vector__XXX
 SG_ APP_sw273_eventType m273 : 16|1@1+ (1,0) [0|0] "" Vector__XXX
 SG_ APP_sw274_exitStatus m274 : 16|1@1+ (1,0) [0|0] "" Vector__XXX
 SG_ APP_sw275_exitStatus m275 : 16|1@1+ (1,0) [0|0] "" Vector__XXX
 SG_ APP_sw276_exitStatus m276 : 16|1@1+ (1,0) [0|0] "" Vector__XXX
 SG_ APP_sw277_exitStatus m277 : 16|1@1+ (1,0) [0|0] "" Vector__XXX
 SG_ APP_sw278_exitStatus m278 : 16|1@1+ (1,0) [0|0] "" Vector__XXX
 SG_ APP_sw279_exitStatus m279 : 16|1@1+ (1,0) [0|0] "" Vector__XXX
 SG_ APP_sw280_exitStatus m280 : 16|1@1+ (1,0) [0|0] "" Vector__XXX
 SG_ APP_sw281_exitStatus m281 : 16|1@1+ (1,0) [0|0] "" Vector__XXX
 SG_ APP_sw282_exitStatus m282 : 16|1@1+ (1,0) [0|0] "" Vector__XXX
 SG_ APP_sw283_appAbortReason m283 : 16|5@1+ (1,0) [0|0] "" Vector__XXX
 SG_ APP_sw284_antennaDisconnected m284 : 16|1@1+ (1,0) [0|0] "" Vector__XXX
 SG_ APP_sw285_gpsCommMissing m285 : 16|1@1+ (1,0) [0|0] "" Vector__XXX
 SG_ APP_sw286_cfgBufNull m286 : 16|1@1+ (1,0) [0|0] "" Vector__XXX
 SG_ APP_sw287_fusionStatus m287 : 16|2@1+ (1,0) [0|0] "" Vector__XXX
 SG_ APP_sw288_dist_to_stop m288 : 16|8@1+ (0.5,0) [0|0] "" Vector__XXX
 SG_ APP_sw289_numCorrectableErrors m289 : 16|32@1+ (1,0) [0|0] "" Vector__XXX
 SG_ APP_sw290_numUncorrectableErrors m290 : 16|32@1+ (1,0) [0|0] "" Vector__XXX
 SG_ APP_sw291_dist_to_stop m291 : 16|8@1+ (0.5,0) [0|0] "" Vector__XXX
 SG_ APP_sw293_clockFrequencyDrift m293 : 16|16@1- (0.0005,0) [0|0] "" Vector__XXX
 SG_ APP_sw294_clockFrequencyDrift m294 : 16|16@1- (0.0005,0) [0|0] "" Vector__XXX
 SG_ APP_sw295_clockFrequencyDrift m295 : 16|16@1- (0.0005,0) [0|0] "" Vector__XXX
 SG_ APP_sw296_clockFrequencyDrift m296 : 16|16@1- (0.0005,0) [0|0] "" Vector__XXX
 SG_ APP_sw297_clockFrequencyDrift m297 : 16|16@1- (0.0005,0) [0|0] "" Vector__XXX
 SG_ APP_sw298_clockFrequencyDrift m298 : 16|16@1- (0.0005,0) [0|0] "" Vector__XXX
 SG_ APP_sw299_clockFrequencyDrift m299 : 16|16@1- (0.0005,0) [0|0] "" Vector__XXX
 SG_ APP_sw300_clockFrequencyDrift m300 : 16|16@1- (0.0005,0) [0|0] "" Vector__XXX
 SG_ APP_sw301_clockFrequencyDrift m301 : 16|16@1- (0.0005,0) [0|0] "" Vector__XXX
 SG_ APP_sw302_AP_vehicleState10Hz m302 : 16|1@1+ (1,0) [0|0] "" Vector__XXX
 SG_ APP_sw304_lssLPillarBlocked m304 : 16|1@1+ (1,0) [0|0] "" Vector__XXX
 SG_ APP_sw305_lssLPillarStreamExit m305 : 16|1@1+ (1,0) [0|0] "" Vector__XXX
 SG_ APP_sw306_lssUssS1Blocked m306 : 16|1@1+ (1,0) [0|0] "" Vector__XXX
 SG_ APP_sw307_lssTurnSignalFLFault m307 : 16|1@1+ (1,0) [0|0] "" Vector__XXX
 SG_ APP_sw308_IBST_status m308 : 16|1@1+ (1,0) [0|0] "" Vector__XXX
 SG_ APP_sw310_txErrThresholdReached m310 : 16|1@1+ (1,0) [0|0] "" Vector__XXX
 SG_ APP_sw311_txErrThresholdReached m311 : 16|1@1+ (1,0) [0|0] "" Vector__XXX
 SG_ APP_sw312_expectedSensorModel m312 : 16|2@1+ (1,0) [0|0] "" Vector__XXX
 SG_ APP_sw313_expectedSensorModel m313 : 16|2@1+ (1,0) [0|0] "" Vector__XXX
 SG_ APP_sw314_expectedSensorModel m314 : 16|2@1+ (1,0) [0|0] "" Vector__XXX
 SG_ APP_sw315_expectedSensorModel m315 : 16|2@1+ (1,0) [0|0] "" Vector__XXX
 SG_ APP_sw316_expectedSensorModel m316 : 16|2@1+ (1,0) [0|0] "" Vector__XXX
 SG_ APP_sw317_expectedSensorModel m317 : 16|2@1+ (1,0) [0|0] "" Vector__XXX
 SG_ APP_sw318_expectedSensorModel m318 : 16|2@1+ (1,0) [0|0] "" Vector__XXX
 SG_ APP_sw319_expectedSensorModel m319 : 16|2@1+ (1,0) [0|0] "" Vector__XXX
 SG_ APP_sw320_expectedSensorModel m320 : 16|2@1+ (1,0) [0|0] "" Vector__XXX
 SG_ APP_sw321_energyStatus m321 : 16|1@1+ (1,0) [0|0] "" Vector__XXX
 SG_ APP_sw322_sunGlare m322 : 16|1@1+ (1,0) [0|0] "" Vector__XXX
 SG_ APP_sw323_confidence m323 : 16|8@1+ (0.004,0) [0|0] "" Vector__XXX
 SG_ APP_sw324_state m324 : 16|1@1+ (1,0) [0|0] "" Vector__XXX
 SG_ APP_sw325_taskId m325 : 16|7@1+ (1,0) [0|0] "" Vector__XXX
 SG_ APP_sw327_driveHandSideMismatch m327 : 16|1@1+ (1,0) [0|0] "" Vector__XXX
 SG_ APP_sw328_ussS1Unavailable m328 : 16|1@1+ (1,0) [0|0] "" Vector__XXX
 SG_ APP_sw329_cipvSysReqAccel m329 : 16|7@1+ (0.15625,-10) [0|0] "" Vector__XXX
 SG_ APP_sw330_initFailure m330 : 16|1@1+ (1,0) [0|0] "" Vector__XXX
 SG_ APP_sw331_lPillarOccluded m331 : 16|1@1+ (1,0) [0|0] "" Vector__XXX
 SG_ APP_sw332_narrowWithFisheye m332 : 16|1@1+ (1,0) [0|0] "" Vector__XXX
 SG_ APP_sw335_RfSensorId m335 : 16|2@1+ (1,0) [0|0] "" Vector__XXX
 SG_ APP_sw336_outRailId m336 : 16|2@1+ (1,0) [0|0] "" Vector__XXX
 SG_ APP_sw337_outChanId m337 : 16|2@1+ (1,0) [0|0] "" Vector__XXX
 SG_ APP_sw338_pcbTemp m338 : 16|16@1- (0.1,50) [0|0] "" Vector__XXX
 SG_ APP_sw339_pcbTemp m339 : 16|16@1- (0.1,50) [0|0] "" Vector__XXX
 SG_ APP_sw340_csiRxChanId m340 : 16|2@1+ (1,0) [0|0] "" Vector__XXX
 SG_ APP_sw341_rfInitCalibDataInvalid m341 : 16|1@1+ (1,0) [0|0] "" Vector__XXX
 SG_ APP_sw342_drtBlockStatus m342 : 16|32@1+ (1,0) [0|0] "" Vector__XXX
 SG_ APP_sw343_frameId m343 : 16|21@1+ (1,0) [0|0] "" Vector__XXX
 SG_ APP_sw344_frameId m344 : 16|16@1+ (1,0) [0|0] "" Vector__XXX
 SG_ APP_sw345_errorData m345 : 16|16@1- (1,0) [0|0] "" Vector__XXX
 SG_ APP_sw346_solutionProviderReset m346 : 16|1@1+ (1,0) [0|0] "" Vector__XXX
 SG_ APP_sw347_eFuseDebugStatus m347 : 16|1@1+ (1,0) [0|0] "" Vector__XXX
 SG_ APP_sw348_main m348 : 16|1@1+ (1,0) [0|0] "" Vector__XXX
 SG_ APP_sw349_main m349 : 16|1@1+ (1,0) [0|0] "" Vector__XXX
 SG_ APP_sw350_staticMisalignCalError m350 : 16|1@1+ (1,0) [0|0] "" Vector__XXX
 SG_ APP_sw351_errorCode m351 : 16|32@1+ (1,0) [0|0] "" Vector__XXX
 SG_ APP_sw352_errorCode m352 : 16|32@1+ (1,0) [0|0] "" Vector__XXX
 SG_ APP_sw353_errorCode m353 : 16|32@1+ (1,0) [0|0] "" Vector__XXX
 SG_ APP_sw354_totalFrames m354 : 16|32@1+ (1,0) [0|0] "" Vector__XXX
 SG_ APP_sw355_quad1 m355 : 16|1@1+ (1,0) [0|0] "" Vector__XXX
 SG_ APP_sw357_cabinCameraFailsafeActive m357 : 16|1@1+ (1,0) [0|0] "" Vector__XXX
 SG_ APP_sw358_noSpeedLimitSource m358 : 16|1@1+ (1,0) [0|0] "" Vector__XXX
 SG_ APP_sw359_mainCameraBlinded m359 : 16|1@1+ (1,0) [0|0] "" Vector__XXX
 SG_ APP_sw371_decryptionFailed m371 : 16|1@1+ (1,0) [0|0] "" Vector__XXX
 SG_ APP_sw373_overrunError m373 : 16|1@1+ (1,0) [0|0] "" Vector__XXX
 SG_ APP_sw380_ppsNotMonotonic m380 : 16|1@1+ (1,0) [0|0] "" Vector__XXX
 SG_ APP_sw381_backwardsJump m381 : 16|1@1+ (1,0) [0|0] "" Vector__XXX
 SG_ APP_sw382_backwardsJump m382 : 16|1@1+ (1,0) [0|0] "" Vector__XXX
 SG_ APP_sw385_posEngineTimingError m385 : 16|1@1+ (1,0) [0|0] "" Vector__XXX
 SG_ APP_sw386_cipvValid m386 : 16|1@1+ (1,0) [0|0] "" Vector__XXX
 SG_ APP_sw387_radarPartialBlockage m387 : 16|1@1+ (1,0) [0|0] "" Vector__XXX
 SG_ APP_sw389_frontCamResidue m389 : 16|1@1+ (1,0) [0|0] "" Vector__XXX
 SG_ APP_sw392_suspensionClearTs m392 : 16|32@1+ (1,0) [0|0] "" Vector__XXX
 SG_ APP_sw393_buildSettAndFleetCfg m393 : 16|1@1+ (1,0) [0|0] "" Vector__XXX
 SG_ APP_sw397_apImuNoise m397 : 16|1@1+ (1,0) [0|0] "" Vector__XXX
 SG_ APP_sw398_imuLocation m398 : 16|2@1+ (1,0) [0|0] "" Vector__XXX
 SG_ APP_sw399_status m399 : 16|1@1+ (1,0) [0|0] "" Vector__XXX
 SG_ APP_sw404_status m404 : 16|1@1+ (1,0) [0|0] "" Vector__XXX
 SG_ APP_sw405_status m405 : 16|1@1+ (1,0) [0|0] "" Vector__XXX
 SG_ APP_sw406_gnssUartDataMia m406 : 16|1@1+ (1,0) [0|0] "" Vector__XXX
 SG_ APP_sw407_unknown m407 : 16|1@1+ (1,0) [0|0] "" Vector__XXX
 SG_ APP_sw408_lvDegradedState m408 : 16|1@1+ (1,0) [0|0] "" Vector__XXX
 SG_ APP_sw409_windshieldCamHeaterFault m409 : 16|1@1+ (1,0) [0|0] "" Vector__XXX
 SG_ APP_sw410_noValidSgkStatus m410 : 16|1@1+ (1,0) [0|0] "" Vector__XXX
 SG_ APP_sw413_apSystemIssuePendingReboot m413 : 16|1@1+ (1,0) [0|0] "" Vector__XXX
 SG_ APP_sw415_reason1 m415 : 16|9@1+ (1,0) [0|0] "" Vector__XXX
 SG_ APP_sw416_reason1 m416 : 16|9@1+ (1,0) [0|0] "" Vector__XXX
 SG_ APP_sw417_reason1 m417 : 16|9@1+ (1,0) [0|0] "" Vector__XXX
 SG_ APP_sw418_reason1 m418 : 16|9@1+ (1,0) [0|0] "" Vector__XXX
 SG_ APP_sw419_reason1 m419 : 16|9@1+ (1,0) [0|0] "" Vector__XXX
 SG_ APP_sw420_reason1 m420 : 16|9@1+ (1,0) [0|0] "" Vector__XXX
 SG_ APP_sw421_reason1 m421 : 16|9@1+ (1,0) [0|0] "" Vector__XXX
 SG_ APP_sw422_reason1 m422 : 16|9@1+ (1,0) [0|0] "" Vector__XXX
 SG_ APP_sw423_type m423 : 16|4@1+ (1,0) [0|0] "" Vector__XXX
 SG_ APP_sw424_type m424 : 16|4@1+ (1,0) [0|0] "" Vector__XXX
 SG_ APP_sw425_type m425 : 16|4@1+ (1,0) [0|0] "" Vector__XXX
 SG_ APP_sw426_type m426 : 16|4@1+ (1,0) [0|0] "" Vector__XXX
 SG_ APP_sw427_type m427 : 16|4@1+ (1,0) [0|0] "" Vector__XXX
 SG_ APP_sw428_type m428 : 16|4@1+ (1,0) [0|0] "" Vector__XXX
 SG_ APP_sw429_type m429 : 16|4@1+ (1,0) [0|0] "" Vector__XXX
 SG_ APP_sw433_currentCameraIsAeroRibFromEeprom m433 : 16|1@1+ (1,0) [0|0] "" Vector__XXX
 SG_ APP_sw434_currentCameraIsAeroRibFromEeprom m434 : 16|1@1+ (1,0) [0|0] "" Vector__XXX
 SG_ APP_sw435_leftRepeaterIsAeroRibFromEeprom m435 : 16|1@1+ (1,0) [0|0] "" Vector__XXX
 SG_ APP_sw436_quad1FatalError m436 : 16|1@1+ (1,0) [0|0] "" Vector__XXX
 SG_ APP_sw437_main m437 : 16|1@1+ (1,0) [0|0] "" Vector__XXX
 SG_ APP_sw438_actuation m438 : 16|1@1+ (1,0) [0|0] "" Vector__XXX
 SG_ APP_sw439_otherApeUnreachableViaEth0 m439 : 16|1@1+ (1,0) [0|0] "" Vector__XXX
 SG_ APP_sw442_cancelMethod m442 : 16|4@1+ (1,0) [0|0] "" Vector__XXX
 SG_ APP_sw443_configuredImagerModelNumber m443 : 16|4@1+ (1,0) [0|0] "" Vector__XXX
 SG_ APP_sw444_configuredImagerModelNumber m444 : 16|4@1+ (1,0) [0|0] "" Vector__XXX
 SG_ APP_sw445_configuredImagerModelNumber m445 : 16|4@1+ (1,0) [0|0] "" Vector__XXX
 SG_ APP_sw446_configuredImagerModelNumber m446 : 16|4@1+ (1,0) [0|0] "" Vector__XXX
 SG_ APP_sw447_configuredImagerModelNumber m447 : 16|4@1+ (1,0) [0|0] "" Vector__XXX
 SG_ APP_sw448_configuredImagerModelNumber m448 : 16|4@1+ (1,0) [0|0] "" Vector__XXX
 SG_ APP_sw449_configuredImagerModelNumber m449 : 16|4@1+ (1,0) [0|0] "" Vector__XXX
 SG_ APP_sw450_configuredImagerModelNumber m450 : 16|4@1+ (1,0) [0|0] "" Vector__XXX
 SG_ APP_sw451_configuredImagerModelNumber m451 : 16|4@1+ (1,0) [0|0] "" Vector__XXX
 SG_ APP_sw452_configuredImagerModelNumber m452 : 16|4@1+ (1,0) [0|0] "" Vector__XXX
 SG_ APP_sw454_reason1 m454 : 16|9@1+ (1,0) [0|0] "" Vector__XXX
 SG_ APP_sw455_reason1 m455 : 16|9@1+ (1,0) [0|0] "" Vector__XXX
 SG_ APP_sw004_radHWFailure m4 : 17|1@1+ (1,0) [0|0] "" Vector__XXX
 SG_ APP_sw005_AutofixOutOfCalibYaw m5 : 17|1@1+ (1,0) [0|0] "" Vector__XXX
 SG_ APP_sw006_RadarMisaligned m6 : 17|1@1+ (1,0) [0|0] "" Vector__XXX
 SG_ APP_sw009_DI_aeb_unresponsive m9 : 17|1@1+ (1,0) [0|0] "" Vector__XXX
 SG_ APP_sw010_a05calibReqd m10 : 17|1@1+ (1,0) [0|0] "" Vector__XXX
 SG_ APP_sw017_Camera_Msg_Objects_MIA m17 : 17|1@1+ (1,0) [0|0] "" Vector__XXX
 SG_ APP_sw027_Core_Reset m27 : 17|1@1+ (1,0) [0|0] "" Vector__XXX
 SG_ APP_sw028_rx_inv_len m28 : 17|1@1+ (1,0) [0|0] "" Vector__XXX
 SG_ APP_sw029_unusedBits m29 : 17|15@1+ (1,0) [0|0] "" Vector__XXX
 SG_ APP_sw033_chNm m33 : 17|1@1+ (1,0) [0|0] "" Vector__XXX
 SG_ APP_sw035_wheelRotation m35 : 17|1@1+ (1,0) [0|0] "" Vector__XXX
 SG_ APP_sw038_OutOfFocusImage m38 : 17|1@1+ (1,0) [0|0] "" Vector__XXX
 SG_ APP_sw045_radcInfo m45 : 17|1@1+ (1,0) [0|0] "" Vector__XXX
 SG_ APP_sw048_thermalIssue m48 : 17|1@1+ (1,0) [0|0] "" Vector__XXX
 SG_ APP_sw051_a02flashPerformance m51 : 17|1@1+ (1,0) [0|0] "" Vector__XXX
 SG_ APP_sw052_sensorDirty m52 : 17|1@1+ (1,0) [0|0] "" Vector__XXX
 SG_ APP_sw053_a11bdyMIA m53 : 17|1@1+ (1,0) [0|0] "" Vector__XXX
 SG_ APP_sw057_csaRoadCurvature m57 : 17|1@1+ (1,0) [0|0] "" Vector__XXX
 SG_ APP_sw059_oocStatus m59 : 17|1@1+ (1,0) [0|0] "" Vector__XXX
 SG_ APP_sw061_axleData m61 : 17|1@1+ (1,0) [0|0] "" Vector__XXX
 SG_ APP_sw064_status m64 : 17|1@1+ (1,0) [0|0] "" Vector__XXX
 SG_ APP_sw069_espMia m69 : 17|1@1+ (1,0) [0|0] "" Vector__XXX
 SG_ APP_sw073_silentEscalatedLDW m73 : 17|1@1+ (1,0) [0|0] "" Vector__XXX
 SG_ APP_sw080_dist_travelled_check m80 : 17|1@1+ (1,0) [0|0] "" Vector__XXX
 SG_ APP_sw145_yawSpike m145 : 17|1@1+ (1,0) [0|0] "" Vector__XXX
 SG_ APP_sw150_speed m150 : 17|1@1+ (1,0) [0|0] "" Vector__XXX
 SG_ APP_sw151_status m151 : 17|1@1+ (1,0) [0|0] "" Vector__XXX
 SG_ APP_sw152_wheelRotation m152 : 17|1@1+ (1,0) [0|0] "" Vector__XXX
 SG_ APP_sw153_inertial2 m153 : 17|1@1+ (1,0) [0|0] "" Vector__XXX
 SG_ APP_sw154_doorStatus m154 : 17|1@1+ (1,0) [0|0] "" Vector__XXX
 SG_ APP_sw155_doorStatus m155 : 17|1@1+ (1,0) [0|0] "" Vector__XXX
 SG_ APP_sw156_autonomyHealth m156 : 17|1@1+ (1,0) [0|0] "" Vector__XXX
 SG_ APP_sw157_rightStalk m157 : 17|1@1+ (1,0) [0|0] "" Vector__XXX
 SG_ APP_sw158_vehicleStatus m158 : 17|1@1+ (1,0) [0|0] "" Vector__XXX
 SG_ APP_sw159_switchStatus m159 : 17|1@1+ (1,0) [0|0] "" Vector__XXX
 SG_ APP_sw160_thsStatus m160 : 17|1@1+ (1,0) [0|0] "" Vector__XXX
 SG_ APP_sw161_hdmiDisplayError m161 : 17|1@1+ (1,0) [0|0] "" Vector__XXX
 SG_ APP_sw162_detectedColorFilter m162 : 17|2@1+ (1,0) [0|0] "" Vector__XXX
 SG_ APP_sw163_detectedColorFilter m163 : 17|2@1+ (1,0) [0|0] "" Vector__XXX
 SG_ APP_sw164_detectedColorFilter m164 : 17|2@1+ (1,0) [0|0] "" Vector__XXX
 SG_ APP_sw165_detectedColorFilter m165 : 17|2@1+ (1,0) [0|0] "" Vector__XXX
 SG_ APP_sw166_detectedColorFilter m166 : 17|2@1+ (1,0) [0|0] "" Vector__XXX
 SG_ APP_sw167_detectedColorFilter m167 : 17|2@1+ (1,0) [0|0] "" Vector__XXX
 SG_ APP_sw168_detectedColorFilter m168 : 17|2@1+ (1,0) [0|0] "" Vector__XXX
 SG_ APP_sw169_detectedColorFilter m169 : 17|2@1+ (1,0) [0|0] "" Vector__XXX
 SG_ APP_sw170_detectedColorFilter m170 : 17|2@1+ (1,0) [0|0] "" Vector__XXX
 SG_ APP_sw182_bufferError m182 : 17|1@1+ (1,0) [0|0] "" Vector__XXX
 SG_ APP_sw183_bufferError m183 : 17|1@1+ (1,0) [0|0] "" Vector__XXX
 SG_ APP_sw184_bufferError m184 : 17|1@1+ (1,0) [0|0] "" Vector__XXX
 SG_ APP_sw185_bufferError m185 : 17|1@1+ (1,0) [0|0] "" Vector__XXX
 SG_ APP_sw186_bufferError m186 : 17|1@1+ (1,0) [0|0] "" Vector__XXX
 SG_ APP_sw187_bufferError m187 : 17|1@1+ (1,0) [0|0] "" Vector__XXX
 SG_ APP_sw188_bufferError m188 : 17|1@1+ (1,0) [0|0] "" Vector__XXX
 SG_ APP_sw189_bufferError m189 : 17|1@1+ (1,0) [0|0] "" Vector__XXX
 SG_ APP_sw190_bufferError m190 : 17|1@1+ (1,0) [0|0] "" Vector__XXX
 SG_ APP_sw193_fullBlockage m193 : 17|1@1+ (1,0) [0|0] "" Vector__XXX
 SG_ APP_sw195_s6Blocked m195 : 17|1@1+ (1,0) [0|0] "" Vector__XXX
 SG_ APP_sw198_partialBlockage m198 : 17|1@1+ (1,0) [0|0] "" Vector__XXX
 SG_ APP_sw202_s6Blocked m202 : 17|1@1+ (1,0) [0|0] "" Vector__XXX
 SG_ APP_sw219_roadClass m219 : 17|3@1+ (1,0) [0|0] "" Vector__XXX
 SG_ APP_sw220_roadClass m220 : 17|3@1+ (1,0) [0|0] "" Vector__XXX
 SG_ APP_sw227_sensorNumber m227 : 17|1@1+ (1,0) [0|0] "" Vector__XXX
 SG_ APP_sw230_sensor2Blocked m230 : 17|1@1+ (1,0) [0|0] "" Vector__XXX
 SG_ APP_sw234_bcw m234 : 17|1@1+ (1,0) [0|0] "" Vector__XXX
 SG_ APP_sw259_do_accel_pedal m259 : 17|1@1+ (1,0) [0|0] "" Vector__XXX
 SG_ APP_sw263_eacStatusNotOk m263 : 17|1@1+ (1,0) [0|0] "" Vector__XXX
 SG_ APP_sw265_mpLocalizedWay m265 : 17|1@1+ (1,0) [0|0] "" Vector__XXX
 SG_ APP_sw269_narrowStreamExit m269 : 17|1@1+ (1,0) [0|0] "" Vector__XXX
 SG_ APP_sw270_lPillarStreamExit m270 : 17|1@1+ (1,0) [0|0] "" Vector__XXX
 SG_ APP_sw273_collisionType m273 : 17|3@1+ (1,0) [0|0] "" Vector__XXX
 SG_ APP_sw274_bufferError m274 : 17|1@1+ (1,0) [0|0] "" Vector__XXX
 SG_ APP_sw275_bufferError m275 : 17|1@1+ (1,0) [0|0] "" Vector__XXX
 SG_ APP_sw276_bufferError m276 : 17|1@1+ (1,0) [0|0] "" Vector__XXX
 SG_ APP_sw277_bufferError m277 : 17|1@1+ (1,0) [0|0] "" Vector__XXX
 SG_ APP_sw278_bufferError m278 : 17|1@1+ (1,0) [0|0] "" Vector__XXX
 SG_ APP_sw279_bufferError m279 : 17|1@1+ (1,0) [0|0] "" Vector__XXX
 SG_ APP_sw280_bufferError m280 : 17|1@1+ (1,0) [0|0] "" Vector__XXX
 SG_ APP_sw281_bufferError m281 : 17|1@1+ (1,0) [0|0] "" Vector__XXX
 SG_ APP_sw282_bufferError m282 : 17|1@1+ (1,0) [0|0] "" Vector__XXX
 SG_ APP_sw285_gpsJunkData m285 : 17|1@1+ (1,0) [0|0] "" Vector__XXX
 SG_ APP_sw286_invalidID m286 : 17|1@1+ (1,0) [0|0] "" Vector__XXX
 SG_ APP_sw302_cameraCleaningStatus m302 : 17|1@1+ (1,0) [0|0] "" Vector__XXX
 SG_ APP_sw304_lssRPillarBlocked m304 : 17|1@1+ (1,0) [0|0] "" Vector__XXX
 SG_ APP_sw305_lssRPillarStreamExit m305 : 17|1@1+ (1,0) [0|0] "" Vector__XXX
 SG_ APP_sw306_lssUssS2Blocked m306 : 17|1@1+ (1,0) [0|0] "" Vector__XXX
 SG_ APP_sw307_lssTurnSignalFRFault m307 : 17|1@1+ (1,0) [0|0] "" Vector__XXX
 SG_ APP_sw310_rxErrThresholdReached m310 : 17|1@1+ (1,0) [0|0] "" Vector__XXX
 SG_ APP_sw311_rxErrThresholdReached m311 : 17|1@1+ (1,0) [0|0] "" Vector__XXX
 SG_ APP_sw321_status m321 : 17|1@1+ (1,0) [0|0] "" Vector__XXX
 SG_ APP_sw322_blinded m322 : 17|1@1+ (1,0) [0|0] "" Vector__XXX
 SG_ APP_sw327_hardwareTypeMismatch m327 : 17|1@1+ (1,0) [0|0] "" Vector__XXX
 SG_ APP_sw328_ussS2Unavailable m328 : 17|1@1+ (1,0) [0|0] "" Vector__XXX
 SG_ APP_sw330_streamExit m330 : 17|1@1+ (1,0) [0|0] "" Vector__XXX
 SG_ APP_sw331_rPillarOccluded m331 : 17|1@1+ (1,0) [0|0] "" Vector__XXX
 SG_ APP_sw332_pillars m332 : 17|1@1+ (1,0) [0|0] "" Vector__XXX
 SG_ APP_sw341_azAntCalibDataInvalid m341 : 17|1@1+ (1,0) [0|0] "" Vector__XXX
 SG_ APP_sw346_fastStartSeedReceived m346 : 17|1@1+ (1,0) [0|0] "" Vector__XXX
 SG_ APP_sw348_narrow m348 : 17|1@1+ (1,0) [0|0] "" Vector__XXX
 SG_ APP_sw349_narrow m349 : 17|1@1+ (1,0) [0|0] "" Vector__XXX
 SG_ APP_sw350_trackerMisalignCalError m350 : 17|1@1+ (1,0) [0|0] "" Vector__XXX
 SG_ APP_sw355_quad2 m355 : 17|1@1+ (1,0) [0|0] "" Vector__XXX
 SG_ APP_sw357_cameraDisabled m357 : 17|1@1+ (1,0) [0|0] "" Vector__XXX
 SG_ APP_sw358_mainCameraBlinded m358 : 17|1@1+ (1,0) [0|0] "" Vector__XXX
 SG_ APP_sw359_narrowCameraBlinded m359 : 17|1@1+ (1,0) [0|0] "" Vector__XXX
 SG_ APP_sw373_parityError m373 : 17|1@1+ (1,0) [0|0] "" Vector__XXX
 SG_ APP_sw380_irregularRxTimestamp m380 : 17|1@1+ (1,0) [0|0] "" Vector__XXX
 SG_ APP_sw381_smallForwardsJump m381 : 17|1@1+ (1,0) [0|0] "" Vector__XXX
 SG_ APP_sw382_smallForwardsJump m382 : 17|1@1+ (1,0) [0|0] "" Vector__XXX
 SG_ APP_sw385_positioningEngineMia m385 : 17|1@1+ (1,0) [0|0] "" Vector__XXX
 SG_ APP_sw387_radarBlind m387 : 17|1@1+ (1,0) [0|0] "" Vector__XXX
 SG_ APP_sw389_leftPillarCamResidue m389 : 17|1@1+ (1,0) [0|0] "" Vector__XXX
 SG_ APP_sw393_devControl m393 : 17|1@1+ (1,0) [0|0] "" Vector__XXX
 SG_ APP_sw404_autonomyHealth m404 : 17|1@1+ (1,0) [0|0] "" Vector__XXX
 SG_ APP_sw405_status2 m405 : 17|1@1+ (1,0) [0|0] "" Vector__XXX
 SG_ APP_sw406_gnssUartErrors m406 : 17|1@1+ (1,0) [0|0] "" Vector__XXX
 SG_ APP_sw407_neutralGear m407 : 17|1@1+ (1,0) [0|0] "" Vector__XXX
 SG_ APP_sw408_lvCriticalState m408 : 17|1@1+ (1,0) [0|0] "" Vector__XXX
 SG_ APP_sw409_leftPillarCamHeaterFault m409 : 17|1@1+ (1,0) [0|0] "" Vector__XXX
 SG_ APP_sw410_autonomyControllingAndNotParked m410 : 17|1@1+ (1,0) [0|0] "" Vector__XXX
 SG_ APP_sw413_diVelocityEstimatorStateDegraded m413 : 17|1@1+ (1,0) [0|0] "" Vector__XXX
 SG_ APP_sw433_currentCameraAeroRibInfoFromGtw m433 : 17|3@1+ (1,0) [0|0] "" Vector__XXX
 SG_ APP_sw434_currentCameraAeroRibInfoFromGtw m434 : 17|3@1+ (1,0) [0|0] "" Vector__XXX
 SG_ APP_sw435_leftRepeaterAeroRibInfoFromGTW m435 : 17|3@1+ (1,0) [0|0] "" Vector__XXX
 SG_ APP_sw436_quad1DmaFifoOverflow m436 : 17|1@1+ (1,0) [0|0] "" Vector__XXX
 SG_ APP_sw437_narrow m437 : 17|1@1+ (1,0) [0|0] "" Vector__XXX
 SG_ APP_sw439_otherApeUnreachableViaEth1 m439 : 17|1@1+ (1,0) [0|0] "" Vector__XXX
 SG_ APP_sw004_radSensorBlind m4 : 18|1@1+ (1,0) [0|0] "" Vector__XXX
 SG_ APP_sw005_RadarMisalignment m5 : 18|1@1+ (1,0) [0|0] "" Vector__XXX
 SG_ APP_sw006_radCalibration m6 : 18|1@1+ (1,0) [0|0] "" Vector__XXX
 SG_ APP_sw009_DI_MIA m9 : 18|1@1+ (1,0) [0|0] "" Vector__XXX
 SG_ APP_sw010_a06calibNotOK m10 : 18|1@1+ (1,0) [0|0] "" Vector__XXX
 SG_ APP_sw015_RadarMisalignment m15 : 18|2@1+ (1,0) [0|0] "" Vector__XXX
 SG_ APP_sw017_Camera_Msg_Tsr_MIA m17 : 18|1@1+ (1,0) [0|0] "" Vector__XXX
 SG_ APP_sw026_tardiness m26 : 18|9@1+ (0.25,0) [0|0] "" Vector__XXX
 SG_ APP_sw027_Unused_Bit_0 m27 : 18|1@1+ (1,0) [0|0] "" Vector__XXX
 SG_ APP_sw028_inv_multifrm_1st m28 : 18|1@1+ (1,0) [0|0] "" Vector__XXX
 SG_ APP_sw033_gearControlVehBus m33 : 18|1@1+ (1,0) [0|0] "" Vector__XXX
 SG_ APP_sw035_wheelSpeeds m35 : 18|1@1+ (1,0) [0|0] "" Vector__XXX
 SG_ APP_sw038_AutofixOutOfCalib m38 : 18|1@1+ (1,0) [0|0] "" Vector__XXX
 SG_ APP_sw045_radcAccTargObj1A m45 : 18|1@1+ (1,0) [0|0] "" Vector__XXX
 SG_ APP_sw048_powerIssue m48 : 18|1@1+ (1,0) [0|0] "" Vector__XXX
 SG_ APP_sw051_a03vBatHigh m51 : 18|1@1+ (1,0) [0|0] "" Vector__XXX
 SG_ APP_sw052_HWFail m52 : 18|1@1+ (1,0) [0|0] "" Vector__XXX
 SG_ APP_sw053_a12espMIA m53 : 18|1@1+ (1,0) [0|0] "" Vector__XXX
 SG_ APP_sw057_driverAssistControl m57 : 18|1@1+ (1,0) [0|0] "" Vector__XXX
 SG_ APP_sw059_pasFrontMiddle m59 : 18|1@1+ (1,0) [0|0] "" Vector__XXX
 SG_ APP_sw061_dampingStates m61 : 18|1@1+ (1,0) [0|0] "" Vector__XXX
 SG_ APP_sw069_parkMia m69 : 18|1@1+ (1,0) [0|0] "" Vector__XXX
 SG_ APP_sw073_escalateLDWreason m73 : 18|3@1+ (1,0) [0|0] "" Vector__XXX
 SG_ APP_sw080_road_class_check m80 : 18|1@1+ (1,0) [0|0] "" Vector__XXX
 SG_ APP_sw145_rollSpike m145 : 18|1@1+ (1,0) [0|0] "" Vector__XXX
 SG_ APP_sw150_systemStatus m150 : 18|1@1+ (1,0) [0|0] "" Vector__XXX
 SG_ APP_sw152_wheelSpeeds m152 : 18|1@1+ (1,0) [0|0] "" Vector__XXX
 SG_ APP_sw153_inertial3 m153 : 18|1@1+ (1,0) [0|0] "" Vector__XXX
 SG_ APP_sw157_steeringAngleSensor m157 : 18|1@1+ (1,0) [0|0] "" Vector__XXX
 SG_ APP_sw158_status m158 : 18|1@1+ (1,0) [0|0] "" Vector__XXX
 SG_ APP_sw160_hvacStatus m160 : 18|1@1+ (1,0) [0|0] "" Vector__XXX
 SG_ APP_sw161_rawImageTimeout m161 : 18|1@1+ (1,0) [0|0] "" Vector__XXX
 SG_ APP_sw182_frameGrabFailure m182 : 18|1@1+ (1,0) [0|0] "" Vector__XXX
 SG_ APP_sw183_frameGrabFailure m183 : 18|1@1+ (1,0) [0|0] "" Vector__XXX
 SG_ APP_sw184_frameGrabFailure m184 : 18|1@1+ (1,0) [0|0] "" Vector__XXX
 SG_ APP_sw185_frameGrabFailure m185 : 18|1@1+ (1,0) [0|0] "" Vector__XXX
 SG_ APP_sw186_frameGrabFailure m186 : 18|1@1+ (1,0) [0|0] "" Vector__XXX
 SG_ APP_sw187_frameGrabFailure m187 : 18|1@1+ (1,0) [0|0] "" Vector__XXX
 SG_ APP_sw188_frameGrabFailure m188 : 18|1@1+ (1,0) [0|0] "" Vector__XXX
 SG_ APP_sw189_frameGrabFailure m189 : 18|1@1+ (1,0) [0|0] "" Vector__XXX
 SG_ APP_sw190_frameGrabFailure m190 : 18|1@1+ (1,0) [0|0] "" Vector__XXX
 SG_ APP_sw193_impairedVD m193 : 18|1@1+ (1,0) [0|0] "" Vector__XXX
 SG_ APP_sw195_s7Blocked m195 : 18|1@1+ (1,0) [0|0] "" Vector__XXX
 SG_ APP_sw198_tflMsgInvalid m198 : 18|1@1+ (1,0) [0|0] "" Vector__XXX
 SG_ APP_sw202_s7Blocked m202 : 18|1@1+ (1,0) [0|0] "" Vector__XXX
 SG_ APP_sw227_vehicleSpeed m227 : 18|12@1+ (0.05,-25) [0|0] "" Vector__XXX
 SG_ APP_sw230_sensor3Blocked m230 : 18|1@1+ (1,0) [0|0] "" Vector__XXX
 SG_ APP_sw234_cruiseEnabled m234 : 18|1@1+ (1,0) [0|0] "" Vector__XXX
 SG_ APP_sw259_do_aeb_accel_pedal m259 : 18|1@1+ (1,0) [0|0] "" Vector__XXX
 SG_ APP_sw263_timerExpired m263 : 18|1@1+ (1,0) [0|0] "" Vector__XXX
 SG_ APP_sw265_mmHasRoute m265 : 18|1@1+ (1,0) [0|0] "" Vector__XXX
 SG_ APP_sw269_fisheyeStreamExit m269 : 18|1@1+ (1,0) [0|0] "" Vector__XXX
 SG_ APP_sw270_rPillarStreamExit m270 : 18|1@1+ (1,0) [0|0] "" Vector__XXX
 SG_ APP_sw274_frameGrabFailure m274 : 18|1@1+ (1,0) [0|0] "" Vector__XXX
 SG_ APP_sw275_frameGrabFailure m275 : 18|1@1+ (1,0) [0|0] "" Vector__XXX
 SG_ APP_sw276_frameGrabFailure m276 : 18|1@1+ (1,0) [0|0] "" Vector__XXX
 SG_ APP_sw277_frameGrabFailure m277 : 18|1@1+ (1,0) [0|0] "" Vector__XXX
 SG_ APP_sw278_frameGrabFailure m278 : 18|1@1+ (1,0) [0|0] "" Vector__XXX
 SG_ APP_sw279_frameGrabFailure m279 : 18|1@1+ (1,0) [0|0] "" Vector__XXX
 SG_ APP_sw280_frameGrabFailure m280 : 18|1@1+ (1,0) [0|0] "" Vector__XXX
 SG_ APP_sw281_frameGrabFailure m281 : 18|1@1+ (1,0) [0|0] "" Vector__XXX
 SG_ APP_sw282_frameGrabFailure m282 : 18|1@1+ (1,0) [0|0] "" Vector__XXX
 SG_ APP_sw285_gpsNMEAmissing m285 : 18|1@1+ (1,0) [0|0] "" Vector__XXX
 SG_ APP_sw286_gpsBufferOverflow m286 : 18|1@1+ (1,0) [0|0] "" Vector__XXX
 SG_ APP_sw304_lssLRepeaterBlocked m304 : 18|1@1+ (1,0) [0|0] "" Vector__XXX
 SG_ APP_sw305_lssLRepeaterStreamExit m305 : 18|1@1+ (1,0) [0|0] "" Vector__XXX
 SG_ APP_sw306_lssUssS3Blocked m306 : 18|1@1+ (1,0) [0|0] "" Vector__XXX
 SG_ APP_sw307_lssTurnSignalRLFault m307 : 18|1@1+ (1,0) [0|0] "" Vector__XXX
 SG_ APP_sw312_detectedSensorModel m312 : 18|2@1+ (1,0) [0|0] "" Vector__XXX
 SG_ APP_sw313_detectedSensorModel m313 : 18|2@1+ (1,0) [0|0] "" Vector__XXX
 SG_ APP_sw314_detectedSensorModel m314 : 18|2@1+ (1,0) [0|0] "" Vector__XXX
 SG_ APP_sw315_detectedSensorModel m315 : 18|2@1+ (1,0) [0|0] "" Vector__XXX
 SG_ APP_sw316_detectedSensorModel m316 : 18|2@1+ (1,0) [0|0] "" Vector__XXX
 SG_ APP_sw317_detectedSensorModel m317 : 18|2@1+ (1,0) [0|0] "" Vector__XXX
 SG_ APP_sw318_detectedSensorModel m318 : 18|2@1+ (1,0) [0|0] "" Vector__XXX
 SG_ APP_sw319_detectedSensorModel m319 : 18|2@1+ (1,0) [0|0] "" Vector__XXX
 SG_ APP_sw320_detectedSensorModel m320 : 18|2@1+ (1,0) [0|0] "" Vector__XXX
 SG_ APP_sw321_autonomyHealth m321 : 18|1@1+ (1,0) [0|0] "" Vector__XXX
 SG_ APP_sw322_falseWipe m322 : 18|1@1+ (1,0) [0|0] "" Vector__XXX
 SG_ APP_sw327_turboTypeMismatch m327 : 18|1@1+ (1,0) [0|0] "" Vector__XXX
 SG_ APP_sw328_ussS3Unavailable m328 : 18|1@1+ (1,0) [0|0] "" Vector__XXX
 SG_ APP_sw330_ledFault m330 : 18|1@1+ (1,0) [0|0] "" Vector__XXX
 SG_ APP_sw331_lRepeaterOccluded m331 : 18|1@1+ (1,0) [0|0] "" Vector__XXX
 SG_ APP_sw335_unusedBits m335 : 18|14@1+ (1,0) [0|0] "" Vector__XXX
 SG_ APP_sw336_railPowerErr m336 : 18|1@1+ (1,0) [0|0] "" Vector__XXX
 SG_ APP_sw337_miaErr m337 : 18|1@1+ (1,0) [0|0] "" Vector__XXX
 SG_ APP_sw340_unusedBits m340 : 18|14@1+ (1,0) [0|0] "" Vector__XXX
 SG_ APP_sw341_elAntCalibDataInvalid m341 : 18|1@1+ (1,0) [0|0] "" Vector__XXX
 SG_ APP_sw346_alignmentComplete m346 : 18|1@1+ (1,0) [0|0] "" Vector__XXX
 SG_ APP_sw348_fisheye m348 : 18|1@1+ (1,0) [0|0] "" Vector__XXX
 SG_ APP_sw349_fisheye m349 : 18|1@1+ (1,0) [0|0] "" Vector__XXX
 SG_ APP_sw350_posRollAngleInvalid m350 : 18|1@1+ (1,0) [0|0] "" Vector__XXX
 SG_ APP_sw355_quad3 m355 : 18|1@1+ (1,0) [0|0] "" Vector__XXX
 SG_ APP_sw357_cameraNotStreaming m357 : 18|1@1+ (1,0) [0|0] "" Vector__XXX
 SG_ APP_sw358_fisheyeCameraBlinded m358 : 18|1@1+ (1,0) [0|0] "" Vector__XXX
 SG_ APP_sw359_fisheyeCameraBlinded m359 : 18|1@1+ (1,0) [0|0] "" Vector__XXX
 SG_ APP_sw373_frameError m373 : 18|1@1+ (1,0) [0|0] "" Vector__XXX
 SG_ APP_sw381_largeForwardsJump m381 : 18|1@1+ (1,0) [0|0] "" Vector__XXX
 SG_ APP_sw382_largeForwardsJump m382 : 18|1@1+ (1,0) [0|0] "" Vector__XXX
 SG_ APP_sw385_posEngineTaskFailure m385 : 18|1@1+ (1,0) [0|0] "" Vector__XXX
 SG_ APP_sw387_fastObjCounter m387 : 18|4@1+ (1,0) [0|0] "" Vector__XXX
 SG_ APP_sw389_rightPillarCamResidue m389 : 18|1@1+ (1,0) [0|0] "" Vector__XXX
 SG_ APP_sw393_operatorVehicle m393 : 18|1@1+ (1,0) [0|0] "" Vector__XXX
 SG_ APP_sw398_outputUnhealthyReason m398 : 18|3@1+ (1,0) [0|0] "" Vector__XXX
 SG_ APP_sw405_sysHealth2 m405 : 18|1@1+ (1,0) [0|0] "" Vector__XXX
 SG_ APP_sw406_gnssAntDisconnect m406 : 18|1@1+ (1,0) [0|0] "" Vector__XXX
 SG_ APP_sw407_noAutonomyModeActive m407 : 18|1@1+ (1,0) [0|0] "" Vector__XXX
 SG_ APP_sw408_controllerSolverFailure m408 : 18|1@1+ (1,0) [0|0] "" Vector__XXX
 SG_ APP_sw409_rightPillarCamHeaterFault m409 : 18|1@1+ (1,0) [0|0] "" Vector__XXX
 SG_ APP_sw410_cameraDayOffgassing m410 : 18|1@1+ (1,0) [0|0] "" Vector__XXX
 SG_ APP_sw413_noVehicleSpeedSourceAvailable m413 : 18|1@1+ (1,0) [0|0] "" Vector__XXX
 SG_ APP_sw436_quad2FatalError m436 : 18|1@1+ (1,0) [0|0] "" Vector__XXX
 SG_ APP_sw437_fisheye m437 : 18|1@1+ (1,0) [0|0] "" Vector__XXX
 SG_ APP_sw439_sgkAUnreachableViaEth0 m439 : 18|1@1+ (1,0) [0|0] "" Vector__XXX
 SG_ APP_sw004_radSGUFailure m4 : 19|1@1+ (1,0) [0|0] "" Vector__XXX
 SG_ APP_sw005_partialBlockage m5 : 19|1@1+ (1,0) [0|0] "" Vector__XXX
 SG_ APP_sw006_OutOfFocusImage m6 : 19|1@1+ (1,0) [0|0] "" Vector__XXX
 SG_ APP_sw009_SCCM_MIA m9 : 19|1@1+ (1,0) [0|0] "" Vector__XXX
 SG_ APP_sw010_a08PlantMode m10 : 19|1@1+ (1,0) [0|0] "" Vector__XXX
 SG_ APP_sw011_scaLeft m11 : 19|1@1+ (1,0) [0|0] "" Vector__XXX
 SG_ APP_sw017_Camera_Msg_Hlb_MIA m17 : 19|1@1+ (1,0) [0|0] "" Vector__XXX
 SG_ APP_sw027_CPU_Checkstop_Error m27 : 19|1@1+ (1,0) [0|0] "" Vector__XXX
 SG_ APP_sw028_inv_multifrm_id m28 : 19|1@1+ (1,0) [0|0] "" Vector__XXX
 SG_ APP_sw035_redundantBrakingStatus m35 : 19|1@1+ (1,0) [0|0] "" Vector__XXX
 SG_ APP_sw038_AutofixOutOfCalibHorzn m38 : 19|1@1+ (1,0) [0|0] "" Vector__XXX
 SG_ APP_sw042_abort_reason m42 : 19|5@1+ (1,0) [0|0] "" Vector__XXX
 SG_ APP_sw045_lrrAlertMatrix0 m45 : 19|1@1+ (1,0) [0|0] "" Vector__XXX
 SG_ APP_sw048_stackOverflow m48 : 19|1@1+ (1,0) [0|0] "" Vector__XXX
 SG_ APP_sw051_a09configMismatch m51 : 19|1@1+ (1,0) [0|0] "" Vector__XXX
 SG_ APP_sw052_overTemperature m52 : 19|1@1+ (1,0) [0|0] "" Vector__XXX
 SG_ APP_sw053_a13gtwMIA m53 : 19|1@1+ (1,0) [0|0] "" Vector__XXX
 SG_ APP_sw057_autopilotControl m57 : 19|1@1+ (1,0) [0|0] "" Vector__XXX
 SG_ APP_sw059_pasRearMiddle m59 : 19|1@1+ (1,0) [0|0] "" Vector__XXX
 SG_ APP_sw061_speedBumpAttributes m61 : 19|1@1+ (1,0) [0|0] "" Vector__XXX
 SG_ APP_sw069_sccmMia m69 : 19|1@1+ (1,0) [0|0] "" Vector__XXX
 SG_ APP_sw070_lastTireFitment m70 : 19|3@1+ (1,0) [0|0] "" Vector__XXX
 SG_ APP_sw080_stw_angle_check m80 : 19|1@1+ (1,0) [0|0] "" Vector__XXX
 SG_ APP_sw133_mainCamI2CbusFault m133 : 19|1@1+ (1,0) [0|0] "" Vector__XXX
 SG_ APP_sw134_narrowCamI2CbusFault m134 : 19|1@1+ (1,0) [0|0] "" Vector__XXX
 SG_ APP_sw135_fisheyeCamI2CbusFault m135 : 19|1@1+ (1,0) [0|0] "" Vector__XXX
 SG_ APP_sw136_lPillarCamI2CbusFault m136 : 19|1@1+ (1,0) [0|0] "" Vector__XXX
 SG_ APP_sw137_rPillarCamI2CbusFault m137 : 19|1@1+ (1,0) [0|0] "" Vector__XXX
 SG_ APP_sw138_lRepeatCamI2CbusFault m138 : 19|1@1+ (1,0) [0|0] "" Vector__XXX
 SG_ APP_sw139_rRepeatCamI2CbusFault m139 : 19|1@1+ (1,0) [0|0] "" Vector__XXX
 SG_ APP_sw140_backupCamDeserFault m140 : 19|3@1+ (1,0) [0|0] "" Vector__XXX
 SG_ APP_sw145_insaneCal m145 : 19|1@1+ (1,0) [0|0] "" Vector__XXX
 SG_ APP_sw146_packageType m146 : 19|3@1+ (1,0) [0|0] "" Vector__XXX
 SG_ APP_sw147_selfieCamI2CbusFault m147 : 19|1@1+ (1,0) [0|0] "" Vector__XXX
 SG_ APP_sw150_chassisControl m150 : 19|1@1+ (1,0) [0|0] "" Vector__XXX
 SG_ APP_sw153_inertial4 m153 : 19|1@1+ (1,0) [0|0] "" Vector__XXX
 SG_ APP_sw158_lighting m158 : 19|1@1+ (1,0) [0|0] "" Vector__XXX
 SG_ APP_sw160_switchStatus m160 : 19|1@1+ (1,0) [0|0] "" Vector__XXX
 SG_ APP_sw161_imagerOutOfSpecTemp m161 : 19|1@1+ (1,0) [0|0] "" Vector__XXX
 SG_ APP_sw162_expectedColorFilter m162 : 19|2@1+ (1,0) [0|0] "" Vector__XXX
 SG_ APP_sw163_expectedColorFilter m163 : 19|2@1+ (1,0) [0|0] "" Vector__XXX
 SG_ APP_sw164_expectedColorFilter m164 : 19|2@1+ (1,0) [0|0] "" Vector__XXX
 SG_ APP_sw165_expectedColorFilter m165 : 19|2@1+ (1,0) [0|0] "" Vector__XXX
 SG_ APP_sw166_expectedColorFilter m166 : 19|2@1+ (1,0) [0|0] "" Vector__XXX
 SG_ APP_sw167_expectedColorFilter m167 : 19|2@1+ (1,0) [0|0] "" Vector__XXX
 SG_ APP_sw168_expectedColorFilter m168 : 19|2@1+ (1,0) [0|0] "" Vector__XXX
 SG_ APP_sw169_expectedColorFilter m169 : 19|2@1+ (1,0) [0|0] "" Vector__XXX
 SG_ APP_sw170_expectedColorFilter m170 : 19|2@1+ (1,0) [0|0] "" Vector__XXX
 SG_ APP_sw182_gainControlFailure m182 : 19|1@1+ (1,0) [0|0] "" Vector__XXX
 SG_ APP_sw183_gainControlFailure m183 : 19|1@1+ (1,0) [0|0] "" Vector__XXX
 SG_ APP_sw184_gainControlFailure m184 : 19|1@1+ (1,0) [0|0] "" Vector__XXX
 SG_ APP_sw185_gainControlFailure m185 : 19|1@1+ (1,0) [0|0] "" Vector__XXX
 SG_ APP_sw186_gainControlFailure m186 : 19|1@1+ (1,0) [0|0] "" Vector__XXX
 SG_ APP_sw187_gainControlFailure m187 : 19|1@1+ (1,0) [0|0] "" Vector__XXX
 SG_ APP_sw188_gainControlFailure m188 : 19|1@1+ (1,0) [0|0] "" Vector__XXX
 SG_ APP_sw189_gainControlFailure m189 : 19|1@1+ (1,0) [0|0] "" Vector__XXX
 SG_ APP_sw190_gainControlFailure m190 : 19|1@1+ (1,0) [0|0] "" Vector__XXX
 SG_ APP_sw192_chassisType m192 : 19|3@1+ (1,0) [0|0] "" Vector__XXX
 SG_ APP_sw193_outOfFocusImage m193 : 19|1@1+ (1,0) [0|0] "" Vector__XXX
 SG_ APP_sw195_s8Blocked m195 : 19|1@1+ (1,0) [0|0] "" Vector__XXX
 SG_ APP_sw198_tsrMsgInvalid m198 : 19|1@1+ (1,0) [0|0] "" Vector__XXX
 SG_ APP_sw201_steeringErrorOAL m201 : 19|3@1+ (1,0) [0|0] "" Vector__XXX
 SG_ APP_sw202_s8Blocked m202 : 19|1@1+ (1,0) [0|0] "" Vector__XXX
 SG_ APP_sw230_sensor4Blocked m230 : 19|1@1+ (1,0) [0|0] "" Vector__XXX
 SG_ APP_sw234_eldw m234 : 19|1@1+ (1,0) [0|0] "" Vector__XXX
 SG_ APP_sw259_do_brake_pedal m259 : 19|1@1+ (1,0) [0|0] "" Vector__XXX
 SG_ APP_sw263_notStableInLane m263 : 19|1@1+ (1,0) [0|0] "" Vector__XXX
 SG_ APP_sw265_mmLocalizedEdge m265 : 19|1@1+ (1,0) [0|0] "" Vector__XXX
 SG_ APP_sw266_rPillarStreamStatus m266 : 19|3@1+ (1,0) [0|0] "" Vector__XXX
 SG_ APP_sw269_lPillarStreamExit m269 : 19|1@1+ (1,0) [0|0] "" Vector__XXX
 SG_ APP_sw270_lRepeaterStreamExit m270 : 19|1@1+ (1,0) [0|0] "" Vector__XXX
 SG_ APP_sw274_gainControlFailure m274 : 19|1@1+ (1,0) [0|0] "" Vector__XXX
 SG_ APP_sw275_gainControlFailure m275 : 19|1@1+ (1,0) [0|0] "" Vector__XXX
 SG_ APP_sw276_gainControlFailure m276 : 19|1@1+ (1,0) [0|0] "" Vector__XXX
 SG_ APP_sw277_gainControlFailure m277 : 19|1@1+ (1,0) [0|0] "" Vector__XXX
 SG_ APP_sw278_gainControlFailure m278 : 19|1@1+ (1,0) [0|0] "" Vector__XXX
 SG_ APP_sw279_gainControlFailure m279 : 19|1@1+ (1,0) [0|0] "" Vector__XXX
 SG_ APP_sw280_gainControlFailure m280 : 19|1@1+ (1,0) [0|0] "" Vector__XXX
 SG_ APP_sw281_gainControlFailure m281 : 19|1@1+ (1,0) [0|0] "" Vector__XXX
 SG_ APP_sw282_gainControlFailure m282 : 19|1@1+ (1,0) [0|0] "" Vector__XXX
 SG_ APP_sw285_gpsUBXmissing m285 : 19|1@1+ (1,0) [0|0] "" Vector__XXX
 SG_ APP_sw286_navx5CfgFailed m286 : 19|1@1+ (1,0) [0|0] "" Vector__XXX
 SG_ APP_sw304_lssRRepeaterBlocked m304 : 19|1@1+ (1,0) [0|0] "" Vector__XXX
 SG_ APP_sw305_lssRRepeaterStreamExit m305 : 19|1@1+ (1,0) [0|0] "" Vector__XXX
 SG_ APP_sw306_lssUssS4Blocked m306 : 19|1@1+ (1,0) [0|0] "" Vector__XXX
 SG_ APP_sw307_lssTurnSignalRRFault m307 : 19|1@1+ (1,0) [0|0] "" Vector__XXX
 SG_ APP_sw327_epasTypeMismatch m327 : 19|1@1+ (1,0) [0|0] "" Vector__XXX
 SG_ APP_sw328_ussS4Unavailable m328 : 19|1@1+ (1,0) [0|0] "" Vector__XXX
 SG_ APP_sw331_rRepeaterOccluded m331 : 19|1@1+ (1,0) [0|0] "" Vector__XXX
 SG_ APP_sw336_miaErr m336 : 19|1@1+ (1,0) [0|0] "" Vector__XXX
 SG_ APP_sw337_unusedBits m337 : 19|13@1+ (1,0) [0|0] "" Vector__XXX
 SG_ APP_sw341_phaShiftCalibDataInvalid m341 : 19|1@1+ (1,0) [0|0] "" Vector__XXX
 SG_ APP_sw346_imuTimeGap m346 : 19|1@1+ (1,0) [0|0] "" Vector__XXX
 SG_ APP_sw348_leftPillar m348 : 19|1@1+ (1,0) [0|0] "" Vector__XXX
 SG_ APP_sw349_leftPillar m349 : 19|1@1+ (1,0) [0|0] "" Vector__XXX
 SG_ APP_sw350_posPitchAngleInvalid m350 : 19|1@1+ (1,0) [0|0] "" Vector__XXX
 SG_ APP_sw357_disableByBuildCfg m357 : 19|1@1+ (1,0) [0|0] "" Vector__XXX
 SG_ APP_sw358_mainCameraStreamUnavailable m358 : 19|1@1+ (1,0) [0|0] "" Vector__XXX
 SG_ APP_sw373_breakError m373 : 19|1@1+ (1,0) [0|0] "" Vector__XXX
 SG_ APP_sw385_hwTimingOffsetError m385 : 19|1@1+ (1,0) [0|0] "" Vector__XXX
 SG_ APP_sw393_cabinCamMntrDisabled m393 : 19|1@1+ (1,0) [0|0] "" Vector__XXX
 SG_ APP_sw406_gnssRtcmChecksumErrors m406 : 19|1@1+ (1,0) [0|0] "" Vector__XXX
 SG_ APP_sw407_delivered m407 : 19|1@1+ (1,0) [0|0] "" Vector__XXX
 SG_ APP_sw408_controllerSolverDegraded m408 : 19|1@1+ (1,0) [0|0] "" Vector__XXX
 SG_ APP_sw409_wiperNotHealthy m409 : 19|1@1+ (1,0) [0|0] "" Vector__XXX
 SG_ APP_sw410_missionPlannerDesiredBehaviorNotE2e m410 : 19|1@1+ (1,0) [0|0] "" Vector__XXX
 SG_ APP_sw413_secondaryWasherFluidLow m413 : 19|1@1+ (1,0) [0|0] "" Vector__XXX
 SG_ APP_sw436_quad2DmaFifoOverflow m436 : 19|1@1+ (1,0) [0|0] "" Vector__XXX
 SG_ APP_sw437_leftPillar m437 : 19|1@1+ (1,0) [0|0] "" Vector__XXX
 SG_ APP_sw439_sgkBUnreachableViaEth0 m439 : 19|1@1+ (1,0) [0|0] "" Vector__XXX
 SG_ APP_sw004_radMia m4 : 20|1@1+ (1,0) [0|0] "" Vector__XXX
 SG_ APP_sw005_fullBlockage m5 : 20|1@1+ (1,0) [0|0] "" Vector__XXX
 SG_ APP_sw006_SunRay m6 : 20|1@1+ (1,0) [0|0] "" Vector__XXX
 SG_ APP_sw009_CameraStream_fault m9 : 20|1@1+ (1,0) [0|0] "" Vector__XXX
 SG_ APP_sw010_HorizontalMisalignment m10 : 20|16@1+ (0.00137332,-45) [0|0] "" Vector__XXX
 SG_ APP_sw011_scaRight m11 : 20|1@1+ (1,0) [0|0] "" Vector__XXX
 SG_ APP_sw015_LowSun m15 : 20|2@1+ (1,0) [0|0] "" Vector__XXX
 SG_ APP_sw017_Camera_Msg_Common_MIA m17 : 20|1@1+ (1,0) [0|0] "" Vector__XXX
 SG_ APP_sw022_recordId m22 : 20|12@1+ (1,0) [0|0] "" Vector__XXX
 SG_ APP_sw024_numVirtualLaneVeh m24 : 20|4@1+ (1,0) [0|0] "" Vector__XXX
 SG_ APP_sw025_road_class m25 : 20|3@1+ (1,0) [0|0] "" Vector__XXX
 SG_ APP_sw027_PLL_0_Failure m27 : 20|1@1+ (1,0) [0|0] "" Vector__XXX
 SG_ APP_sw028_inv_multifrm_next m28 : 20|1@1+ (1,0) [0|0] "" Vector__XXX
 SG_ APP_sw038_AutofixOutOfCalibYaw m38 : 20|1@1+ (1,0) [0|0] "" Vector__XXX
 SG_ APP_sw045_lrrPacketEnder m45 : 20|1@1+ (1,0) [0|0] "" Vector__XXX
 SG_ APP_sw047_roadClass m47 : 20|3@1+ (1,0) [0|0] "" Vector__XXX
 SG_ APP_sw048_checkStop m48 : 20|1@1+ (1,0) [0|0] "" Vector__XXX
 SG_ APP_sw051_a52radomeHtrInop m51 : 20|1@1+ (1,0) [0|0] "" Vector__XXX
 SG_ APP_sw052_underTemperature m52 : 20|1@1+ (1,0) [0|0] "" Vector__XXX
 SG_ APP_sw053_a14sccmMIA m53 : 20|1@1+ (1,0) [0|0] "" Vector__XXX
 SG_ APP_sw057_driverAssistMapData m57 : 20|1@1+ (1,0) [0|0] "" Vector__XXX
 SG_ APP_sw059_pscStatus m59 : 20|1@1+ (1,0) [0|0] "" Vector__XXX
 SG_ APP_sw069_parkMismatch m69 : 20|1@1+ (1,0) [0|0] "" Vector__XXX
 SG_ APP_sw071_endPosX m71 : 20|10@1+ (0.05,-25.6) [0|0] "" Vector__XXX
 SG_ APP_sw080_rad_tar_5_check m80 : 20|1@1+ (1,0) [0|0] "" Vector__XXX
 SG_ APP_sw133_mainCamSensorFault m133 : 20|3@1+ (1,0) [0|0] "" Vector__XXX
 SG_ APP_sw134_narrowCamSensorFault m134 : 20|3@1+ (1,0) [0|0] "" Vector__XXX
 SG_ APP_sw135_fisheyeCamSensorFault m135 : 20|3@1+ (1,0) [0|0] "" Vector__XXX
 SG_ APP_sw136_lPillarCamSensorFault m136 : 20|3@1+ (1,0) [0|0] "" Vector__XXX
 SG_ APP_sw137_rPillarCamSensorFault m137 : 20|3@1+ (1,0) [0|0] "" Vector__XXX
 SG_ APP_sw138_lRepeatCamSensorFault m138 : 20|3@1+ (1,0) [0|0] "" Vector__XXX
 SG_ APP_sw139_rRepeatCamSensorFault m139 : 20|3@1+ (1,0) [0|0] "" Vector__XXX
 SG_ APP_sw145_problemSaving m145 : 20|1@1+ (1,0) [0|0] "" Vector__XXX
 SG_ APP_sw147_selfieCamSensorFault m147 : 20|3@1+ (1,0) [0|0] "" Vector__XXX
 SG_ APP_sw150_locStatus2 m150 : 20|1@1+ (1,0) [0|0] "" Vector__XXX
 SG_ APP_sw158_LVHealth m158 : 20|1@1+ (1,0) [0|0] "" Vector__XXX
 SG_ APP_sw182_tempMonitorFailure m182 : 20|2@1+ (1,0) [0|0] "" Vector__XXX
 SG_ APP_sw183_tempMonitorFailure m183 : 20|2@1+ (1,0) [0|0] "" Vector__XXX
 SG_ APP_sw184_tempMonitorFailure m184 : 20|2@1+ (1,0) [0|0] "" Vector__XXX
 SG_ APP_sw185_tempMonitorFailure m185 : 20|2@1+ (1,0) [0|0] "" Vector__XXX
 SG_ APP_sw186_tempMonitorFailure m186 : 20|2@1+ (1,0) [0|0] "" Vector__XXX
 SG_ APP_sw187_tempMonitorFailure m187 : 20|2@1+ (1,0) [0|0] "" Vector__XXX
 SG_ APP_sw188_tempMonitorFailure m188 : 20|2@1+ (1,0) [0|0] "" Vector__XXX
 SG_ APP_sw189_tempMonitorFailure m189 : 20|2@1+ (1,0) [0|0] "" Vector__XXX
 SG_ APP_sw190_tempMonitorFailure m190 : 20|2@1+ (1,0) [0|0] "" Vector__XXX
 SG_ APP_sw193_partialBlockage m193 : 20|1@1+ (1,0) [0|0] "" Vector__XXX
 SG_ APP_sw195_s11Blocked m195 : 20|1@1+ (1,0) [0|0] "" Vector__XXX
 SG_ APP_sw200_autopilotRestricted m200 : 20|1@1+ (1,0) [0|0] "" Vector__XXX
 SG_ APP_sw202_s11Blocked m202 : 20|1@1+ (1,0) [0|0] "" Vector__XXX
 SG_ APP_sw203_curbType m203 : 20|2@1+ (1,0) [0|0] "" Vector__XXX
 SG_ APP_sw213_autopilotRestricted m213 : 20|1@1+ (1,0) [0|0] "" Vector__XXX
 SG_ APP_sw219_vehicleSpeed m219 : 20|12@1+ (0.05,-25) [0|0] "" Vector__XXX
 SG_ APP_sw220_vehicleSpeed m220 : 20|12@1+ (0.05,-25) [0|0] "" Vector__XXX
 SG_ APP_sw230_sensor5Blocked m230 : 20|1@1+ (1,0) [0|0] "" Vector__XXX
 SG_ APP_sw234_elkaObject m234 : 20|1@1+ (1,0) [0|0] "" Vector__XXX
 SG_ APP_sw259_do_aeb_brake_pedal m259 : 20|1@1+ (1,0) [0|0] "" Vector__XXX
 SG_ APP_sw263_outOfSpeedRegion m263 : 20|1@1+ (1,0) [0|0] "" Vector__XXX
 SG_ APP_sw265_surroundCameraStatus m265 : 20|2@1+ (1,0) [0|0] "" Vector__XXX
 SG_ APP_sw269_rPillarStreamExit m269 : 20|1@1+ (1,0) [0|0] "" Vector__XXX
 SG_ APP_sw270_rRepeaterStreamExit m270 : 20|1@1+ (1,0) [0|0] "" Vector__XXX
 SG_ APP_sw272_lPillarStreamExit m272 : 20|1@1+ (1,0) [0|0] "" Vector__XXX
 SG_ APP_sw273_side m273 : 20|1@1+ (1,0) [0|0] "" Vector__XXX
 SG_ APP_sw274_tempMonitorFailure m274 : 20|2@1+ (1,0) [0|0] "" Vector__XXX
 SG_ APP_sw275_tempMonitorFailure m275 : 20|2@1+ (1,0) [0|0] "" Vector__XXX
 SG_ APP_sw276_tempMonitorFailure m276 : 20|2@1+ (1,0) [0|0] "" Vector__XXX
 SG_ APP_sw277_tempMonitorFailure m277 : 20|2@1+ (1,0) [0|0] "" Vector__XXX
 SG_ APP_sw278_tempMonitorFailure m278 : 20|2@1+ (1,0) [0|0] "" Vector__XXX
 SG_ APP_sw279_tempMonitorFailure m279 : 20|2@1+ (1,0) [0|0] "" Vector__XXX
 SG_ APP_sw280_tempMonitorFailure m280 : 20|2@1+ (1,0) [0|0] "" Vector__XXX
 SG_ APP_sw281_tempMonitorFailure m281 : 20|2@1+ (1,0) [0|0] "" Vector__XXX
 SG_ APP_sw282_tempMonitorFailure m282 : 20|2@1+ (1,0) [0|0] "" Vector__XXX
 SG_ APP_sw285_fusionModeDisabled m285 : 20|1@1+ (1,0) [0|0] "" Vector__XXX
 SG_ APP_sw286_mcuNMEAmsgUDPinvalid m286 : 20|1@1+ (1,0) [0|0] "" Vector__XXX
 SG_ APP_sw304_lssMainBlocked m304 : 20|1@1+ (1,0) [0|0] "" Vector__XXX
 SG_ APP_sw306_lssUssS5Blocked m306 : 20|1@1+ (1,0) [0|0] "" Vector__XXX
 SG_ APP_sw312_sensorModelMismatch m312 : 20|1@1+ (1,0) [0|0] "" Vector__XXX
 SG_ APP_sw313_sensorModelMismatch m313 : 20|1@1+ (1,0) [0|0] "" Vector__XXX
 SG_ APP_sw314_sensorModelMismatch m314 : 20|1@1+ (1,0) [0|0] "" Vector__XXX
 SG_ APP_sw315_sensorModelMismatch m315 : 20|1@1+ (1,0) [0|0] "" Vector__XXX
 SG_ APP_sw316_sensorModelMismatch m316 : 20|1@1+ (1,0) [0|0] "" Vector__XXX
 SG_ APP_sw317_sensorModelMismatch m317 : 20|1@1+ (1,0) [0|0] "" Vector__XXX
 SG_ APP_sw318_sensorModelMismatch m318 : 20|1@1+ (1,0) [0|0] "" Vector__XXX
 SG_ APP_sw319_sensorModelMismatch m319 : 20|1@1+ (1,0) [0|0] "" Vector__XXX
 SG_ APP_sw320_sensorModelMismatch m320 : 20|1@1+ (1,0) [0|0] "" Vector__XXX
 SG_ APP_sw327_radarTypeMismatch m327 : 20|1@1+ (1,0) [0|0] "" Vector__XXX
 SG_ APP_sw328_ussS5Unavailable m328 : 20|1@1+ (1,0) [0|0] "" Vector__XXX
 SG_ APP_sw331_gpsDegraded m331 : 20|1@1+ (1,0) [0|0] "" Vector__XXX
 SG_ APP_sw341_adcCalibDataInvalid m341 : 20|1@1+ (1,0) [0|0] "" Vector__XXX
 SG_ APP_sw346_deadReckonLimitExceded m346 : 20|1@1+ (1,0) [0|0] "" Vector__XXX
 SG_ APP_sw348_rightPillar m348 : 20|1@1+ (1,0) [0|0] "" Vector__XXX
 SG_ APP_sw349_rightPillar m349 : 20|1@1+ (1,0) [0|0] "" Vector__XXX
 SG_ APP_sw350_posYawAngleInvalid m350 : 20|1@1+ (1,0) [0|0] "" Vector__XXX
 SG_ APP_sw357_invalidCameraFailsafe m357 : 20|1@1+ (1,0) [0|0] "" Vector__XXX
 SG_ APP_sw358_fisheyeCameraStreamUnavailable m358 : 20|1@1+ (1,0) [0|0] "" Vector__XXX
 SG_ APP_sw385_imuUnhealthy m385 : 20|1@1+ (1,0) [0|0] "" Vector__XXX
 SG_ APP_sw393_r79Region m393 : 20|1@1+ (1,0) [0|0] "" Vector__XXX
 SG_ APP_sw407_fsdDisabled m407 : 20|1@1+ (1,0) [0|0] "" Vector__XXX
 SG_ APP_sw408_controllerSolverCritical m408 : 20|1@1+ (1,0) [0|0] "" Vector__XXX
 SG_ APP_sw409_brakePedalPressed m409 : 20|1@1+ (1,0) [0|0] "" Vector__XXX
 SG_ APP_sw410_arbiterSelectedBehaviorNotE2e m410 : 20|1@1+ (1,0) [0|0] "" Vector__XXX
 SG_ APP_sw413_leftRepeaterAirCleanDegraded m413 : 20|1@1+ (1,0) [0|0] "" Vector__XXX
 SG_ APP_sw433_previousCameraIsAeroRibFromEeprom m433 : 20|1@1+ (1,0) [0|0] "" Vector__XXX
 SG_ APP_sw434_previousCameraIsAeroRibFromEeprom m434 : 20|1@1+ (1,0) [0|0] "" Vector__XXX
 SG_ APP_sw435_leftRepeaterAeroRibInfoMismatched m435 : 20|1@1+ (1,0) [0|0] "" Vector__XXX
 SG_ APP_sw436_quad3FatalError m436 : 20|1@1+ (1,0) [0|0] "" Vector__XXX
 SG_ APP_sw437_rightPillar m437 : 20|1@1+ (1,0) [0|0] "" Vector__XXX
 SG_ APP_sw439_mcuUnreachableViaEth0 m439 : 20|1@1+ (1,0) [0|0] "" Vector__XXX
 SG_ APP_sw443_detectedImagerModelNumber m443 : 20|4@1+ (1,0) [0|0] "" Vector__XXX
 SG_ APP_sw444_detectedImagerModelNumber m444 : 20|4@1+ (1,0) [0|0] "" Vector__XXX
 SG_ APP_sw445_detectedImagerModelNumber m445 : 20|4@1+ (1,0) [0|0] "" Vector__XXX
 SG_ APP_sw446_detectedImagerModelNumber m446 : 20|4@1+ (1,0) [0|0] "" Vector__XXX
 SG_ APP_sw447_detectedImagerModelNumber m447 : 20|4@1+ (1,0) [0|0] "" Vector__XXX
 SG_ APP_sw448_detectedImagerModelNumber m448 : 20|4@1+ (1,0) [0|0] "" Vector__XXX
 SG_ APP_sw449_detectedImagerModelNumber m449 : 20|4@1+ (1,0) [0|0] "" Vector__XXX
 SG_ APP_sw450_detectedImagerModelNumber m450 : 20|4@1+ (1,0) [0|0] "" Vector__XXX
 SG_ APP_sw451_detectedImagerModelNumber m451 : 20|4@1+ (1,0) [0|0] "" Vector__XXX
 SG_ APP_sw452_detectedImagerModelNumber m452 : 20|4@1+ (1,0) [0|0] "" Vector__XXX
 SG_ APP_sw004_radDynamicsError m4 : 21|1@1+ (1,0) [0|0] "" Vector__XXX
 SG_ APP_sw005_camObjHeader m5 : 21|1@1+ (1,0) [0|0] "" Vector__XXX
 SG_ APP_sw006_Splashes m6 : 21|1@1+ (1,0) [0|0] "" Vector__XXX
 SG_ APP_sw011_scaBlinker m11 : 21|2@1+ (1,0) [0|0] "" Vector__XXX
 SG_ APP_sw013_numEyeqResets m13 : 21|3@1+ (1,0) [0|0] "" Vector__XXX
 SG_ APP_sw017_Camera_Msg_FCW_PCW_MIA m17 : 21|1@1+ (1,0) [0|0] "" Vector__XXX
 SG_ APP_sw027_Clock_Monitor_0_Low m27 : 21|1@1+ (1,0) [0|0] "" Vector__XXX
 SG_ APP_sw028_unusedBits m28 : 21|11@1+ (1,0) [0|0] "" Vector__XXX
 SG_ APP_sw038_FullBlockage m38 : 21|1@1+ (1,0) [0|0] "" Vector__XXX
 SG_ APP_sw045_lrrRadarStatus m45 : 21|1@1+ (1,0) [0|0] "" Vector__XXX
 SG_ APP_sw048_ecuWatchdog m48 : 21|1@1+ (1,0) [0|0] "" Vector__XXX
 SG_ APP_sw051_unused m51 : 21|3@1+ (1,0) [0|0] "" Vector__XXX
 SG_ APP_sw052_chirpError m52 : 21|1@1+ (1,0) [0|0] "" Vector__XXX
 SG_ APP_sw053_a15adasMIA m53 : 21|1@1+ (1,0) [0|0] "" Vector__XXX
 SG_ APP_sw057_gpsVehicleSpeed m57 : 21|1@1+ (1,0) [0|0] "" Vector__XXX
 SG_ APP_sw059_pscVehSlot m59 : 21|1@1+ (1,0) [0|0] "" Vector__XXX
 SG_ APP_sw069_eacStatus m69 : 21|4@1+ (1,0) [0|0] "" Vector__XXX
 SG_ APP_sw073_rawMobileyeLDW m73 : 21|2@1+ (1,0) [0|0] "" Vector__XXX
 SG_ APP_sw080_ultrasonic_obs_check m80 : 21|1@1+ (1,0) [0|0] "" Vector__XXX
 SG_ APP_sw150_autonomyHealth m150 : 21|1@1+ (1,0) [0|0] "" Vector__XXX
 SG_ APP_sw158_sensors m158 : 21|1@1+ (1,0) [0|0] "" Vector__XXX
 SG_ APP_sw162_cameraPositionMismatch m162 : 21|1@1+ (1,0) [0|0] "" Vector__XXX
 SG_ APP_sw163_cameraPositionMismatch m163 : 21|1@1+ (1,0) [0|0] "" Vector__XXX
 SG_ APP_sw164_cameraPositionMismatch m164 : 21|1@1+ (1,0) [0|0] "" Vector__XXX
 SG_ APP_sw165_cameraPositionMismatch m165 : 21|1@1+ (1,0) [0|0] "" Vector__XXX
 SG_ APP_sw166_cameraPositionMismatch m166 : 21|1@1+ (1,0) [0|0] "" Vector__XXX
 SG_ APP_sw167_cameraPositionMismatch m167 : 21|1@1+ (1,0) [0|0] "" Vector__XXX
 SG_ APP_sw168_cameraPositionMismatch m168 : 21|1@1+ (1,0) [0|0] "" Vector__XXX
 SG_ APP_sw169_cameraPositionMismatch m169 : 21|1@1+ (1,0) [0|0] "" Vector__XXX
 SG_ APP_sw170_cameraPositionMismatch m170 : 21|1@1+ (1,0) [0|0] "" Vector__XXX
 SG_ APP_sw193_smearedHalos m193 : 21|1@1+ (1,0) [0|0] "" Vector__XXX
 SG_ APP_sw195_s12Blocked m195 : 21|1@1+ (1,0) [0|0] "" Vector__XXX
 SG_ APP_sw200_endSpeed m200 : 21|10@1+ (0.1,-10) [0|0] "" Vector__XXX
 SG_ APP_sw202_s12Blocked m202 : 21|1@1+ (1,0) [0|0] "" Vector__XXX
 SG_ APP_sw213_endSpeed m213 : 21|10@1+ (0.1,-10) [0|0] "" Vector__XXX
 SG_ APP_sw230_sensor6Blocked m230 : 21|1@1+ (1,0) [0|0] "" Vector__XXX
 SG_ APP_sw234_elkaRoadEdge m234 : 21|1@1+ (1,0) [0|0] "" Vector__XXX
 SG_ APP_sw259_do_stw_angle m259 : 21|1@1+ (1,0) [0|0] "" Vector__XXX
 SG_ APP_sw263_laneTooNarrow m263 : 21|1@1+ (1,0) [0|0] "" Vector__XXX
 SG_ APP_sw269_lRepeaterStreamExit m269 : 21|1@1+ (1,0) [0|0] "" Vector__XXX
 SG_ APP_sw270_lPillarBlocked m270 : 21|1@1+ (1,0) [0|0] "" Vector__XXX
 SG_ APP_sw271_direction m271 : 21|1@1+ (1,0) [0|0] "" Vector__XXX
 SG_ APP_sw272_rPillarStreamExit m272 : 21|1@1+ (1,0) [0|0] "" Vector__XXX
 SG_ APP_sw273_alarmStrikes m273 : 21|3@1+ (1,0) [0|0] "" Vector__XXX
 SG_ APP_sw283_apsAbortReason m283 : 21|6@1+ (1,0) [0|0] "" Vector__XXX
 SG_ APP_sw285_gpsCfgFail m285 : 21|1@1+ (1,0) [0|0] "" Vector__XXX
 SG_ APP_sw286_mcuDbgMsgInvalid m286 : 21|1@1+ (1,0) [0|0] "" Vector__XXX
 SG_ APP_sw306_lssUssS6Blocked m306 : 21|1@1+ (1,0) [0|0] "" Vector__XXX
 SG_ APP_sw327_chassisTypeMismatch m327 : 21|1@1+ (1,0) [0|0] "" Vector__XXX
 SG_ APP_sw328_ussS6Unavailable m328 : 21|1@1+ (1,0) [0|0] "" Vector__XXX
 SG_ APP_sw331_poorWeather m331 : 21|1@1+ (1,0) [0|0] "" Vector__XXX
 SG_ APP_sw341_misalignCalibIncomplete m341 : 21|1@1+ (1,0) [0|0] "" Vector__XXX
 SG_ APP_sw346_posnCovarLimitExceeded m346 : 21|1@1+ (1,0) [0|0] "" Vector__XXX
 SG_ APP_sw348_leftRepeater m348 : 21|1@1+ (1,0) [0|0] "" Vector__XXX
 SG_ APP_sw349_leftRepeater m349 : 21|1@1+ (1,0) [0|0] "" Vector__XXX
 SG_ APP_sw350_correctedRollAngle m350 : 21|9@1- (0.025,0) [0|0] "" Vector__XXX
 SG_ APP_sw357_invalidDrowsinessPredictions m357 : 21|1@1+ (1,0) [0|0] "" Vector__XXX
 SG_ APP_sw358_camCalibOutOfBounds m358 : 21|1@1+ (1,0) [0|0] "" Vector__XXX
 SG_ APP_sw393_cabinConditionsNotMet m393 : 21|1@1+ (1,0) [0|0] "" Vector__XXX
 SG_ APP_sw398_eskfReset m398 : 21|1@1+ (1,0) [0|0] "" Vector__XXX
 SG_ APP_sw407_outsideGeofence m407 : 21|1@1+ (1,0) [0|0] "" Vector__XXX
 SG_ APP_sw408_driverNotPresent m408 : 21|1@1+ (1,0) [0|0] "" Vector__XXX
 SG_ APP_sw409_rankerNotHealthy m409 : 21|1@1+ (1,0) [0|0] "" Vector__XXX
 SG_ APP_sw410_arbiterSelectedBehaviorOutOfDate m410 : 21|1@1+ (1,0) [0|0] "" Vector__XXX
 SG_ APP_sw413_rightRepeaterAirCleanDegraded m413 : 21|1@1+ (1,0) [0|0] "" Vector__XXX
 SG_ APP_sw433_previousCameraAeroRibInfoFromGtw m433 : 21|3@1+ (1,0) [0|0] "" Vector__XXX
 SG_ APP_sw434_previousCameraAeroRibInfoFromGtw m434 : 21|3@1+ (1,0) [0|0] "" Vector__XXX
 SG_ APP_sw435_rightRepeaterIsAeroRibFromEeprom m435 : 21|1@1+ (1,0) [0|0] "" Vector__XXX
 SG_ APP_sw436_quad3DmaFifoOverflow m436 : 21|1@1+ (1,0) [0|0] "" Vector__XXX
 SG_ APP_sw437_leftRepeater m437 : 21|1@1+ (1,0) [0|0] "" Vector__XXX
 SG_ APP_sw004_espMIA m4 : 22|1@1+ (1,0) [0|0] "" Vector__XXX
 SG_ APP_sw005_camCommonMsg m5 : 22|1@1+ (1,0) [0|0] "" Vector__XXX
 SG_ APP_sw006_BlurredImage m6 : 22|1@1+ (1,0) [0|0] "" Vector__XXX
 SG_ APP_sw015_BlurredImage m15 : 22|2@1+ (1,0) [0|0] "" Vector__XXX
 SG_ APP_sw017_Camera_Msg_TFL_MIA m17 : 22|1@1+ (1,0) [0|0] "" Vector__XXX
 SG_ APP_sw027_Clock_Monitor_0_Off m27 : 22|1@1+ (1,0) [0|0] "" Vector__XXX
 SG_ APP_sw038_TooManyResets m38 : 22|1@1+ (1,0) [0|0] "" Vector__XXX
 SG_ APP_sw045_lrrObj00A m45 : 22|1@1+ (1,0) [0|0] "" Vector__XXX
 SG_ APP_sw048_ecuReset m48 : 22|1@1+ (1,0) [0|0] "" Vector__XXX
 SG_ APP_sw052_rspError m52 : 22|1@1+ (1,0) [0|0] "" Vector__XXX
 SG_ APP_sw053_a16bdyInvalidCount m53 : 22|1@1+ (1,0) [0|0] "" Vector__XXX
 SG_ APP_sw057_radarMapData m57 : 22|1@1+ (1,0) [0|0] "" Vector__XXX
 SG_ APP_sw059_sdiFront m59 : 22|1@1+ (1,0) [0|0] "" Vector__XXX
 SG_ APP_sw080_freespace_check m80 : 22|1@1+ (1,0) [0|0] "" Vector__XXX
 SG_ APP_sw140_backupCamI2CbusFault m140 : 22|1@1+ (1,0) [0|0] "" Vector__XXX
 SG_ APP_sw146_numElementsQueued m146 : 22|9@1+ (10,0) [0|0] "" Vector__XXX
 SG_ APP_sw150_chassisControl2 m150 : 22|1@1+ (1,0) [0|0] "" Vector__XXX
 SG_ APP_sw158_coolant m158 : 22|1@1+ (1,0) [0|0] "" Vector__XXX
 SG_ APP_sw162_blacklistedFuseID m162 : 22|1@1+ (1,0) [0|0] "" Vector__XXX
 SG_ APP_sw163_blacklistedFuseID m163 : 22|1@1+ (1,0) [0|0] "" Vector__XXX
 SG_ APP_sw164_blacklistedFuseID m164 : 22|1@1+ (1,0) [0|0] "" Vector__XXX
 SG_ APP_sw165_blacklistedFuseID m165 : 22|1@1+ (1,0) [0|0] "" Vector__XXX
 SG_ APP_sw166_blacklistedFuseID m166 : 22|1@1+ (1,0) [0|0] "" Vector__XXX
 SG_ APP_sw167_blacklistedFuseID m167 : 22|1@1+ (1,0) [0|0] "" Vector__XXX
 SG_ APP_sw168_blacklistedFuseID m168 : 22|1@1+ (1,0) [0|0] "" Vector__XXX
 SG_ APP_sw169_blacklistedFuseID m169 : 22|1@1+ (1,0) [0|0] "" Vector__XXX
 SG_ APP_sw170_blacklistedFuseID m170 : 22|1@1+ (1,0) [0|0] "" Vector__XXX
 SG_ APP_sw182_firstFrameGrabFailure m182 : 22|1@1+ (1,0) [0|0] "" Vector__XXX
 SG_ APP_sw183_firstFrameGrabFailure m183 : 22|1@1+ (1,0) [0|0] "" Vector__XXX
 SG_ APP_sw184_firstFrameGrabFailure m184 : 22|1@1+ (1,0) [0|0] "" Vector__XXX
 SG_ APP_sw185_firstFrameGrabFailure m185 : 22|1@1+ (1,0) [0|0] "" Vector__XXX
 SG_ APP_sw186_firstFrameGrabFailure m186 : 22|1@1+ (1,0) [0|0] "" Vector__XXX
 SG_ APP_sw187_firstFrameGrabFailure m187 : 22|1@1+ (1,0) [0|0] "" Vector__XXX
 SG_ APP_sw188_firstFrameGrabFailure m188 : 22|1@1+ (1,0) [0|0] "" Vector__XXX
 SG_ APP_sw189_firstFrameGrabFailure m189 : 22|1@1+ (1,0) [0|0] "" Vector__XXX
 SG_ APP_sw190_firstFrameGrabFailure m190 : 22|1@1+ (1,0) [0|0] "" Vector__XXX
 SG_ APP_sw192_hardwareType m192 : 22|2@1+ (1,0) [0|0] "" Vector__XXX
 SG_ APP_sw193_smearedSpots m193 : 22|1@1+ (1,0) [0|0] "" Vector__XXX
 SG_ APP_sw194_leadDx m194 : 22|8@1+ (0.1,0) [0|0] "" Vector__XXX
 SG_ APP_sw199_abortCodePARK m199 : 22|5@1+ (1,0) [0|0] "" Vector__XXX
 SG_ APP_sw203_roadClass m203 : 22|3@1+ (1,0) [0|0] "" Vector__XXX
 SG_ APP_sw230_sensor7Blocked m230 : 22|1@1+ (1,0) [0|0] "" Vector__XXX
 SG_ APP_sw234_fcw m234 : 22|1@1+ (1,0) [0|0] "" Vector__XXX
 SG_ APP_sw259_do_stw_rate m259 : 22|1@1+ (1,0) [0|0] "" Vector__XXX
 SG_ APP_sw263_elkConditionsMet m263 : 22|1@1+ (1,0) [0|0] "" Vector__XXX
 SG_ APP_sw269_rRepeaterStreamExit m269 : 22|1@1+ (1,0) [0|0] "" Vector__XXX
 SG_ APP_sw270_rPillarBlocked m270 : 22|1@1+ (1,0) [0|0] "" Vector__XXX
 SG_ APP_sw272_lRepeaterStreamExit m272 : 22|1@1+ (1,0) [0|0] "" Vector__XXX
 SG_ APP_sw274_firstFrameGrabFailure m274 : 22|1@1+ (1,0) [0|0] "" Vector__XXX
 SG_ APP_sw275_firstFrameGrabFailure m275 : 22|1@1+ (1,0) [0|0] "" Vector__XXX
 SG_ APP_sw276_firstFrameGrabFailure m276 : 22|1@1+ (1,0) [0|0] "" Vector__XXX
 SG_ APP_sw277_firstFrameGrabFailure m277 : 22|1@1+ (1,0) [0|0] "" Vector__XXX
 SG_ APP_sw278_firstFrameGrabFailure m278 : 22|1@1+ (1,0) [0|0] "" Vector__XXX
 SG_ APP_sw279_firstFrameGrabFailure m279 : 22|1@1+ (1,0) [0|0] "" Vector__XXX
 SG_ APP_sw280_firstFrameGrabFailure m280 : 22|1@1+ (1,0) [0|0] "" Vector__XXX
 SG_ APP_sw281_firstFrameGrabFailure m281 : 22|1@1+ (1,0) [0|0] "" Vector__XXX
 SG_ APP_sw282_firstFrameGrabFailure m282 : 22|1@1+ (1,0) [0|0] "" Vector__XXX
 SG_ APP_sw285_esfStatusMsgMIA m285 : 22|1@1+ (1,0) [0|0] "" Vector__XXX
 SG_ APP_sw286_mcuDbgMsgTooBig m286 : 22|1@1+ (1,0) [0|0] "" Vector__XXX
 SG_ APP_sw306_lssUssS7Blocked m306 : 22|1@1+ (1,0) [0|0] "" Vector__XXX
 SG_ APP_sw327_displayTypeMismatch m327 : 22|1@1+ (1,0) [0|0] "" Vector__XXX
 SG_ APP_sw328_ussS7Unavailable m328 : 22|1@1+ (1,0) [0|0] "" Vector__XXX
 SG_ APP_sw331_invalidMap m331 : 22|1@1+ (1,0) [0|0] "" Vector__XXX
 SG_ APP_sw341_runtimeCalibDataInvalid m341 : 22|1@1+ (1,0) [0|0] "" Vector__XXX
 SG_ APP_sw346_gnssDisagreeLmtExceded m346 : 22|1@1+ (1,0) [0|0] "" Vector__XXX
 SG_ APP_sw348_rightRepeater m348 : 22|1@1+ (1,0) [0|0] "" Vector__XXX
 SG_ APP_sw349_rightRepeater m349 : 22|1@1+ (1,0) [0|0] "" Vector__XXX
 SG_ APP_sw357_invalidSccmSteeringAngle m357 : 22|1@1+ (1,0) [0|0] "" Vector__XXX
 SG_ APP_sw393_fsdNotEnabled m393 : 22|1@1+ (1,0) [0|0] "" Vector__XXX
 SG_ APP_sw407_driverlessGtwConfigOff m407 : 22|1@1+ (1,0) [0|0] "" Vector__XXX
 SG_ APP_sw408_driverMonitorStrikeout m408 : 22|1@1+ (1,0) [0|0] "" Vector__XXX
 SG_ APP_sw409_redundantBrakePathActive m409 : 22|1@1+ (1,0) [0|0] "" Vector__XXX
 SG_ APP_sw410_peerVisionFailoverActive m410 : 22|1@1+ (1,0) [0|0] "" Vector__XXX
 SG_ APP_sw413_backupAirCleanDegraded m413 : 22|1@1+ (1,0) [0|0] "" Vector__XXX
 SG_ APP_sw437_rightRepeater m437 : 22|1@1+ (1,0) [0|0] "" Vector__XXX
 SG_ APP_sw005_camFcwPcwMsg m5 : 23|1@1+ (1,0) [0|0] "" Vector__XXX
 SG_ APP_sw006_LowSun m6 : 23|1@1+ (1,0) [0|0] "" Vector__XXX
 SG_ APP_sw011_scaThreshold m11 : 23|1@1+ (1,0) [0|0] "" Vector__XXX
 SG_ APP_sw017_Any_Lanes_Msg_Recd m17 : 23|1@1+ (1,0) [0|0] "" Vector__XXX
 SG_ APP_sw025_road_match m25 : 23|1@1+ (1,0) [0|0] "" Vector__XXX
 SG_ APP_sw027_LVD_4v5 m27 : 23|1@1+ (1,0) [0|0] "" Vector__XXX
 SG_ APP_sw047_controlledAccess m47 : 23|1@1+ (1,0) [0|0] "" Vector__XXX
 SG_ APP_sw048_radcVersionMismatch m48 : 23|1@1+ (1,0) [0|0] "" Vector__XXX
 SG_ APP_sw052_sensorBlocked m52 : 23|1@1+ (1,0) [0|0] "" Vector__XXX
 SG_ APP_sw053_a17adasInvalidCount m53 : 23|1@1+ (1,0) [0|0] "" Vector__XXX
 SG_ APP_sw057_csaRoadCurv m57 : 23|1@1+ (1,0) [0|0] "" Vector__XXX
 SG_ APP_sw059_sdiRear m59 : 23|1@1+ (1,0) [0|0] "" Vector__XXX
 SG_ APP_sw080_pedestrian_check m80 : 23|1@1+ (1,0) [0|0] "" Vector__XXX
 SG_ APP_sw162_uuidMismatch m162 : 23|1@1+ (1,0) [0|0] "" Vector__XXX
 SG_ APP_sw163_uuidMismatch m163 : 23|1@1+ (1,0) [0|0] "" Vector__XXX
 SG_ APP_sw164_uuidMismatch m164 : 23|1@1+ (1,0) [0|0] "" Vector__XXX
 SG_ APP_sw165_uuidMismatch m165 : 23|1@1+ (1,0) [0|0] "" Vector__XXX
 SG_ APP_sw166_uuidMismatch m166 : 23|1@1+ (1,0) [0|0] "" Vector__XXX
 SG_ APP_sw167_uuidMismatch m167 : 23|1@1+ (1,0) [0|0] "" Vector__XXX
 SG_ APP_sw168_uuidMismatch m168 : 23|1@1+ (1,0) [0|0] "" Vector__XXX
 SG_ APP_sw169_uuidMismatch m169 : 23|1@1+ (1,0) [0|0] "" Vector__XXX
 SG_ APP_sw170_uuidMismatch m170 : 23|1@1+ (1,0) [0|0] "" Vector__XXX
 SG_ APP_sw182_deserParityError m182 : 23|1@1+ (1,0) [0|0] "" Vector__XXX
 SG_ APP_sw183_deserParityError m183 : 23|1@1+ (1,0) [0|0] "" Vector__XXX
 SG_ APP_sw184_deserParityError m184 : 23|1@1+ (1,0) [0|0] "" Vector__XXX
 SG_ APP_sw185_deserParityError m185 : 23|1@1+ (1,0) [0|0] "" Vector__XXX
 SG_ APP_sw186_deserParityError m186 : 23|1@1+ (1,0) [0|0] "" Vector__XXX
 SG_ APP_sw187_deserParityError m187 : 23|1@1+ (1,0) [0|0] "" Vector__XXX
 SG_ APP_sw188_deserParityError m188 : 23|1@1+ (1,0) [0|0] "" Vector__XXX
 SG_ APP_sw189_deserParityError m189 : 23|1@1+ (1,0) [0|0] "" Vector__XXX
 SG_ APP_sw190_deserParityError m190 : 23|1@1+ (1,0) [0|0] "" Vector__XXX
 SG_ APP_sw230_sensor8Blocked m230 : 23|1@1+ (1,0) [0|0] "" Vector__XXX
 SG_ APP_sw234_ldw m234 : 23|1@1+ (1,0) [0|0] "" Vector__XXX
 SG_ APP_sw259_max_dv_reached m259 : 23|1@1+ (1,0) [0|0] "" Vector__XXX
 SG_ APP_sw263_lkaConditionsMet m263 : 23|1@1+ (1,0) [0|0] "" Vector__XXX
 SG_ APP_sw269_mainBlocked m269 : 23|1@1+ (1,0) [0|0] "" Vector__XXX
 SG_ APP_sw270_lRepeaterBlocked m270 : 23|1@1+ (1,0) [0|0] "" Vector__XXX
 SG_ APP_sw272_rRepeaterStreamExit m272 : 23|1@1+ (1,0) [0|0] "" Vector__XXX
 SG_ APP_sw274_deserParityError m274 : 23|1@1+ (1,0) [0|0] "" Vector__XXX
 SG_ APP_sw275_deserParityError m275 : 23|1@1+ (1,0) [0|0] "" Vector__XXX
 SG_ APP_sw276_deserParityError m276 : 23|1@1+ (1,0) [0|0] "" Vector__XXX
 SG_ APP_sw277_deserParityError m277 : 23|1@1+ (1,0) [0|0] "" Vector__XXX
 SG_ APP_sw278_deserParityError m278 : 23|1@1+ (1,0) [0|0] "" Vector__XXX
 SG_ APP_sw279_deserParityError m279 : 23|1@1+ (1,0) [0|0] "" Vector__XXX
 SG_ APP_sw280_deserParityError m280 : 23|1@1+ (1,0) [0|0] "" Vector__XXX
 SG_ APP_sw281_deserParityError m281 : 23|1@1+ (1,0) [0|0] "" Vector__XXX
 SG_ APP_sw282_deserParityError m282 : 23|1@1+ (1,0) [0|0] "" Vector__XXX
 SG_ APP_sw285_wheelTickCfgMissmatch m285 : 23|1@1+ (1,0) [0|0] "" Vector__XXX
 SG_ APP_sw286_mcuFwdNMEAfail m286 : 23|1@1+ (1,0) [0|0] "" Vector__XXX
 SG_ APP_sw306_lssUssS8Blocked m306 : 23|1@1+ (1,0) [0|0] "" Vector__XXX
 SG_ APP_sw327_cameraTypeMismatch m327 : 23|1@1+ (1,0) [0|0] "" Vector__XXX
 SG_ APP_sw328_ussS8Unavailable m328 : 23|1@1+ (1,0) [0|0] "" Vector__XXX
 SG_ APP_sw331_adverseRoadConditions m331 : 23|1@1+ (1,0) [0|0] "" Vector__XXX
 SG_ APP_sw341_validationInvalidTxRxGain m341 : 23|1@1+ (1,0) [0|0] "" Vector__XXX
 SG_ APP_sw346_wheelTickCalibrated m346 : 23|1@1+ (1,0) [0|0] "" Vector__XXX
 SG_ APP_sw348_backup m348 : 23|1@1+ (1,0) [0|0] "" Vector__XXX
 SG_ APP_sw349_backup m349 : 23|1@1+ (1,0) [0|0] "" Vector__XXX
 SG_ APP_sw357_invalidSccmSteeringAngleRate m357 : 23|1@1+ (1,0) [0|0] "" Vector__XXX
 SG_ APP_sw393_sunglassesDistracted m393 : 23|1@1+ (1,0) [0|0] "" Vector__XXX
 SG_ APP_sw407_sentryActive m407 : 23|1@1+ (1,0) [0|0] "" Vector__XXX
 SG_ APP_sw408_passengerExpected m408 : 23|1@1+ (1,0) [0|0] "" Vector__XXX
 SG_ APP_sw409_redundantBrakesNotReady m409 : 23|1@1+ (1,0) [0|0] "" Vector__XXX
 SG_ APP_sw410_apsAUnhealthy m410 : 23|1@1+ (1,0) [0|0] "" Vector__XXX
 SG_ APP_sw413_fasciaAirCleanDegraded m413 : 23|1@1+ (1,0) [0|0] "" Vector__XXX
 SG_ APP_sw437_backup m437 : 23|1@1+ (1,0) [0|0] "" Vector__XXX
 SG_ APP_sw004_accState m4 : 24|4@1+ (1,0) [0|0] "" Vector__XXX
 SG_ APP_sw005_radHWFailure m5 : 24|1@1+ (1,0) [0|0] "" Vector__XXX
 SG_ APP_sw006_SmearedSpots m6 : 24|1@1+ (1,0) [0|0] "" Vector__XXX
 SG_ APP_sw011_scaSpeed m11 : 24|7@1+ (1,0) [0|0] "" Vector__XXX
 SG_ APP_sw013_numCrcErrors m13 : 24|8@1+ (1,0) [0|0] "" Vector__XXX
 SG_ APP_sw015_FullBlockage m15 : 24|2@1+ (1,0) [0|0] "" Vector__XXX
 SG_ APP_sw017_Any_Objects_Msg_Recd m17 : 24|1@1+ (1,0) [0|0] "" Vector__XXX
 SG_ APP_sw019_numFreeBytes m19 : 24|8@1+ (1,-191) [0|0] "" Vector__XXX
 SG_ APP_sw021_minThreshold m21 : 24|8@1- (1,0) [0|0] "" Vector__XXX
 SG_ APP_sw024_currentVehicleApp m24 : 24|8@1+ (1,0) [0|0] "" Vector__XXX
 SG_ APP_sw025_controlled_access m25 : 24|1@1+ (1,0) [0|0] "" Vector__XXX
 SG_ APP_sw027_Flash_Fatal_Error m27 : 24|1@1+ (1,0) [0|0] "" Vector__XXX
 SG_ APP_sw030_unusedByte m30 : 24|8@1+ (1,0) [0|0] "" Vector__XXX
 SG_ APP_sw031_errorType m31 : 24|8@1+ (1,0) [0|0] "" Vector__XXX
 SG_ APP_sw032_errorType m32 : 24|8@1+ (1,0) [0|0] "" Vector__XXX
 SG_ APP_sw034_unusedByte m34 : 24|8@1+ (1,0) [0|0] "" Vector__XXX
 SG_ APP_sw036_unusedByte m36 : 24|8@1+ (1,0) [0|0] "" Vector__XXX
 SG_ APP_sw037_issue m37 : 24|8@1+ (1,0) [0|0] "" Vector__XXX
 SG_ APP_sw039_unusedByte m39 : 24|8@1+ (1,0) [0|0] "" Vector__XXX
 SG_ APP_sw040_ego_veh_speed m40 : 24|8@1+ (0.2,0) [0|0] "" Vector__XXX
 SG_ APP_sw042_view_range m42 : 24|8@1+ (1,0) [0|0] "" Vector__XXX
 SG_ APP_sw044_appStatus m44 : 24|4@1+ (1,0) [0|0] "" Vector__XXX
 SG_ APP_sw047_edrType m47 : 24|6@1+ (1,0) [0|0] "" Vector__XXX
 SG_ APP_sw048_radcCalibration m48 : 24|1@1+ (1,0) [0|0] "" Vector__XXX
 SG_ APP_sw051_SCUTemperature m51 : 24|8@1- (1,0) [0|0] "" Vector__XXX
 SG_ APP_sw053_a18espInvalidCount m53 : 24|1@1+ (1,0) [0|0] "" Vector__XXX
 SG_ APP_sw054_Autofix_horizon m54 : 24|8@1+ (1,0) [0|0] "" Vector__XXX
 SG_ APP_sw056_unusedByte m56 : 24|8@1+ (1,0) [0|0] "" Vector__XXX
 SG_ APP_sw057_telemetryControl m57 : 24|1@1+ (1,0) [0|0] "" Vector__XXX
 SG_ APP_sw058_unusedByte m58 : 24|8@1+ (1,0) [0|0] "" Vector__XXX
 SG_ APP_sw059_sensorStatusFront m59 : 24|1@1+ (1,0) [0|0] "" Vector__XXX
 SG_ APP_sw063_detectedMajorVer m63 : 24|8@1+ (1,0) [0|0] "" Vector__XXX
 SG_ APP_sw065_mobileye_main_state m65 : 24|8@1+ (1,0) [0|0] "" Vector__XXX
 SG_ APP_sw066_mobileye_main_state m66 : 24|8@1+ (1,0) [0|0] "" Vector__XXX
 SG_ APP_sw070_diGear m70 : 24|3@1+ (1,0) [0|0] "" Vector__XXX
 SG_ APP_sw073_freespaceLDW m73 : 24|2@1+ (1,0) [0|0] "" Vector__XXX
 SG_ APP_sw074_ipsoDy m74 : 24|6@1+ (0.1,-3.2) [0|0] "" Vector__XXX
 SG_ APP_sw075_unusedByte m75 : 24|8@1+ (1,0) [0|0] "" Vector__XXX
 SG_ APP_sw078_ttc m78 : 24|8@1+ (0.02,0) [0|0] "" Vector__XXX
 SG_ APP_sw080_rad_tar_5_dist m80 : 24|6@1+ (1,0) [0|0] "" Vector__XXX
 SG_ APP_sw081_radarTTC m81 : 24|8@1+ (0.02,0) [0|0] "" Vector__XXX
 SG_ APP_sw082_R_VL m82 : 24|8@1+ (0.05,-6.4) [0|0] "" Vector__XXX
 SG_ APP_sw084_ipsoRCS m84 : 24|8@1+ (1,0) [0|0] "" Vector__XXX
 SG_ APP_sw085_radarTTC m85 : 24|8@1+ (0.02,0) [0|0] "" Vector__XXX
 SG_ APP_sw086_distanceEllipse m86 : 24|8@1+ (0.5,0) [0|0] "" Vector__XXX
 SG_ APP_sw103_objectRCS m103 : 24|8@1+ (1,0) [0|0] "" Vector__XXX
 SG_ APP_sw133_mainCamSerFault m133 : 24|3@1+ (1,0) [0|0] "" Vector__XXX
 SG_ APP_sw134_narrowCamSerFault m134 : 24|3@1+ (1,0) [0|0] "" Vector__XXX
 SG_ APP_sw135_fisheyeCamSerFault m135 : 24|3@1+ (1,0) [0|0] "" Vector__XXX
 SG_ APP_sw136_lPillarCamSerFault m136 : 24|3@1+ (1,0) [0|0] "" Vector__XXX
 SG_ APP_sw137_rPillarCamSerFault m137 : 24|3@1+ (1,0) [0|0] "" Vector__XXX
 SG_ APP_sw138_lRepeatCamSerFault m138 : 24|3@1+ (1,0) [0|0] "" Vector__XXX
 SG_ APP_sw139_rRepeatCamSerFault m139 : 24|3@1+ (1,0) [0|0] "" Vector__XXX
 SG_ APP_sw140_backupCamSensorFault m140 : 24|3@1+ (1,0) [0|0] "" Vector__XXX
 SG_ APP_sw141_minThreshold m141 : 24|8@1- (1,0) [0|0] "" Vector__XXX
 SG_ APP_sw145_problemCamPosition m145 : 24|4@1+ (1,0) [0|0] "" Vector__XXX
 SG_ APP_sw147_selfieCamSerFault m147 : 24|3@1+ (1,0) [0|0] "" Vector__XXX
 SG_ APP_sw149_diskUsageHome m149 : 24|8@1+ (1,0) [0|0] "" Vector__XXX
 SG_ APP_sw162_detectedPosition m162 : 24|4@1+ (1,0) [0|0] "" Vector__XXX
 SG_ APP_sw163_detectedPosition m163 : 24|4@1+ (1,0) [0|0] "" Vector__XXX
 SG_ APP_sw164_detectedPosition m164 : 24|4@1+ (1,0) [0|0] "" Vector__XXX
 SG_ APP_sw165_detectedPosition m165 : 24|4@1+ (1,0) [0|0] "" Vector__XXX
 SG_ APP_sw166_detectedPosition m166 : 24|4@1+ (1,0) [0|0] "" Vector__XXX
 SG_ APP_sw167_detectedPosition m167 : 24|4@1+ (1,0) [0|0] "" Vector__XXX
 SG_ APP_sw168_detectedPosition m168 : 24|4@1+ (1,0) [0|0] "" Vector__XXX
 SG_ APP_sw169_detectedPosition m169 : 24|4@1+ (1,0) [0|0] "" Vector__XXX
 SG_ APP_sw170_detectedPosition m170 : 24|4@1+ (1,0) [0|0] "" Vector__XXX
 SG_ APP_sw171_APP_parkerBTemp m171 : 24|8@1+ (1,-128) [0|0] "" Vector__XXX
 SG_ APP_sw182_deserLockError m182 : 24|1@1+ (1,0) [0|0] "" Vector__XXX
 SG_ APP_sw183_deserLockError m183 : 24|1@1+ (1,0) [0|0] "" Vector__XXX
 SG_ APP_sw184_deserLockError m184 : 24|1@1+ (1,0) [0|0] "" Vector__XXX
 SG_ APP_sw185_deserLockError m185 : 24|1@1+ (1,0) [0|0] "" Vector__XXX
 SG_ APP_sw186_deserLockError m186 : 24|1@1+ (1,0) [0|0] "" Vector__XXX
 SG_ APP_sw187_deserLockError m187 : 24|1@1+ (1,0) [0|0] "" Vector__XXX
 SG_ APP_sw188_deserLockError m188 : 24|1@1+ (1,0) [0|0] "" Vector__XXX
 SG_ APP_sw189_deserLockError m189 : 24|1@1+ (1,0) [0|0] "" Vector__XXX
 SG_ APP_sw190_deserLockError m190 : 24|1@1+ (1,0) [0|0] "" Vector__XXX
 SG_ APP_sw191_handsOnState m191 : 24|4@1+ (1,0) [0|0] "" Vector__XXX
 SG_ APP_sw195_sdiFrontCC m195 : 24|5@1+ (1,0) [0|0] "" Vector__XXX
 SG_ APP_sw201_stwAngleReq m201 : 24|8@1- (1,0) [0|0] "" Vector__XXX
 SG_ APP_sw202_sdiFrontCC m202 : 24|5@1+ (1,0) [0|0] "" Vector__XXX
 SG_ APP_sw204_frLeftMiddle m204 : 24|8@1+ (1,0) [0|0] "" Vector__XXX
 SG_ APP_sw205_rrLeft m205 : 24|8@1+ (1,0) [0|0] "" Vector__XXX
 SG_ APP_sw207_eyeq3MainState m207 : 24|8@1+ (1,0) [0|0] "" Vector__XXX
 SG_ APP_sw218_drivingOnHighway m218 : 24|1@1+ (1,0) [0|0] "" Vector__XXX
 SG_ APP_sw230_sensor9Blocked m230 : 24|1@1+ (1,0) [0|0] "" Vector__XXX
 SG_ APP_sw234_lka m234 : 24|1@1+ (1,0) [0|0] "" Vector__XXX
 SG_ APP_sw257_target_vx m257 : 24|8@1+ (0.2,-51) [0|0] "" Vector__XXX
 SG_ APP_sw258_target_vx m258 : 24|8@1+ (0.2,-51) [0|0] "" Vector__XXX
 SG_ APP_sw259_ego_speed m259 : 24|8@1+ (0.2,0) [0|0] "" Vector__XXX
 SG_ APP_sw260_target_vx m260 : 24|8@1+ (0.2,-51) [0|0] "" Vector__XXX
 SG_ APP_sw261_nonFatalUncorrErrors m261 : 24|8@1+ (1,0) [0|0] "" Vector__XXX
 SG_ APP_sw263_ldwConditionsMet m263 : 24|1@1+ (1,0) [0|0] "" Vector__XXX
 SG_ APP_sw265_unavailableReason m265 : 24|5@1+ (1,0) [0|0] "" Vector__XXX
 SG_ APP_sw266_lRepeaterStreamStatus m266 : 24|3@1+ (1,0) [0|0] "" Vector__XXX
 SG_ APP_sw269_narrowBlocked m269 : 24|1@1+ (1,0) [0|0] "" Vector__XXX
 SG_ APP_sw270_rRepeaterBlocked m270 : 24|1@1+ (1,0) [0|0] "" Vector__XXX
 SG_ APP_sw271_progress m271 : 24|8@1+ (0.0039215,0) [0|0] "" Vector__XXX
 SG_ APP_sw272_lPillarBlocked m272 : 24|1@1+ (1,0) [0|0] "" Vector__XXX
 SG_ APP_sw273_handsOn m273 : 24|1@1+ (1,0) [0|0] "" Vector__XXX
 SG_ APP_sw274_deserLockError m274 : 24|1@1+ (1,0) [0|0] "" Vector__XXX
 SG_ APP_sw275_deserLockError m275 : 24|1@1+ (1,0) [0|0] "" Vector__XXX
 SG_ APP_sw276_deserLockError m276 : 24|1@1+ (1,0) [0|0] "" Vector__XXX
 SG_ APP_sw277_deserLockError m277 : 24|1@1+ (1,0) [0|0] "" Vector__XXX
 SG_ APP_sw278_deserLockError m278 : 24|1@1+ (1,0) [0|0] "" Vector__XXX
 SG_ APP_sw279_deserLockError m279 : 24|1@1+ (1,0) [0|0] "" Vector__XXX
 SG_ APP_sw280_deserLockError m280 : 24|1@1+ (1,0) [0|0] "" Vector__XXX
 SG_ APP_sw281_deserLockError m281 : 24|1@1+ (1,0) [0|0] "" Vector__XXX
 SG_ APP_sw282_deserLockError m282 : 24|1@1+ (1,0) [0|0] "" Vector__XXX
 SG_ APP_sw285_exitTransportMode m285 : 24|1@1+ (1,0) [0|0] "" Vector__XXX
 SG_ APP_sw286_NMEAinvalidChecksum m286 : 24|1@1+ (1,0) [0|0] "" Vector__XXX
 SG_ APP_sw288_ego_speed m288 : 24|8@1+ (0.2,0) [0|0] "" Vector__XXX
 SG_ APP_sw291_ego_speed m291 : 24|8@1+ (0.2,0) [0|0] "" Vector__XXX
 SG_ APP_sw306_lssUssS9Blocked m306 : 24|1@1+ (1,0) [0|0] "" Vector__XXX
 SG_ APP_sw323_distance m323 : 24|8@1+ (0.5,0) [0|0] "" Vector__XXX
 SG_ APP_sw325_issue m325 : 24|6@1+ (1,0) [0|0] "" Vector__XXX
 SG_ APP_sw327_parkAssistTypeMismatch m327 : 24|1@1+ (1,0) [0|0] "" Vector__XXX
 SG_ APP_sw328_ussS9Unavailable m328 : 24|1@1+ (1,0) [0|0] "" Vector__XXX
 SG_ APP_sw329_leftLaneReqAccel m329 : 24|7@1+ (0.15625,-10) [0|0] "" Vector__XXX
 SG_ APP_sw341_validationInvalidRngVelCal m341 : 24|1@1+ (1,0) [0|0] "" Vector__XXX
 SG_ APP_sw346_speedScaleCalibrated m346 : 24|1@1+ (1,0) [0|0] "" Vector__XXX
 SG_ APP_sw348_selfie m348 : 24|1@1+ (1,0) [0|0] "" Vector__XXX
 SG_ APP_sw349_selfie m349 : 24|1@1+ (1,0) [0|0] "" Vector__XXX
 SG_ APP_sw355_quad1FailureRate m355 : 24|8@1+ (0.39215686274509803,0) [0|0] "" Vector__XXX
 SG_ APP_sw357_noVisionOutput m357 : 24|1@1+ (1,0) [0|0] "" Vector__XXX
 SG_ APP_sw386_cipvDx m386 : 24|8@1+ (1,0) [0|0] "" Vector__XXX
 SG_ APP_sw387_avgPretrackerObjCount m387 : 24|6@1+ (1,0) [0|0] "" Vector__XXX
 SG_ APP_sw393_platformNotSupported m393 : 24|1@1+ (1,0) [0|0] "" Vector__XXX
 SG_ APP_sw398_eskfResetReason m398 : 24|4@1+ (1,0) [0|0] "" Vector__XXX
 SG_ APP_sw407_apPowerRequestNotNominal m407 : 24|1@1+ (1,0) [0|0] "" Vector__XXX
 SG_ APP_sw408_rideshareIngressNoNavRoute m408 : 24|1@1+ (1,0) [0|0] "" Vector__XXX
 SG_ APP_sw409_redundantBrakesNotArmed m409 : 24|1@1+ (1,0) [0|0] "" Vector__XXX
 SG_ APP_sw410_apsBUnhealthy m410 : 24|1@1+ (1,0) [0|0] "" Vector__XXX
 SG_ APP_sw413_leftRepeaterFluidCleanDegraded m413 : 24|1@1+ (1,0) [0|0] "" Vector__XXX
 SG_ APP_sw435_rightRepeaterAeroRibInfoFromGTW m435 : 24|3@1+ (1,0) [0|0] "" Vector__XXX
 SG_ APP_sw437_selfie m437 : 24|1@1+ (1,0) [0|0] "" Vector__XXX
 SG_ APP_sw005_radSensorBlind m5 : 25|1@1+ (1,0) [0|0] "" Vector__XXX
 SG_ APP_sw006_PartialBlockage m6 : 25|1@1+ (1,0) [0|0] "" Vector__XXX
 SG_ APP_sw016_targetRelSpeed m16 : 25|9@1+ (0.0625,-31) [0|0] "" Vector__XXX
 SG_ APP_sw017_Any_TFL_Msg_Recd m17 : 25|1@1+ (1,0) [0|0] "" Vector__XXX
 SG_ APP_sw025_leftLaneUsage m25 : 25|2@1+ (1,0) [0|0] "" Vector__XXX
 SG_ APP_sw027_PLL_1_Failure m27 : 25|1@1+ (1,0) [0|0] "" Vector__XXX
 SG_ APP_sw048_radcMia m48 : 25|1@1+ (1,0) [0|0] "" Vector__XXX
 SG_ APP_sw050_targetRelSpeed m50 : 25|9@1+ (0.0625,-31) [0|0] "" Vector__XXX
 SG_ APP_sw053_a19sccmInvalidCount m53 : 25|1@1+ (1,0) [0|0] "" Vector__XXX
 SG_ APP_sw057_chassisControl m57 : 25|1@1+ (1,0) [0|0] "" Vector__XXX
 SG_ APP_sw059_sensorStatusRear m59 : 25|1@1+ (1,0) [0|0] "" Vector__XXX
 SG_ APP_sw060_targetRelSpeed m60 : 25|9@1+ (0.0625,-31) [0|0] "" Vector__XXX
 SG_ APP_sw069_diAPState m69 : 25|4@1+ (1,0) [0|0] "" Vector__XXX
 SG_ APP_sw076_targetRelSpeed m76 : 25|9@1+ (0.0625,-31) [0|0] "" Vector__XXX
 SG_ APP_sw077_oocConfidence m77 : 25|7@1+ (1,0) [0|0] "" Vector__XXX
 SG_ APP_sw131_mainCamExtRollCal m131 : 25|9@1- (0.05,0) [0|0] "" Vector__XXX
 SG_ APP_sw132_narrowCamExtRollCal m132 : 25|9@1- (0.05,0) [0|0] "" Vector__XXX
 SG_ APP_sw142_pitchOffsetAtmptVal m142 : 25|9@1+ (1,-256) [0|0] "" Vector__XXX
 SG_ APP_sw143_predImpactVelocity m143 : 25|7@1+ (0.5,0) [0|0] "" Vector__XXX
 SG_ APP_sw177_fisheyeCamExtRollCal m177 : 25|9@1- (0.05,0) [0|0] "" Vector__XXX
 SG_ APP_sw178_lPillarCamExtRollCal m178 : 25|9@1- (0.05,0) [0|0] "" Vector__XXX
 SG_ APP_sw179_rPillarCamExtRollCal m179 : 25|9@1- (0.05,0) [0|0] "" Vector__XXX
 SG_ APP_sw180_lRepeatCamExtRollCal m180 : 25|9@1- (0.05,0) [0|0] "" Vector__XXX
 SG_ APP_sw181_rRepeatCamExtRollCal m181 : 25|9@1- (0.05,0) [0|0] "" Vector__XXX
 SG_ APP_sw182_deserCrcError m182 : 25|1@1+ (1,0) [0|0] "" Vector__XXX
 SG_ APP_sw183_deserCrcError m183 : 25|1@1+ (1,0) [0|0] "" Vector__XXX
 SG_ APP_sw184_deserCrcError m184 : 25|1@1+ (1,0) [0|0] "" Vector__XXX
 SG_ APP_sw185_deserCrcError m185 : 25|1@1+ (1,0) [0|0] "" Vector__XXX
 SG_ APP_sw186_deserCrcError m186 : 25|1@1+ (1,0) [0|0] "" Vector__XXX
 SG_ APP_sw187_deserCrcError m187 : 25|1@1+ (1,0) [0|0] "" Vector__XXX
 SG_ APP_sw188_deserCrcError m188 : 25|1@1+ (1,0) [0|0] "" Vector__XXX
 SG_ APP_sw189_deserCrcError m189 : 25|1@1+ (1,0) [0|0] "" Vector__XXX
 SG_ APP_sw190_deserCrcError m190 : 25|1@1+ (1,0) [0|0] "" Vector__XXX
 SG_ APP_sw203_slotSizeX m203 : 25|8@1+ (4,0) [0|0] "" Vector__XXX
 SG_ APP_sw218_handsOnState m218 : 25|4@1+ (1,0) [0|0] "" Vector__XXX
 SG_ APP_sw230_sensor10Blocked m230 : 25|1@1+ (1,0) [0|0] "" Vector__XXX
 SG_ APP_sw231_predImpactVelocity m231 : 25|7@1+ (0.5,0) [0|0] "" Vector__XXX
 SG_ APP_sw234_sca m234 : 25|1@1+ (1,0) [0|0] "" Vector__XXX
 SG_ APP_sw263_multiLane m263 : 25|1@1+ (1,0) [0|0] "" Vector__XXX
 SG_ APP_sw269_fisheyeBlocked m269 : 25|1@1+ (1,0) [0|0] "" Vector__XXX
 SG_ APP_sw270_lPillarLanesFailsafe m270 : 25|1@1+ (1,0) [0|0] "" Vector__XXX
 SG_ APP_sw272_rPillarBlocked m272 : 25|1@1+ (1,0) [0|0] "" Vector__XXX
 SG_ APP_sw273_timeToCollision m273 : 25|8@1+ (0.02,0) [0|0] "" Vector__XXX
 SG_ APP_sw274_deserCrcError m274 : 25|1@1+ (1,0) [0|0] "" Vector__XXX
 SG_ APP_sw275_deserCrcError m275 : 25|1@1+ (1,0) [0|0] "" Vector__XXX
 SG_ APP_sw276_deserCrcError m276 : 25|1@1+ (1,0) [0|0] "" Vector__XXX
 SG_ APP_sw277_deserCrcError m277 : 25|1@1+ (1,0) [0|0] "" Vector__XXX
 SG_ APP_sw278_deserCrcError m278 : 25|1@1+ (1,0) [0|0] "" Vector__XXX
 SG_ APP_sw279_deserCrcError m279 : 25|1@1+ (1,0) [0|0] "" Vector__XXX
 SG_ APP_sw280_deserCrcError m280 : 25|1@1+ (1,0) [0|0] "" Vector__XXX
 SG_ APP_sw281_deserCrcError m281 : 25|1@1+ (1,0) [0|0] "" Vector__XXX
 SG_ APP_sw282_deserCrcError m282 : 25|1@1+ (1,0) [0|0] "" Vector__XXX
 SG_ APP_sw285_satRejectionTimeout m285 : 25|1@1+ (1,0) [0|0] "" Vector__XXX
 SG_ APP_sw286_unexpectedNMEAmsg m286 : 25|1@1+ (1,0) [0|0] "" Vector__XXX
 SG_ APP_sw306_lssUssS10Blocked m306 : 25|1@1+ (1,0) [0|0] "" Vector__XXX
 SG_ APP_sw327_selfieCamTypeMismatch m327 : 25|1@1+ (1,0) [0|0] "" Vector__XXX
 SG_ APP_sw328_ussS10Unavailable m328 : 25|1@1+ (1,0) [0|0] "" Vector__XXX
 SG_ APP_sw341_validationInvalidDetRate m341 : 25|1@1+ (1,0) [0|0] "" Vector__XXX
 SG_ APP_sw346_seedRejectedEHPE m346 : 25|1@1+ (1,0) [0|0] "" Vector__XXX
 SG_ APP_sw348_fascia m348 : 25|1@1+ (1,0) [0|0] "" Vector__XXX
 SG_ APP_sw349_fascia m349 : 25|1@1+ (1,0) [0|0] "" Vector__XXX
 SG_ APP_sw357_poorFrontCameraVisibility m357 : 25|1@1+ (1,0) [0|0] "" Vector__XXX
 SG_ APP_sw407_gnssDegradedSignalStrength m407 : 25|1@1+ (1,0) [0|0] "" Vector__XXX
 SG_ APP_sw408_cabinCamBlinded m408 : 25|1@1+ (1,0) [0|0] "" Vector__XXX
 SG_ APP_sw409_redundantBrakesRedundancyLost m409 : 25|1@1+ (1,0) [0|0] "" Vector__XXX
 SG_ APP_sw410_apsSelfCanFaulted m410 : 25|1@1+ (1,0) [0|0] "" Vector__XXX
 SG_ APP_sw413_rightRepeaterFluidCleanDegraded m413 : 25|1@1+ (1,0) [0|0] "" Vector__XXX
 SG_ APP_sw415_reason2 m415 : 25|9@1+ (1,0) [0|0] "" Vector__XXX
 SG_ APP_sw416_reason2 m416 : 25|9@1+ (1,0) [0|0] "" Vector__XXX
 SG_ APP_sw417_reason2 m417 : 25|9@1+ (1,0) [0|0] "" Vector__XXX
 SG_ APP_sw418_reason2 m418 : 25|9@1+ (1,0) [0|0] "" Vector__XXX
 SG_ APP_sw419_reason2 m419 : 25|9@1+ (1,0) [0|0] "" Vector__XXX
 SG_ APP_sw420_reason2 m420 : 25|9@1+ (1,0) [0|0] "" Vector__XXX
 SG_ APP_sw421_reason2 m421 : 25|9@1+ (1,0) [0|0] "" Vector__XXX
 SG_ APP_sw422_reason2 m422 : 25|9@1+ (1,0) [0|0] "" Vector__XXX
 SG_ APP_sw437_fascia m437 : 25|1@1+ (1,0) [0|0] "" Vector__XXX
 SG_ APP_sw005_radSGUFailure m5 : 26|1@1+ (1,0) [0|0] "" Vector__XXX
 SG_ APP_sw006_AutofixOutOfCalib m6 : 26|1@1+ (1,0) [0|0] "" Vector__XXX
 SG_ APP_sw015_PartialBlockage m15 : 26|2@1+ (1,0) [0|0] "" Vector__XXX
 SG_ APP_sw017_numCrcErrors m17 : 26|6@1+ (1,0) [0|0] "" Vector__XXX
 SG_ APP_sw027_Unused_Bit_1 m27 : 26|1@1+ (1,0) [0|0] "" Vector__XXX
 SG_ APP_sw041_max_rate m41 : 26|10@1- (1,0) [0|0] "" Vector__XXX
 SG_ APP_sw048_eyeQVersionMismatch m48 : 26|1@1+ (1,0) [0|0] "" Vector__XXX
 SG_ APP_sw053_a20bdyInvalidChkSm m53 : 26|1@1+ (1,0) [0|0] "" Vector__XXX
 SG_ APP_sw057_odo m57 : 26|1@1+ (1,0) [0|0] "" Vector__XXX
 SG_ APP_sw059_status2 m59 : 26|1@1+ (1,0) [0|0] "" Vector__XXX
 SG_ APP_sw068_virtualLaneSTW m68 : 26|14@1+ (0.1,-819.2) [0|0] "" Vector__XXX
 SG_ APP_sw072_vehicleY m72 : 26|10@1+ (0.05,-25.6) [0|0] "" Vector__XXX
 SG_ APP_sw073_freespaceLeftC0 m73 : 26|7@1+ (0.2,-12.8) [0|0] "" Vector__XXX
 SG_ APP_sw182_imagerHeartbeat m182 : 26|2@1+ (1,0) [0|0] "" Vector__XXX
 SG_ APP_sw183_imagerHeartbeat m183 : 26|2@1+ (1,0) [0|0] "" Vector__XXX
 SG_ APP_sw184_imagerHeartbeat m184 : 26|2@1+ (1,0) [0|0] "" Vector__XXX
 SG_ APP_sw185_imagerHeartbeat m185 : 26|2@1+ (1,0) [0|0] "" Vector__XXX
 SG_ APP_sw186_imagerHeartbeat m186 : 26|2@1+ (1,0) [0|0] "" Vector__XXX
 SG_ APP_sw187_imagerHeartbeat m187 : 26|2@1+ (1,0) [0|0] "" Vector__XXX
 SG_ APP_sw188_imagerHeartbeat m188 : 26|2@1+ (1,0) [0|0] "" Vector__XXX
 SG_ APP_sw189_imagerHeartbeat m189 : 26|2@1+ (1,0) [0|0] "" Vector__XXX
 SG_ APP_sw190_imagerHeartbeat m190 : 26|2@1+ (1,0) [0|0] "" Vector__XXX
 SG_ APP_sw230_sensor11Blocked m230 : 26|1@1+ (1,0) [0|0] "" Vector__XXX
 SG_ APP_sw263_noCollisionImminent m263 : 26|1@1+ (1,0) [0|0] "" Vector__XXX
 SG_ APP_sw269_lPillarBlocked m269 : 26|1@1+ (1,0) [0|0] "" Vector__XXX
 SG_ APP_sw270_rPillarLanesFailsafe m270 : 26|1@1+ (1,0) [0|0] "" Vector__XXX
 SG_ APP_sw272_lRepeaterBlocked m272 : 26|1@1+ (1,0) [0|0] "" Vector__XXX
 SG_ APP_sw274_imagerHeartbeat m274 : 26|2@1+ (1,0) [0|0] "" Vector__XXX
 SG_ APP_sw275_imagerHeartbeat m275 : 26|2@1+ (1,0) [0|0] "" Vector__XXX
 SG_ APP_sw276_imagerHeartbeat m276 : 26|2@1+ (1,0) [0|0] "" Vector__XXX
 SG_ APP_sw277_imagerHeartbeat m277 : 26|2@1+ (1,0) [0|0] "" Vector__XXX
 SG_ APP_sw278_imagerHeartbeat m278 : 26|2@1+ (1,0) [0|0] "" Vector__XXX
 SG_ APP_sw279_imagerHeartbeat m279 : 26|2@1+ (1,0) [0|0] "" Vector__XXX
 SG_ APP_sw280_imagerHeartbeat m280 : 26|2@1+ (1,0) [0|0] "" Vector__XXX
 SG_ APP_sw281_imagerHeartbeat m281 : 26|2@1+ (1,0) [0|0] "" Vector__XXX
 SG_ APP_sw282_imagerHeartbeat m282 : 26|2@1+ (1,0) [0|0] "" Vector__XXX
 SG_ APP_sw285_gpsPPSMissing m285 : 26|1@1+ (1,0) [0|0] "" Vector__XXX
 SG_ APP_sw286_UARTbusFull m286 : 26|1@1+ (1,0) [0|0] "" Vector__XXX
 SG_ APP_sw306_lssUssS11Blocked m306 : 26|1@1+ (1,0) [0|0] "" Vector__XXX
 SG_ APP_sw328_ussS11Unavailable m328 : 26|1@1+ (1,0) [0|0] "" Vector__XXX
 SG_ APP_sw341_validationInvalidMeanAz m341 : 26|1@1+ (1,0) [0|0] "" Vector__XXX
 SG_ APP_sw346_seedRejectedSpeed m346 : 26|1@1+ (1,0) [0|0] "" Vector__XXX
 SG_ APP_sw357_staleVisionDv m357 : 26|1@1+ (1,0) [0|0] "" Vector__XXX
 SG_ APP_sw407_cameraCalibration m407 : 26|1@1+ (1,0) [0|0] "" Vector__XXX
 SG_ APP_sw408_incompatibleSystemHealth m408 : 26|1@1+ (1,0) [0|0] "" Vector__XXX
 SG_ APP_sw409_redundantBrakesFailOperational m409 : 26|1@1+ (1,0) [0|0] "" Vector__XXX
 SG_ APP_sw410_apsPeerCanFaulted m410 : 26|1@1+ (1,0) [0|0] "" Vector__XXX
 SG_ APP_sw413_backupFluidCleanDegraded m413 : 26|1@1+ (1,0) [0|0] "" Vector__XXX
 SG_ APP_sw005_radMia m5 : 27|1@1+ (1,0) [0|0] "" Vector__XXX
 SG_ APP_sw006_AutofixOutOfCalibHorzn m6 : 27|1@1+ (1,0) [0|0] "" Vector__XXX
 SG_ APP_sw025_rightLaneUsage m25 : 27|2@1+ (1,0) [0|0] "" Vector__XXX
 SG_ APP_sw026_execution_time m26 : 27|9@1+ (0.125,0) [0|0] "" Vector__XXX
 SG_ APP_sw027_f_PLL_1_Off m27 : 27|1@1+ (1,0) [0|0] "" Vector__XXX
 SG_ APP_sw048_camIssue m48 : 27|1@1+ (1,0) [0|0] "" Vector__XXX
 SG_ APP_sw053_a21espInvalidChkSm m53 : 27|1@1+ (1,0) [0|0] "" Vector__XXX
 SG_ APP_sw057_solarData m57 : 27|1@1+ (1,0) [0|0] "" Vector__XXX
 SG_ APP_sw059_status m59 : 27|1@1+ (1,0) [0|0] "" Vector__XXX
 SG_ APP_sw070_driveRail m70 : 27|1@1+ (1,0) [0|0] "" Vector__XXX
 SG_ APP_sw140_backupCamUARTbusFault m140 : 27|1@1+ (1,0) [0|0] "" Vector__XXX
 SG_ APP_sw199_currentSTW m199 : 27|14@1+ (0.1,-819.2) [0|0] "" Vector__XXX
 SG_ APP_sw230_sensor12Blocked m230 : 27|1@1+ (1,0) [0|0] "" Vector__XXX
 SG_ APP_sw263_blinkerActive m263 : 27|1@1+ (1,0) [0|0] "" Vector__XXX
 SG_ APP_sw266_rRepeaterStreamStatus m266 : 27|3@1+ (1,0) [0|0] "" Vector__XXX
 SG_ APP_sw269_rPillarBlocked m269 : 27|1@1+ (1,0) [0|0] "" Vector__XXX
 SG_ APP_sw270_lRepeaterLanesFailsafe m270 : 27|1@1+ (1,0) [0|0] "" Vector__XXX
 SG_ APP_sw272_rRepeaterBlocked m272 : 27|1@1+ (1,0) [0|0] "" Vector__XXX
 SG_ APP_sw283_distanceTravelled m283 : 27|10@1+ (0.1,0) [0|0] "" Vector__XXX
 SG_ APP_sw286_UARTframeError m286 : 27|1@1+ (1,0) [0|0] "" Vector__XXX
 SG_ APP_sw306_lssUssS12Blocked m306 : 27|1@1+ (1,0) [0|0] "" Vector__XXX
 SG_ APP_sw328_ussS12Unavailable m328 : 27|1@1+ (1,0) [0|0] "" Vector__XXX
 SG_ APP_sw341_validationInvalidMeanEL m341 : 27|1@1+ (1,0) [0|0] "" Vector__XXX
 SG_ APP_sw346_seedEmpty m346 : 27|1@1+ (1,0) [0|0] "" Vector__XXX
 SG_ APP_sw357_staleVisionOutput m357 : 27|1@1+ (1,0) [0|0] "" Vector__XXX
 SG_ APP_sw407_factoryCalibration m407 : 27|1@1+ (1,0) [0|0] "" Vector__XXX
 SG_ APP_sw408_stateMachineDisabled m408 : 27|1@1+ (1,0) [0|0] "" Vector__XXX
 SG_ APP_sw409_rcmWarningIndicatorOn m409 : 27|1@1+ (1,0) [0|0] "" Vector__XXX
 SG_ APP_sw410_apsSelfImemFaulted m410 : 27|1@1+ (1,0) [0|0] "" Vector__XXX
 SG_ APP_sw413_fasciaFluidCleanDegraded m413 : 27|1@1+ (1,0) [0|0] "" Vector__XXX
 SG_ APP_sw435_rightRepeaterAeroRibInfoMismatched m435 : 27|1@1+ (1,0) [0|0] "" Vector__XXX
 SG_ APP_sw004_appMobileyeStatus m4 : 28|5@1+ (1,0) [0|0] "" Vector__XXX
 SG_ APP_sw005_radCalibration m5 : 28|1@1+ (1,0) [0|0] "" Vector__XXX
 SG_ APP_sw006_AutofixOutOfCalibYaw m6 : 28|1@1+ (1,0) [0|0] "" Vector__XXX
 SG_ APP_sw015_AutofixOutOfCalib m15 : 28|2@1+ (1,0) [0|0] "" Vector__XXX
 SG_ APP_sw027_Unused_Nibble m27 : 28|4@1+ (1,0) [0|0] "" Vector__XXX
 SG_ APP_sw044_meMainState m44 : 28|4@1+ (1,0) [0|0] "" Vector__XXX
 SG_ APP_sw048_parkerIssue m48 : 28|1@1+ (1,0) [0|0] "" Vector__XXX
 SG_ APP_sw053_a22sccmInvalidChkSm m53 : 28|1@1+ (1,0) [0|0] "" Vector__XXX
 SG_ APP_sw057_vehicleModes m57 : 28|1@1+ (1,0) [0|0] "" Vector__XXX
 SG_ APP_sw070_accRail m70 : 28|1@1+ (1,0) [0|0] "" Vector__XXX
 SG_ APP_sw140_backupCamSXDeserFailed m140 : 28|1@1+ (1,0) [0|0] "" Vector__XXX
 SG_ APP_sw145_camExtPitchCal m145 : 28|9@1+ (0.05,-12.5) [0|0] "" Vector__XXX
 SG_ APP_sw182_serializerCrcErrCount m182 : 28|8@1+ (1,0) [0|0] "" Vector__XXX
 SG_ APP_sw183_serializerCrcErrCount m183 : 28|8@1+ (1,0) [0|0] "" Vector__XXX
 SG_ APP_sw184_serializerCrcErrCount m184 : 28|8@1+ (1,0) [0|0] "" Vector__XXX
 SG_ APP_sw185_serializerCrcErrCount m185 : 28|8@1+ (1,0) [0|0] "" Vector__XXX
 SG_ APP_sw186_serializerCrcErrCount m186 : 28|8@1+ (1,0) [0|0] "" Vector__XXX
 SG_ APP_sw187_serializerCrcErrCount m187 : 28|8@1+ (1,0) [0|0] "" Vector__XXX
 SG_ APP_sw188_serializerCrcErrCount m188 : 28|8@1+ (1,0) [0|0] "" Vector__XXX
 SG_ APP_sw189_serializerCrcErrCount m189 : 28|8@1+ (1,0) [0|0] "" Vector__XXX
 SG_ APP_sw190_serializerCrcErrCount m190 : 28|8@1+ (1,0) [0|0] "" Vector__XXX
 SG_ APP_sw191_cruiseState m191 : 28|3@1+ (1,0) [0|0] "" Vector__XXX
 SG_ APP_sw263_notEncroaching m263 : 28|1@1+ (1,0) [0|0] "" Vector__XXX
 SG_ APP_sw269_lRepeaterBlocked m269 : 28|1@1+ (1,0) [0|0] "" Vector__XXX
 SG_ APP_sw270_rRepeaterLanesFailsafe m270 : 28|1@1+ (1,0) [0|0] "" Vector__XXX
 SG_ APP_sw274_serializerCrcErrCount m274 : 28|8@1+ (1,0) [0|0] "" Vector__XXX
 SG_ APP_sw275_serializerCrcErrCount m275 : 28|8@1+ (1,0) [0|0] "" Vector__XXX
 SG_ APP_sw276_serializerCrcErrCount m276 : 28|8@1+ (1,0) [0|0] "" Vector__XXX
 SG_ APP_sw277_serializerCrcErrCount m277 : 28|8@1+ (1,0) [0|0] "" Vector__XXX
 SG_ APP_sw278_serializerCrcErrCount m278 : 28|8@1+ (1,0) [0|0] "" Vector__XXX
 SG_ APP_sw279_serializerCrcErrCount m279 : 28|8@1+ (1,0) [0|0] "" Vector__XXX
 SG_ APP_sw280_serializerCrcErrCount m280 : 28|8@1+ (1,0) [0|0] "" Vector__XXX
 SG_ APP_sw281_serializerCrcErrCount m281 : 28|8@1+ (1,0) [0|0] "" Vector__XXX
 SG_ APP_sw282_serializerCrcErrCount m282 : 28|8@1+ (1,0) [0|0] "" Vector__XXX
 SG_ APP_sw286_UBXrxFrameTooBig m286 : 28|1@1+ (1,0) [0|0] "" Vector__XXX
 SG_ APP_sw328_fisheyeStreamExit m328 : 28|1@1+ (1,0) [0|0] "" Vector__XXX
 SG_ APP_sw341_validationInvalidVarAz m341 : 28|1@1+ (1,0) [0|0] "" Vector__XXX
 SG_ APP_sw346_seedSkipAccelErrModel m346 : 28|1@1+ (1,0) [0|0] "" Vector__XXX
 SG_ APP_sw357_sccmMia m357 : 28|1@1+ (1,0) [0|0] "" Vector__XXX
 SG_ APP_sw407_frontCamerasStreamLost m407 : 28|1@1+ (1,0) [0|0] "" Vector__XXX
 SG_ APP_sw408_imuReplicationNotReady m408 : 28|1@1+ (1,0) [0|0] "" Vector__XXX
 SG_ APP_sw409_seatbeltStatusUnhealthy m409 : 28|1@1+ (1,0) [0|0] "" Vector__XXX
 SG_ APP_sw410_apsPeerImemFaulted m410 : 28|1@1+ (1,0) [0|0] "" Vector__XXX
 SG_ APP_sw413_leftRepeaterAirCleanCritical m413 : 28|1@1+ (1,0) [0|0] "" Vector__XXX
 SG_ APP_sw005_brakePedal m5 : 29|1@1+ (1,0) [0|0] "" Vector__XXX
 SG_ APP_sw006_FullBlockage m6 : 29|1@1+ (1,0) [0|0] "" Vector__XXX
 SG_ APP_sw018_railID m18 : 29|2@1+ (1,0) [0|0] "" Vector__XXX
 SG_ APP_sw025_vehiclesUsage m25 : 29|2@1+ (1,0) [0|0] "" Vector__XXX
 SG_ APP_sw048_prolongedUiMia m48 : 29|1@1+ (1,0) [0|0] "" Vector__XXX
 SG_ APP_sw053_a23sccmInvalidChkSm m53 : 29|1@1+ (1,0) [0|0] "" Vector__XXX
 SG_ APP_sw057_cruiseControl m57 : 29|1@1+ (1,0) [0|0] "" Vector__XXX
 SG_ APP_sw069_parkCal m69 : 29|1@1+ (1,0) [0|0] "" Vector__XXX
 SG_ APP_sw140_backupCamDeserLock m140 : 29|2@1+ (1,0) [0|0] "" Vector__XXX
 SG_ APP_sw218_mcuAutosteerRestricted m218 : 29|1@1+ (1,0) [0|0] "" Vector__XXX
 SG_ APP_sw263_dtleAboveThresholdLdw m263 : 29|1@1+ (1,0) [0|0] "" Vector__XXX
 SG_ APP_sw265_leftPillarBlocked m265 : 29|1@1+ (1,0) [0|0] "" Vector__XXX
 SG_ APP_sw269_rRepeaterBlocked m269 : 29|1@1+ (1,0) [0|0] "" Vector__XXX
 SG_ APP_sw270_mainBlocked m270 : 29|1@1+ (1,0) [0|0] "" Vector__XXX
 SG_ APP_sw286_emptyValidNMEA m286 : 29|1@1+ (1,0) [0|0] "" Vector__XXX
 SG_ APP_sw328_lPillarStreamExit m328 : 29|1@1+ (1,0) [0|0] "" Vector__XXX
 SG_ APP_sw341_validationInvalidVarEL m341 : 29|1@1+ (1,0) [0|0] "" Vector__XXX
 SG_ APP_sw346_seedSkipAccelErVarianc m346 : 29|1@1+ (1,0) [0|0] "" Vector__XXX
 SG_ APP_sw357_electricalFaultForSccm m357 : 29|1@1+ (1,0) [0|0] "" Vector__XXX
 SG_ APP_sw407_leftCamerasStreamLost m407 : 29|1@1+ (1,0) [0|0] "" Vector__XXX
 SG_ APP_sw408_singleSocHealthyException m408 : 29|1@1+ (1,0) [0|0] "" Vector__XXX
 SG_ APP_sw409_teleopStreamsUnhealthy m409 : 29|1@1+ (1,0) [0|0] "" Vector__XXX
 SG_ APP_sw410_apsSelfVrmFaulted m410 : 29|1@1+ (1,0) [0|0] "" Vector__XXX
 SG_ APP_sw413_rightRepeaterAirCleanCritical m413 : 29|1@1+ (1,0) [0|0] "" Vector__XXX
 SG_ APP_sw005_steeringAngle m5 : 30|1@1+ (1,0) [0|0] "" Vector__XXX
 SG_ APP_sw006_SmearedHalos m6 : 30|1@1+ (1,0) [0|0] "" Vector__XXX
 SG_ APP_sw015_AutofixOutOfCalibYaw m15 : 30|2@1+ (1,0) [0|0] "" Vector__XXX
 SG_ APP_sw047_edrBlackBox m47 : 30|2@1+ (1,0) [0|0] "" Vector__XXX
 SG_ APP_sw048_apImuNoise m48 : 30|1@1+ (1,0) [0|0] "" Vector__XXX
 SG_ APP_sw053_a24absValidity m53 : 30|1@1+ (1,0) [0|0] "" Vector__XXX
 SG_ APP_sw057_vehicleControl m57 : 30|1@1+ (1,0) [0|0] "" Vector__XXX
 SG_ APP_sw067_epasSTW m67 : 30|14@1+ (0.1,-819.2) [0|0] "" Vector__XXX
 SG_ APP_sw069_torsionBar m69 : 30|12@1+ (0.01,-20.5) [0|0] "" Vector__XXX
 SG_ APP_sw071_endPosY m71 : 30|10@1+ (0.05,-25.6) [0|0] "" Vector__XXX
 SG_ APP_sw194_leadVx m194 : 30|6@1- (0.2,0) [0|0] "" Vector__XXX
 SG_ APP_sw227_sensorMeasurement m227 : 30|9@1+ (1,0) [0|0] "" Vector__XXX
 SG_ APP_sw265_rightPillarBlocked m265 : 30|1@1+ (1,0) [0|0] "" Vector__XXX
 SG_ APP_sw269_lPillarLanesFailsafe m269 : 30|1@1+ (1,0) [0|0] "" Vector__XXX
 SG_ APP_sw270_narrowBlocked m270 : 30|1@1+ (1,0) [0|0] "" Vector__XXX
 SG_ APP_sw286_invalidAsciiNMEA m286 : 30|1@1+ (1,0) [0|0] "" Vector__XXX
 SG_ APP_sw328_rPillarStreamExit m328 : 30|1@1+ (1,0) [0|0] "" Vector__XXX
 SG_ APP_sw341_validationInvalidMeanRCS m341 : 30|1@1+ (1,0) [0|0] "" Vector__XXX
 SG_ APP_sw346_seedValidationFailed m346 : 30|1@1+ (1,0) [0|0] "" Vector__XXX
 SG_ APP_sw350_correctedPitchAngle m350 : 30|9@1- (0.05,0) [0|0] "" Vector__XXX
 SG_ APP_sw357_electricalFaultForMainCam m357 : 30|1@1+ (1,0) [0|0] "" Vector__XXX
 SG_ APP_sw407_rightCamerasStreamLost m407 : 30|1@1+ (1,0) [0|0] "" Vector__XXX
 SG_ APP_sw408_systemUnhealthyDevOverride m408 : 30|1@1+ (1,0) [0|0] "" Vector__XXX
 SG_ APP_sw409_seatOccupancyStatusUnhealthy m409 : 30|1@1+ (1,0) [0|0] "" Vector__XXX
 SG_ APP_sw410_apsPeerVrmFaulted m410 : 30|1@1+ (1,0) [0|0] "" Vector__XXX
 SG_ APP_sw413_backupAirCleanCritical m413 : 30|1@1+ (1,0) [0|0] "" Vector__XXX
 SG_ APP_sw005_steeringAngleRate m5 : 31|1@1+ (1,0) [0|0] "" Vector__XXX
 SG_ APP_sw006_FoggyLights m6 : 31|1@1+ (1,0) [0|0] "" Vector__XXX
 SG_ APP_sw018_powerSequnceError m18 : 31|1@1+ (1,0) [0|0] "" Vector__XXX
 SG_ APP_sw048_uiMiaAtBootup m48 : 31|1@1+ (1,0) [0|0] "" Vector__XXX
 SG_ APP_sw053_a25ambTValidity m53 : 31|1@1+ (1,0) [0|0] "" Vector__XXX
 SG_ APP_sw057_vehicleControl2 m57 : 31|1@1+ (1,0) [0|0] "" Vector__XXX
 SG_ APP_sw146_telemSize m146 : 31|9@1+ (100,0) [0|0] "" Vector__XXX
 SG_ APP_sw200_epasHandsOnDetected m200 : 31|1@1+ (1,0) [0|0] "" Vector__XXX
 SG_ APP_sw213_epasHandsOnDetected m213 : 31|1@1+ (1,0) [0|0] "" Vector__XXX
 SG_ APP_sw265_leftRepeaterBlocked m265 : 31|1@1+ (1,0) [0|0] "" Vector__XXX
 SG_ APP_sw269_rPillarLanesFailsafe m269 : 31|1@1+ (1,0) [0|0] "" Vector__XXX
 SG_ APP_sw270_fisheyeBlocked m270 : 31|1@1+ (1,0) [0|0] "" Vector__XXX
 SG_ APP_sw286_wheeltickUARTfault m286 : 31|1@1+ (1,0) [0|0] "" Vector__XXX
 SG_ APP_sw328_lRepeaterStreamExit m328 : 31|1@1+ (1,0) [0|0] "" Vector__XXX
 SG_ APP_sw341_validationInvalidVarRCS m341 : 31|1@1+ (1,0) [0|0] "" Vector__XXX
 SG_ APP_sw346_timingFaultDetected m346 : 31|1@1+ (1,0) [0|0] "" Vector__XXX
 SG_ APP_sw357_electricalFaultForCabinCam m357 : 31|1@1+ (1,0) [0|0] "" Vector__XXX
 SG_ APP_sw407_backupCameraStreamLost m407 : 31|1@1+ (1,0) [0|0] "" Vector__XXX
 SG_ APP_sw408_passengerUnbuckled m408 : 31|1@1+ (1,0) [0|0] "" Vector__XXX
 SG_ APP_sw409_visionFailoverActive m409 : 31|1@1+ (1,0) [0|0] "" Vector__XXX
 SG_ APP_sw410_apsSelfPmicFaulted m410 : 31|1@1+ (1,0) [0|0] "" Vector__XXX
 SG_ APP_sw413_fasciaAirCleanCritical m413 : 31|1@1+ (1,0) [0|0] "" Vector__XXX
 SG_ APP_sw001_APP_alertDataW1 m1 : 32|16@1+ (1,0) [0|0] "" Vector__XXX
 SG_ APP_sw005_speed m5 : 32|1@1+ (1,0) [0|0] "" Vector__XXX
 SG_ APP_sw006_SelfGlare m6 : 32|1@1+ (1,0) [0|0] "" Vector__XXX
 SG_ APP_sw011_scaSonicDist m11 : 32|5@1+ (0.05,0) [0|0] "" Vector__XXX
 SG_ APP_sw012_bootDDRTempStatus m12 : 32|2@1+ (1,0) [0|0] "" Vector__XXX
 SG_ APP_sw013_numSeqErrors m13 : 32|8@1+ (1,0) [0|0] "" Vector__XXX
 SG_ APP_sw014_lineNumberInCode m14 : 32|16@1+ (1,0) [0|0] "" Vector__XXX
 SG_ APP_sw015_AutofixOOfCalibHorizon m15 : 32|2@1+ (1,0) [0|0] "" Vector__XXX
 SG_ APP_sw017_numSeqErrors m17 : 32|8@1+ (1,0) [0|0] "" Vector__XXX
 SG_ APP_sw018_maxThreshold m18 : 32|15@1+ (1,50) [0|0] "" Vector__XXX
 SG_ APP_sw019_timeStamp m19 : 32|32@1+ (1,0) [0|0] "" Vector__XXX
 SG_ APP_sw020_unusedW1 m20 : 32|16@1+ (1,0) [0|0] "" Vector__XXX
 SG_ APP_sw021_maxThreshold m21 : 32|8@1- (1,0) [0|0] "" Vector__XXX
 SG_ APP_sw022_errorCode m22 : 32|32@1+ (1,0) [0|0] "" Vector__XXX
 SG_ APP_sw024_taskProgramCounter m24 : 32|32@1+ (1,0) [0|0] "" Vector__XXX
 SG_ APP_sw025_hppUsage m25 : 32|2@1+ (1,0) [0|0] "" Vector__XXX
 SG_ APP_sw027_LVD_1v2 m27 : 32|1@1+ (1,0) [0|0] "" Vector__XXX
 SG_ APP_sw028_highestSeqRcvd m28 : 32|16@1+ (1,0) [0|0] "" Vector__XXX
 SG_ APP_sw029_highestSeqRcvd m29 : 32|16@1+ (1,0) [0|0] "" Vector__XXX
 SG_ APP_sw030_unusedW0 m30 : 32|16@1+ (1,0) [0|0] "" Vector__XXX
 SG_ APP_sw031_errorData1 m31 : 32|16@1+ (1,0) [0|0] "" Vector__XXX
 SG_ APP_sw032_errorData1 m32 : 32|16@1+ (1,0) [0|0] "" Vector__XXX
 SG_ APP_sw034_unusedW0 m34 : 32|16@1+ (1,0) [0|0] "" Vector__XXX
 SG_ APP_sw036_unusedW0 m36 : 32|16@1+ (1,0) [0|0] "" Vector__XXX
 SG_ APP_sw037_unusedW0 m37 : 32|16@1+ (1,0) [0|0] "" Vector__XXX
 SG_ APP_sw039_unusedW0 m39 : 32|16@1+ (1,0) [0|0] "" Vector__XXX
 SG_ APP_sw040_das_steering_req m40 : 32|8@1+ (1,-128) [0|0] "" Vector__XXX
 SG_ APP_sw042_state_before_abort m42 : 32|4@1+ (1,0) [0|0] "" Vector__XXX
 SG_ APP_sw043_mesp_health_main_state m43 : 32|16@1+ (1,0) [0|0] "" Vector__XXX
 SG_ APP_sw044_timestampms m44 : 32|32@1+ (1,0) [0|0] "" Vector__XXX
 SG_ APP_sw046_errorCode m46 : 32|32@1+ (1,0) [0|0] "" Vector__XXX
 SG_ APP_sw047_edrReturn m47 : 32|16@1+ (1,0) [0|0] "" Vector__XXX
 SG_ APP_sw048_fisheyeNarrowSwap m48 : 32|1@1+ (1,0) [0|0] "" Vector__XXX
 SG_ APP_sw049_app_version_msw m49 : 32|16@1+ (1,0) [0|0] "" Vector__XXX
 SG_ APP_sw051_HWFail m51 : 32|1@1+ (1,0) [0|0] "" Vector__XXX
 SG_ APP_sw053_a26brakeValidity m53 : 32|1@1+ (1,0) [0|0] "" Vector__XXX
 SG_ APP_sw054_Autofix_yaw m54 : 32|8@1+ (1,0) [0|0] "" Vector__XXX
 SG_ APP_sw056_unusedW0 m56 : 32|16@1+ (1,0) [0|0] "" Vector__XXX
 SG_ APP_sw057_phoneLocStatusMia m57 : 32|1@1+ (1,0) [0|0] "" Vector__XXX
 SG_ APP_sw058_unusedW0 m58 : 32|16@1+ (1,0) [0|0] "" Vector__XXX
 SG_ APP_sw062_VerticalMisalignment m62 : 32|10@1+ (0.087977,-45) [0|0] "" Vector__XXX
 SG_ APP_sw063_expectedMinorVer m63 : 32|8@1+ (1,0) [0|0] "" Vector__XXX
 SG_ APP_sw065_unusedW0 m65 : 32|16@1+ (1,0) [0|0] "" Vector__XXX
 SG_ APP_sw066_unusedW0 m66 : 32|16@1+ (1,0) [0|0] "" Vector__XXX
 SG_ APP_sw070_temperature m70 : 32|8@1+ (0.5,-40) [0|0] "" Vector__XXX
 SG_ APP_sw074_ipsoDz m74 : 32|6@1+ (0.2,-6.4) [0|0] "" Vector__XXX
 SG_ APP_sw075_unusedW0 m75 : 32|16@1+ (1,0) [0|0] "" Vector__XXX
 SG_ APP_sw077_oocCollisionSide m77 : 32|3@1+ (1,0) [0|0] "" Vector__XXX
 SG_ APP_sw078_radarTarg5_dx m78 : 32|8@1+ (0.0625,0) [0|0] "" Vector__XXX
 SG_ APP_sw080_stw_angle_deg m80 : 32|8@1+ (1,0) [0|0] "" Vector__XXX
 SG_ APP_sw081_cameraDistance m81 : 32|8@1+ (0.0625,0) [0|0] "" Vector__XXX
 SG_ APP_sw082_L_Lane m82 : 32|8@1+ (0.05,-6.4) [0|0] "" Vector__XXX
 SG_ APP_sw083_Targ5_dx m83 : 32|12@1+ (0.0625,0) [0|0] "" Vector__XXX
 SG_ APP_sw084_ipsoDx m84 : 32|8@1+ (0.1,0) [0|0] "" Vector__XXX
 SG_ APP_sw085_roadClass m85 : 32|3@1+ (1,0) [0|0] "" Vector__XXX
 SG_ APP_sw086_ellipseWidth m86 : 32|8@1+ (0.1,0) [0|0] "" Vector__XXX
 SG_ APP_sw103_objectDy m103 : 32|8@1+ (0.5,-15.5) [0|0] "" Vector__XXX
 SG_ APP_sw140_backupCamSerFault m140 : 32|3@1+ (1,0) [0|0] "" Vector__XXX
 SG_ APP_sw141_tempSensorId m141 : 32|8@1+ (1,0) [0|0] "" Vector__XXX
 SG_ APP_sw143_targetDistance m143 : 32|7@1+ (0.1,0) [0|0] "" Vector__XXX
 SG_ APP_sw149_diskUsageMap m149 : 32|8@1+ (1,0) [0|0] "" Vector__XXX
 SG_ APP_sw171_APP_pascalTemp m171 : 32|8@1+ (1,-128) [0|0] "" Vector__XXX
 SG_ APP_sw191_epasErrorCode m191 : 32|4@1+ (1,0) [0|0] "" Vector__XXX
 SG_ APP_sw195_sdiRearCC m195 : 32|5@1+ (1,0) [0|0] "" Vector__XXX
 SG_ APP_sw200_startSpeed m200 : 32|10@1+ (0.1,-10) [0|0] "" Vector__XXX
 SG_ APP_sw201_timeHorizon m201 : 32|8@1+ (0.1,0) [0|0] "" Vector__XXX
 SG_ APP_sw202_sdiRearCC m202 : 32|5@1+ (1,0) [0|0] "" Vector__XXX
 SG_ APP_sw204_frMiddle m204 : 32|8@1+ (1,0) [0|0] "" Vector__XXX
 SG_ APP_sw205_rrLeftMiddle m205 : 32|8@1+ (1,0) [0|0] "" Vector__XXX
 SG_ APP_sw207_lcUnavailableReason m207 : 32|8@1+ (1,0) [0|0] "" Vector__XXX
 SG_ APP_sw213_startSpeed m213 : 32|10@1+ (0.1,-10) [0|0] "" Vector__XXX
 SG_ APP_sw218_pedalPosition m218 : 32|7@1+ (1,0) [0|0] "" Vector__XXX
 SG_ APP_sw231_targetDistance m231 : 32|7@1+ (0.1,0) [0|0] "" Vector__XXX
 SG_ APP_sw257_target_ax m257 : 32|8@1+ (0.1,-15.5) [0|0] "" Vector__XXX
 SG_ APP_sw258_target_ax m258 : 32|8@1+ (0.1,-15.5) [0|0] "" Vector__XXX
 SG_ APP_sw259_ego_acceleration m259 : 32|8@1+ (0.1,-15.5) [0|0] "" Vector__XXX
 SG_ APP_sw260_target_ax m260 : 32|8@1+ (0.1,-15.5) [0|0] "" Vector__XXX
 SG_ APP_sw261_fatalUncorrErrors m261 : 32|8@1+ (1,0) [0|0] "" Vector__XXX
 SG_ APP_sw263_markerType m263 : 32|3@1+ (1,0) [0|0] "" Vector__XXX
 SG_ APP_sw265_rightRepeaterBlocked m265 : 32|1@1+ (1,0) [0|0] "" Vector__XXX
 SG_ APP_sw266_backupStreamStatus m266 : 32|3@1+ (1,0) [0|0] "" Vector__XXX
 SG_ APP_sw269_lRepeaterLanesFailsafe m269 : 32|1@1+ (1,0) [0|0] "" Vector__XXX
 SG_ APP_sw270_aebOffInOffRoadMode m270 : 32|1@1+ (1,0) [0|0] "" Vector__XXX
 SG_ APP_sw271_egoSpeed m271 : 32|8@1+ (0.2,0) [0|0] "" Vector__XXX
 SG_ APP_sw286_baudrateMismatch m286 : 32|1@1+ (1,0) [0|0] "" Vector__XXX
 SG_ APP_sw288_ego_acceleration m288 : 32|8@1+ (0.1,-15.5) [0|0] "" Vector__XXX
 SG_ APP_sw291_ego_acceleration m291 : 32|8@1+ (0.1,-15.5) [0|0] "" Vector__XXX
 SG_ APP_sw323_ttc m323 : 32|8@1+ (0.02,0) [0|0] "" Vector__XXX
 SG_ APP_sw328_rRepeaterStreamExit m328 : 32|1@1+ (1,0) [0|0] "" Vector__XXX
 SG_ APP_sw329_rightLaneReqAccel m329 : 32|7@1+ (0.15625,-10) [0|0] "" Vector__XXX
 SG_ APP_sw335_errData m335 : 32|16@1+ (1,0) [0|0] "" Vector__XXX
 SG_ APP_sw337_outVolt m337 : 32|16@1+ (1,0) [0|0] "" Vector__XXX
 SG_ APP_sw338_socTemp m338 : 32|16@1- (0.1,50) [0|0] "" Vector__XXX
 SG_ APP_sw339_rfSensor0Temp m339 : 32|16@1- (0.1,50) [0|0] "" Vector__XXX
 SG_ APP_sw340_csiStatus m340 : 32|32@1+ (1,0) [0|0] "" Vector__XXX
 SG_ APP_sw341_validationADCOffsetOOR m341 : 32|1@1+ (1,0) [0|0] "" Vector__XXX
 SG_ APP_sw344_rangeFftTimeout m344 : 32|1@1+ (1,0) [0|0] "" Vector__XXX
 SG_ APP_sw345_noiseFloorExceededLimit m345 : 32|1@1+ (1,0) [0|0] "" Vector__XXX
 SG_ APP_sw346_sanityChkFailPosition m346 : 32|1@1+ (1,0) [0|0] "" Vector__XXX
 SG_ APP_sw355_quad2FailureRate m355 : 32|8@1+ (0.39215686274509803,0) [0|0] "" Vector__XXX
 SG_ APP_sw357_mainCameraFailsafeActive m357 : 32|1@1+ (1,0) [0|0] "" Vector__XXX
 SG_ APP_sw386_cipvCollisionRunLength m386 : 32|5@1+ (1,0) [0|0] "" Vector__XXX
 SG_ APP_sw387_objCountCdf m387 : 32|7@1+ (0.02,-1) [0|0] "" Vector__XXX
 SG_ APP_sw407_outOfSyncCameraStreams m407 : 32|1@1+ (1,0) [0|0] "" Vector__XXX
 SG_ APP_sw408_passengerUnbuckledActiveRide m408 : 32|1@1+ (1,0) [0|0] "" Vector__XXX
 SG_ APP_sw409_poorLocalizationAccuracy m409 : 32|1@1+ (1,0) [0|0] "" Vector__XXX
 SG_ APP_sw410_apsPeerPmicFaulted m410 : 32|1@1+ (1,0) [0|0] "" Vector__XXX
 SG_ APP_sw413_leftRepeaterFluidCleanCritical m413 : 32|1@1+ (1,0) [0|0] "" Vector__XXX
 SG_ APP_sw004_diCruiseStateFault m4 : 33|1@1+ (1,0) [0|0] "" Vector__XXX
 SG_ APP_sw005_gear m5 : 33|1@1+ (1,0) [0|0] "" Vector__XXX
 SG_ APP_sw006_blinkers m6 : 33|1@1+ (1,0) [0|0] "" Vector__XXX
 SG_ APP_sw027_Unused_Bit_2 m27 : 33|1@1+ (1,0) [0|0] "" Vector__XXX
 SG_ APP_sw048_pillarSwap m48 : 33|1@1+ (1,0) [0|0] "" Vector__XXX
 SG_ APP_sw051_SGUFail m51 : 33|1@1+ (1,0) [0|0] "" Vector__XXX
 SG_ APP_sw053_a27CntryCdValidity m53 : 33|1@1+ (1,0) [0|0] "" Vector__XXX
 SG_ APP_sw073_freespaceRightC0 m73 : 33|7@1+ (0.2,-12.8) [0|0] "" Vector__XXX
 SG_ APP_sw203_slotSizeY m203 : 33|8@1+ (4,0) [0|0] "" Vector__XXX
 SG_ APP_sw265_backupBlocked m265 : 33|1@1+ (1,0) [0|0] "" Vector__XXX
 SG_ APP_sw269_rRepeaterLanesFailsafe m269 : 33|1@1+ (1,0) [0|0] "" Vector__XXX
 SG_ APP_sw270_emergencyLaneKeep m270 : 33|5@1+ (1,0) [0|0] "" Vector__XXX
 SG_ APP_sw273_lngDistanceToVehicle m273 : 33|8@1+ (0.02,0) [0|0] "" Vector__XXX
 SG_ APP_sw286_wheelTickInvalidSrc m286 : 33|1@1+ (1,0) [0|0] "" Vector__XXX
 SG_ APP_sw328_backupStreamExit m328 : 33|1@1+ (1,0) [0|0] "" Vector__XXX
 SG_ APP_sw341_validationRCSDBSMOOR m341 : 33|1@1+ (1,0) [0|0] "" Vector__XXX
 SG_ APP_sw344_dopplerFftTimeout m344 : 33|1@1+ (1,0) [0|0] "" Vector__XXX
 SG_ APP_sw345_avgInterfDurationExceededLimit m345 : 33|1@1+ (1,0) [0|0] "" Vector__XXX
 SG_ APP_sw346_sanityChkFailSpeed m346 : 33|1@1+ (1,0) [0|0] "" Vector__XXX
 SG_ APP_sw357_electricalFaultForFisheyeCam m357 : 33|1@1+ (1,0) [0|0] "" Vector__XXX
 SG_ APP_sw407_cameraAutoexposureLost m407 : 33|1@1+ (1,0) [0|0] "" Vector__XXX
 SG_ APP_sw408_chargeCableConnectedOrStatusUnknown m408 : 33|1@1+ (1,0) [0|0] "" Vector__XXX
 SG_ APP_sw409_apsCanMessagesMia m409 : 33|1@1+ (1,0) [0|0] "" Vector__XXX
 SG_ APP_sw410_apsSingleCameraPowerFailure m410 : 33|1@1+ (1,0) [0|0] "" Vector__XXX
 SG_ APP_sw413_rightRepeaterFluidCleanCritical m413 : 33|1@1+ (1,0) [0|0] "" Vector__XXX
 SG_ APP_sw004_diMIA m4 : 34|1@1+ (1,0) [0|0] "" Vector__XXX
 SG_ APP_sw005_stabilityControl m5 : 34|1@1+ (1,0) [0|0] "" Vector__XXX
 SG_ APP_sw006_seatbelt m6 : 34|1@1+ (1,0) [0|0] "" Vector__XXX
 SG_ APP_sw012_mespFatalErrCode m12 : 34|8@1+ (1,0) [0|0] "" Vector__XXX
 SG_ APP_sw015_Splashes m15 : 34|2@1+ (1,0) [0|0] "" Vector__XXX
 SG_ APP_sw016_targetOverlap m16 : 34|6@1+ (0.1,0) [0|0] "" Vector__XXX
 SG_ APP_sw025_navigationUsage m25 : 34|2@1+ (1,0) [0|0] "" Vector__XXX
 SG_ APP_sw027_Watchdog m27 : 34|1@1+ (1,0) [0|0] "" Vector__XXX
 SG_ APP_sw048_severeResidueDetected m48 : 34|1@1+ (1,0) [0|0] "" Vector__XXX
 SG_ APP_sw050_targetOverlap m50 : 34|6@1+ (0.1,0) [0|0] "" Vector__XXX
 SG_ APP_sw051_unusedBits m51 : 34|6@1+ (1,0) [0|0] "" Vector__XXX
 SG_ APP_sw053_a28espValidity m53 : 34|1@1+ (1,0) [0|0] "" Vector__XXX
 SG_ APP_sw060_targetOverlap m60 : 34|6@1+ (0.1,0) [0|0] "" Vector__XXX
 SG_ APP_sw076_targetOverlap m76 : 34|6@1+ (0.1,0) [0|0] "" Vector__XXX
 SG_ APP_sw131_mainCamExtYawCal m131 : 34|9@1- (0.05,0) [0|0] "" Vector__XXX
 SG_ APP_sw132_narrowCamExtYawCal m132 : 34|9@1- (0.05,0) [0|0] "" Vector__XXX
 SG_ APP_sw142_problemCamPosition m142 : 34|4@1+ (1,0) [0|0] "" Vector__XXX
 SG_ APP_sw177_fisheyeCamExtYawCal m177 : 34|9@1- (0.05,0) [0|0] "" Vector__XXX
 SG_ APP_sw178_lPillarCamExtYawCal m178 : 34|9@1- (0.05,0) [0|0] "" Vector__XXX
 SG_ APP_sw179_rPillarCamExtYawCal m179 : 34|9@1- (0.05,0) [0|0] "" Vector__XXX
 SG_ APP_sw180_lRepeatCamExtYawCal m180 : 34|9@1- (0.05,0) [0|0] "" Vector__XXX
 SG_ APP_sw181_rRepeatCamExtYawCal m181 : 34|9@1- (0.05,0) [0|0] "" Vector__XXX
 SG_ APP_sw265_exceptionListInvalid m265 : 34|1@1+ (1,0) [0|0] "" Vector__XXX
 SG_ APP_sw269_aebOffInOffRoadMode m269 : 34|1@1+ (1,0) [0|0] "" Vector__XXX
 SG_ APP_sw286_UARTparityError m286 : 34|1@1+ (1,0) [0|0] "" Vector__XXX
 SG_ APP_sw328_fisheyeCal m328 : 34|1@1+ (1,0) [0|0] "" Vector__XXX
 SG_ APP_sw341_validationRngVelMismatch m341 : 34|1@1+ (1,0) [0|0] "" Vector__XXX
 SG_ APP_sw344_cfarProcTimeout m344 : 34|1@1+ (1,0) [0|0] "" Vector__XXX
 SG_ APP_sw345_numChirpsWithClipExceededLimit m345 : 34|1@1+ (1,0) [0|0] "" Vector__XXX
 SG_ APP_sw346_sanityChkFailSlope m346 : 34|1@1+ (1,0) [0|0] "" Vector__XXX
 SG_ APP_sw357_fisheyeCameraFailsafeActive m357 : 34|1@1+ (1,0) [0|0] "" Vector__XXX
 SG_ APP_sw407_cameraNightOffgassing m407 : 34|1@1+ (1,0) [0|0] "" Vector__XXX
 SG_ APP_sw408_fleetMaintenanceRequired m408 : 34|1@1+ (1,0) [0|0] "" Vector__XXX
 SG_ APP_sw409_diChassisControlCanMessageMia m409 : 34|1@1+ (1,0) [0|0] "" Vector__XXX
 SG_ APP_sw410_apsDualCameraPowerFailure m410 : 34|1@1+ (1,0) [0|0] "" Vector__XXX
 SG_ APP_sw413_backupFluidCleanCritical m413 : 34|1@1+ (1,0) [0|0] "" Vector__XXX
 SG_ APP_sw415_reason3 m415 : 34|9@1+ (1,0) [0|0] "" Vector__XXX
 SG_ APP_sw416_reason3 m416 : 34|9@1+ (1,0) [0|0] "" Vector__XXX
 SG_ APP_sw417_reason3 m417 : 34|9@1+ (1,0) [0|0] "" Vector__XXX
 SG_ APP_sw418_reason3 m418 : 34|9@1+ (1,0) [0|0] "" Vector__XXX
 SG_ APP_sw419_reason3 m419 : 34|9@1+ (1,0) [0|0] "" Vector__XXX
 SG_ APP_sw420_reason3 m420 : 34|9@1+ (1,0) [0|0] "" Vector__XXX
 SG_ APP_sw421_reason3 m421 : 34|9@1+ (1,0) [0|0] "" Vector__XXX
 SG_ APP_sw422_reason3 m422 : 34|9@1+ (1,0) [0|0] "" Vector__XXX
 SG_ APP_sw004_accelPedalInvalid m4 : 35|1@1+ (1,0) [0|0] "" Vector__XXX
 SG_ APP_sw005_blinkers m5 : 35|1@1+ (1,0) [0|0] "" Vector__XXX
 SG_ APP_sw006_accelPedal m6 : 35|1@1+ (1,0) [0|0] "" Vector__XXX
 SG_ APP_sw027_Unused_Bit_3 m27 : 35|1@1+ (1,0) [0|0] "" Vector__XXX
 SG_ APP_sw053_a29longAccOffValidity m53 : 35|1@1+ (1,0) [0|0] "" Vector__XXX
 SG_ APP_sw077_oocHeight m77 : 35|2@1+ (1,0) [0|0] "" Vector__XXX
 SG_ APP_sw085_leftLaneExist m85 : 35|6@1+ (2,0) [0|0] "" Vector__XXX
 SG_ APP_sw140_backupCamHDMISerFault m140 : 35|1@1+ (1,0) [0|0] "" Vector__XXX
 SG_ APP_sw263_side m263 : 35|1@1+ (1,0) [0|0] "" Vector__XXX
 SG_ APP_sw265_lPillarLanesFailsafe m265 : 35|1@1+ (1,0) [0|0] "" Vector__XXX
 SG_ APP_sw269_emergencyLaneKeep m269 : 35|5@1+ (1,0) [0|0] "" Vector__XXX
 SG_ APP_sw286_UARTrxFifoOverflow m286 : 35|1@1+ (1,0) [0|0] "" Vector__XXX
 SG_ APP_sw328_lPillarCal m328 : 35|1@1+ (1,0) [0|0] "" Vector__XXX
 SG_ APP_sw341_validationSkippedFrame m341 : 35|1@1+ (1,0) [0|0] "" Vector__XXX
 SG_ APP_sw344_arrayProcTimeout m344 : 35|1@1+ (1,0) [0|0] "" Vector__XXX
 SG_ APP_sw345_vehicleDynamicsDataMissing m345 : 35|1@1+ (1,0) [0|0] "" Vector__XXX
 SG_ APP_sw346_sanityChkFailAccel m346 : 35|1@1+ (1,0) [0|0] "" Vector__XXX
 SG_ APP_sw357_camCalibOutOfBounds m357 : 35|1@1+ (1,0) [0|0] "" Vector__XXX
 SG_ APP_sw407_cameraVisionFailsafeBeforeActivation m407 : 35|1@1+ (1,0) [0|0] "" Vector__XXX
 SG_ APP_sw408_sgkPlannerActiveDRN m408 : 35|1@1+ (1,0) [0|0] "" Vector__XXX
 SG_ APP_sw409_diSystemStatusCanMessagesMia m409 : 35|1@1+ (1,0) [0|0] "" Vector__XXX
 SG_ APP_sw410_apTaskPendingReboot m410 : 35|1@1+ (1,0) [0|0] "" Vector__XXX
 SG_ APP_sw413_fasciaFluidCleanCritical m413 : 35|1@1+ (1,0) [0|0] "" Vector__XXX
 SG_ APP_sw004_stwAngleInvalid m4 : 36|1@1+ (1,0) [0|0] "" Vector__XXX
 SG_ APP_sw005_yaw m5 : 36|1@1+ (1,0) [0|0] "" Vector__XXX
 SG_ APP_sw006_radMia m6 : 36|1@1+ (1,0) [0|0] "" Vector__XXX
 SG_ APP_sw010_VerticalMisalignment m10 : 36|10@1+ (0.087977,-45) [0|0] "" Vector__XXX
 SG_ APP_sw015_SmearedSpots m15 : 36|2@1+ (1,0) [0|0] "" Vector__XXX
 SG_ APP_sw025_modelUsage m25 : 36|2@1+ (1,0) [0|0] "" Vector__XXX
 SG_ APP_sw026_can_mean_utilization m26 : 36|7@1+ (1,0) [0|0] "" Vector__XXX
 SG_ APP_sw027_LVD_2v7_VREG m27 : 36|1@1+ (1,0) [0|0] "" Vector__XXX
 SG_ APP_sw041_ego_speed m41 : 36|10@1+ (0.05,0) [0|0] "" Vector__XXX
 SG_ APP_sw042_epas_error_code m42 : 36|4@1+ (1,0) [0|0] "" Vector__XXX
 SG_ APP_sw053_a30longAccValidity m53 : 36|1@1+ (1,0) [0|0] "" Vector__XXX
 SG_ APP_sw072_vehicleHeading m72 : 36|10@1+ (0.005,-2.56) [0|0] "" Vector__XXX
 SG_ APP_sw182_deserLineLengthError m182 : 36|1@1+ (1,0) [0|0] "" Vector__XXX
 SG_ APP_sw183_deserLineLengthError m183 : 36|1@1+ (1,0) [0|0] "" Vector__XXX
 SG_ APP_sw184_deserLineLengthError m184 : 36|1@1+ (1,0) [0|0] "" Vector__XXX
 SG_ APP_sw185_deserLineLengthError m185 : 36|1@1+ (1,0) [0|0] "" Vector__XXX
 SG_ APP_sw186_deserLineLengthError m186 : 36|1@1+ (1,0) [0|0] "" Vector__XXX
 SG_ APP_sw187_deserLineLengthError m187 : 36|1@1+ (1,0) [0|0] "" Vector__XXX
 SG_ APP_sw188_deserLineLengthError m188 : 36|1@1+ (1,0) [0|0] "" Vector__XXX
 SG_ APP_sw189_deserLineLengthError m189 : 36|1@1+ (1,0) [0|0] "" Vector__XXX
 SG_ APP_sw190_deserLineLengthError m190 : 36|1@1+ (1,0) [0|0] "" Vector__XXX
 SG_ APP_sw194_numObstacles m194 : 36|4@1+ (1,0) [0|0] "" Vector__XXX
 SG_ APP_sw263_speed m263 : 36|8@1+ (1,0) [0|0] "" Vector__XXX
 SG_ APP_sw265_rPillarLanesFailsafe m265 : 36|1@1+ (1,0) [0|0] "" Vector__XXX
 SG_ APP_sw274_deserLineLengthError m274 : 36|1@1+ (1,0) [0|0] "" Vector__XXX
 SG_ APP_sw275_deserLineLengthError m275 : 36|1@1+ (1,0) [0|0] "" Vector__XXX
 SG_ APP_sw276_deserLineLengthError m276 : 36|1@1+ (1,0) [0|0] "" Vector__XXX
 SG_ APP_sw277_deserLineLengthError m277 : 36|1@1+ (1,0) [0|0] "" Vector__XXX
 SG_ APP_sw278_deserLineLengthError m278 : 36|1@1+ (1,0) [0|0] "" Vector__XXX
 SG_ APP_sw279_deserLineLengthError m279 : 36|1@1+ (1,0) [0|0] "" Vector__XXX
 SG_ APP_sw280_deserLineLengthError m280 : 36|1@1+ (1,0) [0|0] "" Vector__XXX
 SG_ APP_sw281_deserLineLengthError m281 : 36|1@1+ (1,0) [0|0] "" Vector__XXX
 SG_ APP_sw282_deserLineLengthError m282 : 36|1@1+ (1,0) [0|0] "" Vector__XXX
 SG_ APP_sw286_UARTrxFifoUnderflow m286 : 36|1@1+ (1,0) [0|0] "" Vector__XXX
 SG_ APP_sw328_rPillarCal m328 : 36|1@1+ (1,0) [0|0] "" Vector__XXX
 SG_ APP_sw341_validationTinyMeasuredAz m341 : 36|1@1+ (1,0) [0|0] "" Vector__XXX
 SG_ APP_sw344_genObjSoftTimeout m344 : 36|1@1+ (1,0) [0|0] "" Vector__XXX
 SG_ APP_sw345_vehicleSteeringDataMissing m345 : 36|1@1+ (1,0) [0|0] "" Vector__XXX
 SG_ APP_sw346_sanityChkFailAnglrRate m346 : 36|1@1+ (1,0) [0|0] "" Vector__XXX
 SG_ APP_sw407_severeFrontVisionOcclusion m407 : 36|1@1+ (1,0) [0|0] "" Vector__XXX
 SG_ APP_sw408_visionCabinOccupancyUnavailable m408 : 36|1@1+ (1,0) [0|0] "" Vector__XXX
 SG_ APP_sw409_steeringCanMessagesMia m409 : 36|1@1+ (1,0) [0|0] "" Vector__XXX
 SG_ APP_sw410_anyLvHealthCanMessageMia m410 : 36|1@1+ (1,0) [0|0] "" Vector__XXX
 SG_ APP_sw413_cabinCamFanRpmFault m413 : 36|1@1+ (1,0) [0|0] "" Vector__XXX
 SG_ APP_sw004_accelerationInvalid m4 : 37|1@1+ (1,0) [0|0] "" Vector__XXX
 SG_ APP_sw005_longAccel m5 : 37|1@1+ (1,0) [0|0] "" Vector__XXX
 SG_ APP_sw006_radHWFailure m6 : 37|1@1+ (1,0) [0|0] "" Vector__XXX
 SG_ APP_sw011_scaSteerAngle m11 : 37|10@1+ (0.1,-51.2) [0|0] "" Vector__XXX
 SG_ APP_sw027_LVD_2v7_Flash m27 : 37|1@1+ (1,0) [0|0] "" Vector__XXX
 SG_ APP_sw053_a31odoValidity m53 : 37|1@1+ (1,0) [0|0] "" Vector__XXX
 SG_ APP_sw077_vehicleSpeed m77 : 37|10@1+ (0.05,-25) [0|0] "" Vector__XXX
 SG_ APP_sw145_camExtYawCal m145 : 37|9@1+ (0.05,-12.5) [0|0] "" Vector__XXX
 SG_ APP_sw182_numCaptureRecoveries m182 : 37|3@1+ (1,0) [0|0] "" Vector__XXX
 SG_ APP_sw183_numCaptureRecoveries m183 : 37|3@1+ (1,0) [0|0] "" Vector__XXX
 SG_ APP_sw184_numCaptureRecoveries m184 : 37|3@1+ (1,0) [0|0] "" Vector__XXX
 SG_ APP_sw185_numCaptureRecoveries m185 : 37|3@1+ (1,0) [0|0] "" Vector__XXX
 SG_ APP_sw186_numCaptureRecoveries m186 : 37|3@1+ (1,0) [0|0] "" Vector__XXX
 SG_ APP_sw187_numCaptureRecoveries m187 : 37|3@1+ (1,0) [0|0] "" Vector__XXX
 SG_ APP_sw188_numCaptureRecoveries m188 : 37|3@1+ (1,0) [0|0] "" Vector__XXX
 SG_ APP_sw189_numCaptureRecoveries m189 : 37|3@1+ (1,0) [0|0] "" Vector__XXX
 SG_ APP_sw190_numCaptureRecoveries m190 : 37|3@1+ (1,0) [0|0] "" Vector__XXX
 SG_ APP_sw195_sdiSystemNoise m195 : 37|2@1+ (1,0) [0|0] "" Vector__XXX
 SG_ APP_sw202_sdiSystemNoise m202 : 37|2@1+ (1,0) [0|0] "" Vector__XXX
 SG_ APP_sw265_lRepeaterLanesFailsafe m265 : 37|1@1+ (1,0) [0|0] "" Vector__XXX
 SG_ APP_sw274_numCaptureRecoveries m274 : 37|3@1+ (1,0) [0|0] "" Vector__XXX
 SG_ APP_sw275_numCaptureRecoveries m275 : 37|3@1+ (1,0) [0|0] "" Vector__XXX
 SG_ APP_sw276_numCaptureRecoveries m276 : 37|3@1+ (1,0) [0|0] "" Vector__XXX
 SG_ APP_sw277_numCaptureRecoveries m277 : 37|3@1+ (1,0) [0|0] "" Vector__XXX
 SG_ APP_sw278_numCaptureRecoveries m278 : 37|3@1+ (1,0) [0|0] "" Vector__XXX
 SG_ APP_sw279_numCaptureRecoveries m279 : 37|3@1+ (1,0) [0|0] "" Vector__XXX
 SG_ APP_sw280_numCaptureRecoveries m280 : 37|3@1+ (1,0) [0|0] "" Vector__XXX
 SG_ APP_sw281_numCaptureRecoveries m281 : 37|3@1+ (1,0) [0|0] "" Vector__XXX
 SG_ APP_sw282_numCaptureRecoveries m282 : 37|3@1+ (1,0) [0|0] "" Vector__XXX
 SG_ APP_sw283_phoneDistance m283 : 37|9@1+ (0.2,0) [0|0] "" Vector__XXX
 SG_ APP_sw286_UARTtxFifoOverflow m286 : 37|1@1+ (1,0) [0|0] "" Vector__XXX
 SG_ APP_sw328_lRepeaterCal m328 : 37|1@1+ (1,0) [0|0] "" Vector__XXX
 SG_ APP_sw341_validationTinyMeasuredEl m341 : 37|1@1+ (1,0) [0|0] "" Vector__XXX
 SG_ APP_sw343_statsNumTargetAz m343 : 37|1@1+ (1,0) [0|0] "" Vector__XXX
 SG_ APP_sw345_vehicleWiperStatusDataMissing m345 : 37|1@1+ (1,0) [0|0] "" Vector__XXX
 SG_ APP_sw346_sanityChkFailErrModel m346 : 37|1@1+ (1,0) [0|0] "" Vector__XXX
 SG_ APP_sw386_cipv2Valid m386 : 37|1@1+ (1,0) [0|0] "" Vector__XXX
 SG_ APP_sw407_severeLeftVisionOcclusion m407 : 37|1@1+ (1,0) [0|0] "" Vector__XXX
 SG_ APP_sw408_lowTirePressureReading m408 : 37|1@1+ (1,0) [0|0] "" Vector__XXX
 SG_ APP_sw409_parkBrakeCanMessagesMia m409 : 37|1@1+ (1,0) [0|0] "" Vector__XXX
 SG_ APP_sw410_anyLvHealthCanMessageInvalid m410 : 37|1@1+ (1,0) [0|0] "" Vector__XXX
 SG_ APP_sw413_gnssPpsMIA m413 : 37|1@1+ (1,0) [0|0] "" Vector__XXX
 SG_ APP_sw004_diSpeedInvalid m4 : 38|1@1+ (1,0) [0|0] "" Vector__XXX
 SG_ APP_sw005_accelPedal m5 : 38|1@1+ (1,0) [0|0] "" Vector__XXX
 SG_ APP_sw006_radSensorBlind m6 : 38|1@1+ (1,0) [0|0] "" Vector__XXX
 SG_ APP_sw015_SmearedHalos m15 : 38|2@1+ (1,0) [0|0] "" Vector__XXX
 SG_ APP_sw025_bottsDotsUsage m25 : 38|2@1+ (1,0) [0|0] "" Vector__XXX
 SG_ APP_sw027_LVD_2v7_IO m27 : 38|1@1+ (1,0) [0|0] "" Vector__XXX
 SG_ APP_sw053_a32gearValidity m53 : 38|1@1+ (1,0) [0|0] "" Vector__XXX
 SG_ APP_sw265_rRepeaterLanesFailsafe m265 : 38|1@1+ (1,0) [0|0] "" Vector__XXX
 SG_ APP_sw286_esfWtMsgTimeout m286 : 38|1@1+ (1,0) [0|0] "" Vector__XXX
 SG_ APP_sw328_rRepeaterCal m328 : 38|1@1+ (1,0) [0|0] "" Vector__XXX
 SG_ APP_sw341_validationNoObjFound m341 : 38|1@1+ (1,0) [0|0] "" Vector__XXX
 SG_ APP_sw343_statsNumTargetEl m343 : 38|1@1+ (1,0) [0|0] "" Vector__XXX
 SG_ APP_sw345_runtimeCalibDataInvalid m345 : 38|1@1+ (1,0) [0|0] "" Vector__XXX
 SG_ APP_sw346_seedValFailGnssAgremnt m346 : 38|1@1+ (1,0) [0|0] "" Vector__XXX
 SG_ APP_sw386_cipv2Dx m386 : 38|8@1+ (1,0) [0|0] "" Vector__XXX
 SG_ APP_sw407_severeRightVisionOcclusion m407 : 38|1@1+ (1,0) [0|0] "" Vector__XXX
 SG_ APP_sw408_elevatedTirePressureReading m408 : 38|1@1+ (1,0) [0|0] "" Vector__XXX
 SG_ APP_sw409_brakingCanMessagesMia m409 : 38|1@1+ (1,0) [0|0] "" Vector__XXX
 SG_ APP_sw410_uiHealthStatusCanMessageMia m410 : 38|1@1+ (1,0) [0|0] "" Vector__XXX
 SG_ APP_sw413_camDayOffgassingPreAlert m413 : 38|1@1+ (1,0) [0|0] "" Vector__XXX
 SG_ APP_sw004_DASFeaturesDisabled m4 : 39|1@1+ (1,0) [0|0] "" Vector__XXX
 SG_ APP_sw005_fcmSensitivity m5 : 39|1@1+ (1,0) [0|0] "" Vector__XXX
 SG_ APP_sw006_radSGUFailure m6 : 39|1@1+ (1,0) [0|0] "" Vector__XXX
 SG_ APP_sw027_Unused_Bit_4 m27 : 39|1@1+ (1,0) [0|0] "" Vector__XXX
 SG_ APP_sw053_a33steerAngValidity m53 : 39|1@1+ (1,0) [0|0] "" Vector__XXX
 SG_ APP_sw143_targetRelVelocity m143 : 39|6@1+ (0.5,0) [0|0] "" Vector__XXX
 SG_ APP_sw195_sdiSystemStatus m195 : 39|1@1+ (1,0) [0|0] "" Vector__XXX
 SG_ APP_sw202_sdiSystemStatus m202 : 39|1@1+ (1,0) [0|0] "" Vector__XXX
 SG_ APP_sw231_targetRelVelocity m231 : 39|6@1+ (0.5,0) [0|0] "" Vector__XXX
 SG_ APP_sw286_PFLASHReadError m286 : 39|1@1+ (1,0) [0|0] "" Vector__XXX
 SG_ APP_sw328_backupCal m328 : 39|1@1+ (1,0) [0|0] "" Vector__XXX
 SG_ APP_sw329_leftLaneAvailable m329 : 39|1@1+ (1,0) [0|0] "" Vector__XXX
 SG_ APP_sw341_validationAzMaxInvalid m341 : 39|1@1+ (1,0) [0|0] "" Vector__XXX
 SG_ APP_sw343_statsRcsdB m343 : 39|1@1+ (1,0) [0|0] "" Vector__XXX
 SG_ APP_sw346_seedValSuccess m346 : 39|1@1+ (1,0) [0|0] "" Vector__XXX
 SG_ APP_sw350_correctedHeadingAngle m350 : 39|9@1- (0.05,0) [0|0] "" Vector__XXX
 SG_ APP_sw407_severeReverseVisionOcclusion m407 : 39|1@1+ (1,0) [0|0] "" Vector__XXX
 SG_ APP_sw408_washerFluidLow m408 : 39|1@1+ (1,0) [0|0] "" Vector__XXX
 SG_ APP_sw409_imuCanMessagesMia m409 : 39|1@1+ (1,0) [0|0] "" Vector__XXX
 SG_ APP_sw410_gtwCarConfigCanMessageMia m410 : 39|1@1+ (1,0) [0|0] "" Vector__XXX
 SG_ APP_sw413_fluidCleaningStatusMia m413 : 39|1@1+ (1,0) [0|0] "" Vector__XXX
 SG_ APP_sw004_appMobileyeNotInVision m4 : 40|1@1+ (1,0) [0|0] "" Vector__XXX
 SG_ APP_sw005_dasDisabled m5 : 40|1@1+ (1,0) [0|0] "" Vector__XXX
 SG_ APP_sw006_brakePedal m6 : 40|1@1+ (1,0) [0|0] "" Vector__XXX
 SG_ APP_sw013_numNaksReceived m13 : 40|8@1+ (1,0) [0|0] "" Vector__XXX
 SG_ APP_sw015_FoggyLights m15 : 40|2@1+ (1,0) [0|0] "" Vector__XXX
 SG_ APP_sw016_hostSpeed m16 : 40|8@1+ (1,0) [0|0] "" Vector__XXX
 SG_ APP_sw017_numTransportErrors m17 : 40|8@1+ (1,0) [0|0] "" Vector__XXX
 SG_ APP_sw021_currentTemperature m21 : 40|8@1- (1,0) [0|0] "" Vector__XXX
 SG_ APP_sw025_offsetSide m25 : 40|2@1+ (1,0) [0|0] "" Vector__XXX
 SG_ APP_sw027_Unused_Byte m27 : 40|8@1+ (1,0) [0|0] "" Vector__XXX
 SG_ APP_sw040_epas_internal_sas m40 : 40|8@1+ (1,-128) [0|0] "" Vector__XXX
 SG_ APP_sw042_cam_SunRay m42 : 40|1@1+ (1,0) [0|0] "" Vector__XXX
 SG_ APP_sw050_hostSpeed m50 : 40|8@1+ (1,0) [0|0] "" Vector__XXX
 SG_ APP_sw051_unusedB0 m51 : 40|8@1+ (1,0) [0|0] "" Vector__XXX
 SG_ APP_sw053_a34steerAngSpdValidity m53 : 40|1@1+ (1,0) [0|0] "" Vector__XXX
 SG_ APP_sw054_unusedByte m54 : 40|8@1+ (1,0) [0|0] "" Vector__XXX
 SG_ APP_sw060_hostSpeed m60 : 40|7@1+ (2,0) [0|0] "" Vector__XXX
 SG_ APP_sw063_detectedMinorVer m63 : 40|8@1+ (1,0) [0|0] "" Vector__XXX
 SG_ APP_sw068_navigationSTW m68 : 40|14@1+ (0.1,-819.2) [0|0] "" Vector__XXX
 SG_ APP_sw070_currentSpeed m70 : 40|12@1+ (0.1,-204.7) [0|0] "" Vector__XXX
 SG_ APP_sw071_roadClass m71 : 40|3@1+ (1,0) [0|0] "" Vector__XXX
 SG_ APP_sw073_freespaceLeftC1 m73 : 40|8@1+ (0.0016,-0.2) [0|0] "" Vector__XXX
 SG_ APP_sw074_ipsoRCS m74 : 40|8@1+ (1,0) [0|0] "" Vector__XXX
 SG_ APP_sw076_hostSpeed m76 : 40|8@1+ (1,0) [0|0] "" Vector__XXX
 SG_ APP_sw078_radarTarg5_VxRel m78 : 40|8@1+ (0.2,-25.6) [0|0] "" Vector__XXX
 SG_ APP_sw080_road_class m80 : 40|3@1+ (1,0) [0|0] "" Vector__XXX
 SG_ APP_sw081_cameraTTC m81 : 40|8@1+ (0.02,0) [0|0] "" Vector__XXX
 SG_ APP_sw082_R_Lane m82 : 40|8@1+ (0.05,-6.4) [0|0] "" Vector__XXX
 SG_ APP_sw084_ipsoDy m84 : 40|8@1+ (0.1,-12.6) [0|0] "" Vector__XXX
 SG_ APP_sw086_ellipseOverlap m86 : 40|8@1+ (0.1,-12.5) [0|0] "" Vector__XXX
 SG_ APP_sw103_objectDz m103 : 40|8@1+ (0.25,-5) [0|0] "" Vector__XXX
 SG_ APP_sw141_temperature m141 : 40|8@1- (1,0) [0|0] "" Vector__XXX
 SG_ APP_sw149_diskUsageAutopilot m149 : 40|8@1+ (1,0) [0|0] "" Vector__XXX
 SG_ APP_sw171_APP_pascalExtTemp m171 : 40|8@1+ (1,-128) [0|0] "" Vector__XXX
 SG_ APP_sw182_currentTemperature m182 : 40|8@1+ (1,-60) [0|0] "" Vector__XXX
 SG_ APP_sw183_currentTemperature m183 : 40|8@1+ (1,-60) [0|0] "" Vector__XXX
 SG_ APP_sw184_currentTemperature m184 : 40|8@1+ (1,-60) [0|0] "" Vector__XXX
 SG_ APP_sw185_currentTemperature m185 : 40|8@1+ (1,-60) [0|0] "" Vector__XXX
 SG_ APP_sw186_currentTemperature m186 : 40|8@1+ (1,-60) [0|0] "" Vector__XXX
 SG_ APP_sw187_currentTemperature m187 : 40|8@1+ (1,-60) [0|0] "" Vector__XXX
 SG_ APP_sw188_currentTemperature m188 : 40|8@1+ (1,-60) [0|0] "" Vector__XXX
 SG_ APP_sw189_currentTemperature m189 : 40|8@1+ (1,-60) [0|0] "" Vector__XXX
 SG_ APP_sw190_currentTemperature m190 : 40|8@1+ (1,-60) [0|0] "" Vector__XXX
 SG_ APP_sw191_viewRange m191 : 40|8@1+ (1,0) [0|0] "" Vector__XXX
 SG_ APP_sw194_numPedstrian m194 : 40|4@1+ (1,0) [0|0] "" Vector__XXX
 SG_ APP_sw195_vehicleSpeed m195 : 40|12@1+ (0.1,0) [0|0] "" Vector__XXX
 SG_ APP_sw201_vehSpeed m201 : 40|8@1+ (1,0) [0|0] "" Vector__XXX
 SG_ APP_sw202_vehicleSpeed m202 : 40|12@1+ (0.1,0) [0|0] "" Vector__XXX
 SG_ APP_sw204_frRight m204 : 40|8@1+ (1,0) [0|0] "" Vector__XXX
 SG_ APP_sw205_rrMiddle m205 : 40|8@1+ (1,0) [0|0] "" Vector__XXX
 SG_ APP_sw227_ambientTemperature m227 : 40|8@1+ (0.5,-40) [0|0] "" Vector__XXX
 SG_ APP_sw257_ego_speed m257 : 40|8@1+ (0.2,0) [0|0] "" Vector__XXX
 SG_ APP_sw258_ego_speed m258 : 40|8@1+ (0.2,0) [0|0] "" Vector__XXX
 SG_ APP_sw259_previous_lcm_app_state m259 : 40|4@1+ (1,0) [0|0] "" Vector__XXX
 SG_ APP_sw260_ego_speed m260 : 40|8@1+ (0.2,0) [0|0] "" Vector__XXX
 SG_ APP_sw269_laneKeepAssist m269 : 40|5@1+ (1,0) [0|0] "" Vector__XXX
 SG_ APP_sw270_laneKeepAssist m270 : 40|5@1+ (1,0) [0|0] "" Vector__XXX
 SG_ APP_sw274_currentTemperature m274 : 40|8@1+ (1,-60) [0|0] "" Vector__XXX
 SG_ APP_sw275_currentTemperature m275 : 40|8@1+ (1,-60) [0|0] "" Vector__XXX
 SG_ APP_sw276_currentTemperature m276 : 40|8@1+ (1,-60) [0|0] "" Vector__XXX
 SG_ APP_sw277_currentTemperature m277 : 40|8@1+ (1,-60) [0|0] "" Vector__XXX
 SG_ APP_sw278_currentTemperature m278 : 40|8@1+ (1,-60) [0|0] "" Vector__XXX
 SG_ APP_sw279_currentTemperature m279 : 40|8@1+ (1,-60) [0|0] "" Vector__XXX
 SG_ APP_sw280_currentTemperature m280 : 40|8@1+ (1,-60) [0|0] "" Vector__XXX
 SG_ APP_sw281_currentTemperature m281 : 40|8@1+ (1,-60) [0|0] "" Vector__XXX
 SG_ APP_sw282_currentTemperature m282 : 40|8@1+ (1,-60) [0|0] "" Vector__XXX
 SG_ APP_sw286_PFLASHWriteError m286 : 40|1@1+ (1,0) [0|0] "" Vector__XXX
 SG_ APP_sw328_epasMia m328 : 40|1@1+ (1,0) [0|0] "" Vector__XXX
 SG_ APP_sw329_rightLaneAvailable m329 : 40|1@1+ (1,0) [0|0] "" Vector__XXX
 SG_ APP_sw341_validationElMaxInvalid m341 : 40|1@1+ (1,0) [0|0] "" Vector__XXX
 SG_ APP_sw343_statsSnrdB m343 : 40|1@1+ (1,0) [0|0] "" Vector__XXX
 SG_ APP_sw346_bigTemperatureGradient m346 : 40|1@1+ (1,0) [0|0] "" Vector__XXX
 SG_ APP_sw355_quad3FailureRate m355 : 40|8@1+ (0.39215686274509803,0) [0|0] "" Vector__XXX
 SG_ APP_sw387_rangeCdf m387 : 40|7@1+ (0.02,-1) [0|0] "" Vector__XXX
 SG_ APP_sw407_frequentVisionOcclusion m407 : 40|1@1+ (1,0) [0|0] "" Vector__XXX
 SG_ APP_sw408_imuDataNotReliable m408 : 40|1@1+ (1,0) [0|0] "" Vector__XXX
 SG_ APP_sw409_narrowWashNotAvailable m409 : 40|1@1+ (1,0) [0|0] "" Vector__XXX
 SG_ APP_sw410_bbStatusCanMessageMia m410 : 40|1@1+ (1,0) [0|0] "" Vector__XXX
 SG_ APP_sw413_airCleaningStatusMia m413 : 40|1@1+ (1,0) [0|0] "" Vector__XXX
 SG_ APP_sw004_CamCommonMIA m4 : 41|1@1+ (1,0) [0|0] "" Vector__XXX
 SG_ APP_sw005_speedDerivative m5 : 41|1@1+ (1,0) [0|0] "" Vector__XXX
 SG_ APP_sw006_steeringAngle m6 : 41|1@1+ (1,0) [0|0] "" Vector__XXX
 SG_ APP_sw042_cam_RoadSpray m42 : 41|1@1+ (1,0) [0|0] "" Vector__XXX
 SG_ APP_sw053_a35indctrValidity m53 : 41|1@1+ (1,0) [0|0] "" Vector__XXX
 SG_ APP_sw085_rightLaneExist m85 : 41|6@1+ (2,0) [0|0] "" Vector__XXX
 SG_ APP_sw199_currentSpeed m199 : 41|8@1+ (0.1,-12.2) [0|0] "" Vector__XXX
 SG_ APP_sw203_startDistance m203 : 41|11@1+ (1,0) [0|0] "" Vector__XXX
 SG_ APP_sw273_latDistanceToVehicle m273 : 41|8@1+ (0.02,0) [0|0] "" Vector__XXX
 SG_ APP_sw286_gpsCfgNack m286 : 41|1@1+ (1,0) [0|0] "" Vector__XXX
 SG_ APP_sw328_espMia m328 : 41|1@1+ (1,0) [0|0] "" Vector__XXX
 SG_ APP_sw329_laneChangeLeft m329 : 41|1@1+ (1,0) [0|0] "" Vector__XXX
 SG_ APP_sw341_validationRngVelInvalid m341 : 41|1@1+ (1,0) [0|0] "" Vector__XXX
 SG_ APP_sw343_statsMpathLvl m343 : 41|1@1+ (1,0) [0|0] "" Vector__XXX
 SG_ APP_sw346_seedSkipGyroErrModel m346 : 41|1@1+ (1,0) [0|0] "" Vector__XXX
 SG_ APP_sw407_fasciaVisionOcclusionAtStop m407 : 41|1@1+ (1,0) [0|0] "" Vector__XXX
 SG_ APP_sw408_flatTire m408 : 41|1@1+ (1,0) [0|0] "" Vector__XXX
 SG_ APP_sw409_driverNotPresentPreActivation m409 : 41|1@1+ (1,0) [0|0] "" Vector__XXX
 SG_ APP_sw410_vcleftDoorStatusCanMessageMia m410 : 41|1@1+ (1,0) [0|0] "" Vector__XXX
 SG_ APP_sw004_CamObjectsMIA m4 : 42|1@1+ (1,0) [0|0] "" Vector__XXX
 SG_ APP_sw005_camWatchdog m5 : 42|1@1+ (1,0) [0|0] "" Vector__XXX
 SG_ APP_sw006_steeringAngleRate m6 : 42|1@1+ (1,0) [0|0] "" Vector__XXX
 SG_ APP_sw012_mespFatalErrDetails m12 : 42|8@1+ (1,0) [0|0] "" Vector__XXX
 SG_ APP_sw015_SunRay m15 : 42|2@1+ (1,0) [0|0] "" Vector__XXX
 SG_ APP_sw042_cam_BlurredImage m42 : 42|1@1+ (1,0) [0|0] "" Vector__XXX
 SG_ APP_sw053_a36vehStndStllValidty m53 : 42|1@1+ (1,0) [0|0] "" Vector__XXX
 SG_ APP_sw062_unusedBits m62 : 42|6@1+ (1,0) [0|0] "" Vector__XXX
 SG_ APP_sw069_roadClass m69 : 42|4@1+ (1,0) [0|0] "" Vector__XXX
 SG_ APP_sw213_apIntStateAtTrigger m213 : 42|4@1+ (1,0) [0|0] "" Vector__XXX
 SG_ APP_sw286_gpsCfgIdFail m286 : 42|6@1+ (1,0) [0|0] "" Vector__XXX
 SG_ APP_sw328_parkMia m328 : 42|1@1+ (1,0) [0|0] "" Vector__XXX
 SG_ APP_sw329_laneChangeRight m329 : 42|1@1+ (1,0) [0|0] "" Vector__XXX
 SG_ APP_sw341_validationRngClose m341 : 42|1@1+ (1,0) [0|0] "" Vector__XXX
 SG_ APP_sw343_statsNumCfarDetections m343 : 42|1@1+ (1,0) [0|0] "" Vector__XXX
 SG_ APP_sw346_seedSkipGyroErrVarianc m346 : 42|1@1+ (1,0) [0|0] "" Vector__XXX
 SG_ APP_sw407_safetyDriverUnbuckled m407 : 42|1@1+ (1,0) [0|0] "" Vector__XXX
 SG_ APP_sw408_tirePressureHardWarning m408 : 42|1@1+ (1,0) [0|0] "" Vector__XXX
 SG_ APP_sw409_passengerUnexpectedRideInactive m409 : 42|1@1+ (1,0) [0|0] "" Vector__XXX
 SG_ APP_sw410_vcrightDoorStatusCanMessageMia m410 : 42|1@1+ (1,0) [0|0] "" Vector__XXX
 SG_ APP_sw004_CamWatchdog m4 : 43|1@1+ (1,0) [0|0] "" Vector__XXX
 SG_ APP_sw005_AutofixOutOfCalibHorzn m5 : 43|1@1+ (1,0) [0|0] "" Vector__XXX
 SG_ APP_sw006_speed m6 : 43|1@1+ (1,0) [0|0] "" Vector__XXX
 SG_ APP_sw026_uds_mean_utilization m26 : 43|7@1+ (1,0) [0|0] "" Vector__XXX
 SG_ APP_sw042_cam_LowSun m42 : 43|1@1+ (1,0) [0|0] "" Vector__XXX
 SG_ APP_sw053_a37vinValidity m53 : 43|1@1+ (1,0) [0|0] "" Vector__XXX
 SG_ APP_sw071_driverPresent m71 : 43|1@1+ (1,0) [0|0] "" Vector__XXX
 SG_ APP_sw080_ego_speed m80 : 43|5@1+ (1,0) [0|0] "" Vector__XXX
 SG_ APP_sw328_sccmMia m328 : 43|1@1+ (1,0) [0|0] "" Vector__XXX
 SG_ APP_sw329_leftLaneChngBehStatus m329 : 43|5@1+ (1,0) [0|0] "" Vector__XXX
 SG_ APP_sw341_validationRngInvalid m341 : 43|1@1+ (1,0) [0|0] "" Vector__XXX
 SG_ APP_sw343_statsNumSvdAz m343 : 43|1@1+ (1,0) [0|0] "" Vector__XXX
 SG_ APP_sw346_imuSanityCheckFailed m346 : 43|1@1+ (1,0) [0|0] "" Vector__XXX
 SG_ APP_sw407_visionFpsLow m407 : 43|1@1+ (1,0) [0|0] "" Vector__XXX
 SG_ APP_sw408_epbParkingAvailabilityFaulted m408 : 43|1@1+ (1,0) [0|0] "" Vector__XXX
 SG_ APP_sw409_waitingForPassengerEgress m409 : 43|1@1+ (1,0) [0|0] "" Vector__XXX
 SG_ APP_sw410_anyLeftDoorOpenButtonFaulted m410 : 43|1@1+ (1,0) [0|0] "" Vector__XXX
 SG_ APP_sw004_RadarLowVisibility m4 : 44|1@1+ (1,0) [0|0] "" Vector__XXX
 SG_ APP_sw005_RadarLowVisibility m5 : 44|1@1+ (1,0) [0|0] "" Vector__XXX
 SG_ APP_sw006_gear m6 : 44|1@1+ (1,0) [0|0] "" Vector__XXX
 SG_ APP_sw015_ImpairedVD m15 : 44|2@1+ (1,0) [0|0] "" Vector__XXX
 SG_ APP_sw042_cam_SmearedSpots m42 : 44|1@1+ (1,0) [0|0] "" Vector__XXX
 SG_ APP_sw053_a38whlRotValidity m53 : 44|1@1+ (1,0) [0|0] "" Vector__XXX
 SG_ APP_sw067_vehSpeed m67 : 44|12@1+ (0.1,-50) [0|0] "" Vector__XXX
 SG_ APP_sw071_airSuspension m71 : 44|3@1+ (1,0) [0|0] "" Vector__XXX
 SG_ APP_sw194_reasonForHold m194 : 44|4@1+ (1,0) [0|0] "" Vector__XXX
 SG_ APP_sw259_unusedN01 m259 : 44|4@1+ (1,0) [0|0] "" Vector__XXX
 SG_ APP_sw263_laneWidth m263 : 44|7@1+ (0.05,0) [0|0] "" Vector__XXX
 SG_ APP_sw328_scMia m328 : 44|1@1+ (1,0) [0|0] "" Vector__XXX
 SG_ APP_sw341_validationInternalError m341 : 44|1@1+ (1,0) [0|0] "" Vector__XXX
 SG_ APP_sw343_statsNumRMusicAz m343 : 44|1@1+ (1,0) [0|0] "" Vector__XXX
 SG_ APP_sw346_gnssSanityCheckFailed m346 : 44|1@1+ (1,0) [0|0] "" Vector__XXX
 SG_ APP_sw407_driverDoorOpen m407 : 44|1@1+ (1,0) [0|0] "" Vector__XXX
 SG_ APP_sw408_epbParkingAvailabilitySpeedInvalid m408 : 44|1@1+ (1,0) [0|0] "" Vector__XXX
 SG_ APP_sw409_unassignedPassengerUnbuckled m409 : 44|1@1+ (1,0) [0|0] "" Vector__XXX
 SG_ APP_sw410_anyRightDoorOpenButtonFaulted m410 : 44|1@1+ (1,0) [0|0] "" Vector__XXX
 SG_ APP_sw004_RadarMisalignment m4 : 45|1@1+ (1,0) [0|0] "" Vector__XXX
 SG_ APP_sw006_stabilityControl m6 : 45|1@1+ (1,0) [0|0] "" Vector__XXX
 SG_ APP_sw042_cam_PartialBlock m42 : 45|1@1+ (1,0) [0|0] "" Vector__XXX
 SG_ APP_sw053_a39whlSpdValidity m53 : 45|1@1+ (1,0) [0|0] "" Vector__XXX
 SG_ APP_sw143_targetRelAcceleration m143 : 45|8@1+ (0.1,-12.8) [0|0] "" Vector__XXX
 SG_ APP_sw231_targetRelAcceleration m231 : 45|8@1+ (0.1,-12.8) [0|0] "" Vector__XXX
 SG_ APP_sw328_ussOLONotEnabled m328 : 45|1@1+ (1,0) [0|0] "" Vector__XXX
 SG_ APP_sw341_validationFWError m341 : 45|1@1+ (1,0) [0|0] "" Vector__XXX
 SG_ APP_sw343_statsNumObjects m343 : 45|1@1+ (1,0) [0|0] "" Vector__XXX
 SG_ APP_sw346_smlImuDataGapDetected m346 : 45|1@1+ (1,0) [0|0] "" Vector__XXX
 SG_ APP_sw407_passengerDoorOpen m407 : 45|1@1+ (1,0) [0|0] "" Vector__XXX
 SG_ APP_sw408_epbParkingAvailabilityRequestPathDegraded m408 : 45|1@1+ (1,0) [0|0] "" Vector__XXX
 SG_ APP_sw409_notAuthenticatedForDrive m409 : 45|1@1+ (1,0) [0|0] "" Vector__XXX
 SG_ APP_sw410_sgkAutonomyStateNotInSync m410 : 45|1@1+ (1,0) [0|0] "" Vector__XXX
 SG_ APP_sw004_OutOfFocusImage m4 : 46|1@1+ (1,0) [0|0] "" Vector__XXX
 SG_ APP_sw006_dasDisabled m6 : 46|1@1+ (1,0) [0|0] "" Vector__XXX
 SG_ APP_sw010_unusedBits m10 : 46|2@1+ (1,0) [0|0] "" Vector__XXX
 SG_ APP_sw015_SelfGlare m15 : 46|2@1+ (1,0) [0|0] "" Vector__XXX
 SG_ APP_sw041_unusedW2 m41 : 46|18@1+ (1,0) [0|0] "" Vector__XXX
 SG_ APP_sw042_cam_Autofix m42 : 46|1@1+ (1,0) [0|0] "" Vector__XXX
 SG_ APP_sw053_a40whlStndStllValidty m53 : 46|1@1+ (1,0) [0|0] "" Vector__XXX
 SG_ APP_sw069_drivingLaneLeft m69 : 46|8@1+ (1,0) [0|0] "" Vector__XXX
 SG_ APP_sw145_camExtRollCal m145 : 46|9@1+ (0.05,-12.5) [0|0] "" Vector__XXX
 SG_ APP_sw283_goalDistance m283 : 46|10@1+ (0.1,0) [0|0] "" Vector__XXX
 SG_ APP_sw328_ussPASNotEnabled m328 : 46|1@1+ (1,0) [0|0] "" Vector__XXX
 SG_ APP_sw343_statsCmptTime m343 : 46|1@1+ (1,0) [0|0] "" Vector__XXX
 SG_ APP_sw346_wheelTickSeedNotUsed m346 : 46|1@1+ (1,0) [0|0] "" Vector__XXX
 SG_ APP_sw386_cipv2CollisionRunLength m386 : 46|5@1+ (1,0) [0|0] "" Vector__XXX
 SG_ APP_sw407_trunkOpen m407 : 46|1@1+ (1,0) [0|0] "" Vector__XXX
 SG_ APP_sw408_epbParkingAvailabilityUnknown m408 : 46|1@1+ (1,0) [0|0] "" Vector__XXX
 SG_ APP_sw409_coolantSystemNotReady m409 : 46|1@1+ (1,0) [0|0] "" Vector__XXX
 SG_ APP_sw410_apThermalModelFaultDetected m410 : 46|1@1+ (1,0) [0|0] "" Vector__XXX
 SG_ APP_sw004_ImpairedVD m4 : 47|1@1+ (1,0) [0|0] "" Vector__XXX
 SG_ APP_sw006_speedDerivative m6 : 47|1@1+ (1,0) [0|0] "" Vector__XXX
 SG_ APP_sw011_egoRightOfCenter m11 : 47|1@1+ (1,0) [0|0] "" Vector__XXX
 SG_ APP_sw018_railControl m18 : 47|1@1+ (1,0) [0|0] "" Vector__XXX
 SG_ APP_sw042_cam_AutofixHorizon m42 : 47|1@1+ (1,0) [0|0] "" Vector__XXX
 SG_ APP_sw053_a41wiperValidity m53 : 47|1@1+ (1,0) [0|0] "" Vector__XXX
 SG_ APP_sw060_hostLongAccel m60 : 47|4@1+ (1,-7.5) [0|0] "" Vector__XXX
 SG_ APP_sw085_averageSpeedHist m85 : 47|6@1+ (0.25,0) [0|0] "" Vector__XXX
 SG_ APP_sw328_ussOOCNotEnabled m328 : 47|1@1+ (1,0) [0|0] "" Vector__XXX
 SG_ APP_sw343_statsDoaMseAz m343 : 47|1@1+ (1,0) [0|0] "" Vector__XXX
 SG_ APP_sw346_wheelSpeedSeedNotUsed m346 : 47|1@1+ (1,0) [0|0] "" Vector__XXX
 SG_ APP_sw407_frunkOpen m407 : 47|1@1+ (1,0) [0|0] "" Vector__XXX
 SG_ APP_sw408_epbStatusNotParked m408 : 47|1@1+ (1,0) [0|0] "" Vector__XXX
 SG_ APP_sw409_defogSystemNotReady m409 : 47|1@1+ (1,0) [0|0] "" Vector__XXX
 SG_ APP_sw410_wheelSpeedsCanMessageMia m410 : 47|1@1+ (1,0) [0|0] "" Vector__XXX
 SG_ APP_sw001_APP_alertDataW2 m1 : 48|16@1+ (1,0) [0|0] "" Vector__XXX
 SG_ APP_sw004_SunRay m4 : 48|1@1+ (1,0) [0|0] "" Vector__XXX
 SG_ APP_sw006_camWatchdog m6 : 48|1@1+ (1,0) [0|0] "" Vector__XXX
 SG_ APP_sw010_VmaPlausibility m10 : 48|16@1+ (1.52587890625005e-05,0) [0|0] "" Vector__XXX
 SG_ APP_sw011_egoMovingRight m11 : 48|1@1+ (1,0) [0|0] "" Vector__XXX
 SG_ APP_sw013_highestSeqRecd m13 : 48|12@1+ (1,0) [0|0] "" Vector__XXX
 SG_ APP_sw014_assertData m14 : 48|16@1+ (1,0) [0|0] "" Vector__XXX
 SG_ APP_sw015_OutOfFocusImage m15 : 48|2@1+ (1,0) [0|0] "" Vector__XXX
 SG_ APP_sw016_hostLongAccel m16 : 48|7@1+ (0.15625,-10) [0|0] "" Vector__XXX
 SG_ APP_sw017_highestSeqRecd m17 : 48|12@1+ (1,0) [0|0] "" Vector__XXX
 SG_ APP_sw018_currentVoltage m18 : 48|16@1+ (1,0) [0|0] "" Vector__XXX
 SG_ APP_sw020_unusedW2 m20 : 48|16@1+ (1,0) [0|0] "" Vector__XXX
 SG_ APP_sw021_unusedWord m21 : 48|16@1+ (1,0) [0|0] "" Vector__XXX
 SG_ APP_sw025_torsionBarTorque m25 : 48|8@1+ (0.1,-12.8) [0|0] "" Vector__XXX
 SG_ APP_sw027_ESR0 m27 : 48|1@1+ (1,0) [0|0] "" Vector__XXX
 SG_ APP_sw028_multifrm_rx_len m28 : 48|16@1+ (1,0) [0|0] "" Vector__XXX
 SG_ APP_sw029_unusedW1 m29 : 48|16@1+ (1,0) [0|0] "" Vector__XXX
 SG_ APP_sw030_unusedW1 m30 : 48|16@1+ (1,0) [0|0] "" Vector__XXX
 SG_ APP_sw031_errorData2 m31 : 48|16@1+ (1,0) [0|0] "" Vector__XXX
 SG_ APP_sw032_errorData2 m32 : 48|16@1+ (1,0) [0|0] "" Vector__XXX
 SG_ APP_sw034_unusedW1 m34 : 48|16@1+ (1,0) [0|0] "" Vector__XXX
 SG_ APP_sw036_unusedW1 m36 : 48|16@1+ (1,0) [0|0] "" Vector__XXX
 SG_ APP_sw037_unusedW1 m37 : 48|16@1+ (1,0) [0|0] "" Vector__XXX
 SG_ APP_sw039_unusedW1 m39 : 48|16@1+ (1,0) [0|0] "" Vector__XXX
 SG_ APP_sw040_torsion_bar_torque m40 : 48|8@1+ (0.1,-12.8) [0|0] "" Vector__XXX
 SG_ APP_sw042_cam_AutofixYaw m42 : 48|1@1+ (1,0) [0|0] "" Vector__XXX
 SG_ APP_sw043_camLongRunTime_unused m43 : 48|16@1+ (1,0) [0|0] "" Vector__XXX
 SG_ APP_sw047_edrStateMachine m47 : 48|8@1+ (1,0) [0|0] "" Vector__XXX
 SG_ APP_sw049_ffs_version_msw m49 : 48|16@1+ (1,0) [0|0] "" Vector__XXX
 SG_ APP_sw050_hostLongAccel m50 : 48|7@1+ (0.15625,-10) [0|0] "" Vector__XXX
 SG_ APP_sw051_unusedW1 m51 : 48|16@1+ (1,0) [0|0] "" Vector__XXX
 SG_ APP_sw053_a42xwdValidity m53 : 48|1@1+ (1,0) [0|0] "" Vector__XXX
 SG_ APP_sw054_unusedW0 m54 : 48|16@1+ (1,0) [0|0] "" Vector__XXX
 SG_ APP_sw055_expectedCrcLsw m55 : 48|16@1+ (1,0) [0|0] "" Vector__XXX
 SG_ APP_sw056_unusedW1 m56 : 48|16@1+ (1,0) [0|0] "" Vector__XXX
 SG_ APP_sw058_unusedW1 m58 : 48|16@1+ (1,0) [0|0] "" Vector__XXX
 SG_ APP_sw062_VmaPlausibility m62 : 48|16@1+ (1.52587890625005e-05,0) [0|0] "" Vector__XXX
 SG_ APP_sw063_expectedSubMinorVer m63 : 48|8@1+ (1,0) [0|0] "" Vector__XXX
 SG_ APP_sw065_unusedW1 m65 : 48|16@1+ (1,0) [0|0] "" Vector__XXX
 SG_ APP_sw066_unusedW1 m66 : 48|16@1+ (1,0) [0|0] "" Vector__XXX
 SG_ APP_sw071_temperature m71 : 48|8@1+ (0.5,-40) [0|0] "" Vector__XXX
 SG_ APP_sw072_endDistance m72 : 48|8@1+ (1,0) [0|0] "" Vector__XXX
 SG_ APP_sw073_freespaceRightC1 m73 : 48|8@1+ (0.0016,-0.2) [0|0] "" Vector__XXX
 SG_ APP_sw074_ipsoConfidence m74 : 48|6@1+ (2,0) [0|0] "" Vector__XXX
 SG_ APP_sw075_unusedW1 m75 : 48|16@1+ (1,0) [0|0] "" Vector__XXX
 SG_ APP_sw076_hostLongAccel m76 : 48|7@1+ (0.15625,-10) [0|0] "" Vector__XXX
 SG_ APP_sw077_oocUntrackedTime m77 : 48|6@1+ (0.1,0) [0|0] "" Vector__XXX
 SG_ APP_sw078_radarTarg1_dx m78 : 48|8@1+ (0.0625,0) [0|0] "" Vector__XXX
 SG_ APP_sw080_cipv_valid m80 : 48|1@1+ (1,0) [0|0] "" Vector__XXX
 SG_ APP_sw081_pedalPosition m81 : 48|7@1+ (1,0) [0|0] "" Vector__XXX
 SG_ APP_sw082_road_class m82 : 48|3@1+ (1,0) [0|0] "" Vector__XXX
 SG_ APP_sw083_Targ5_dz m83 : 48|6@1+ (0.25,-5) [0|0] "" Vector__XXX
 SG_ APP_sw086_ellipseAge m86 : 48|3@1+ (1,0) [0|0] "" Vector__XXX
 SG_ APP_sw103_distanceEllipse m103 : 48|8@1+ (0.5,0) [0|0] "" Vector__XXX
 SG_ APP_sw182_minTemperature m182 : 48|8@1+ (1,-60) [0|0] "" Vector__XXX
 SG_ APP_sw183_minTemperature m183 : 48|8@1+ (1,-60) [0|0] "" Vector__XXX
 SG_ APP_sw184_minTemperature m184 : 48|8@1+ (1,-60) [0|0] "" Vector__XXX
 SG_ APP_sw185_minTemperature m185 : 48|8@1+ (1,-60) [0|0] "" Vector__XXX
 SG_ APP_sw186_minTemperature m186 : 48|8@1+ (1,-60) [0|0] "" Vector__XXX
 SG_ APP_sw187_minTemperature m187 : 48|8@1+ (1,-60) [0|0] "" Vector__XXX
 SG_ APP_sw188_minTemperature m188 : 48|8@1+ (1,-60) [0|0] "" Vector__XXX
 SG_ APP_sw189_minTemperature m189 : 48|8@1+ (1,-60) [0|0] "" Vector__XXX
 SG_ APP_sw190_minTemperature m190 : 48|8@1+ (1,-60) [0|0] "" Vector__XXX
 SG_ APP_sw191_roadClass m191 : 48|3@1+ (1,0) [0|0] "" Vector__XXX
 SG_ APP_sw194_timeInHold m194 : 48|16@1+ (1,0) [0|0] "" Vector__XXX
 SG_ APP_sw201_viewRangeOAL m201 : 48|3@1+ (1,0) [0|0] "" Vector__XXX
 SG_ APP_sw204_frRightMiddle m204 : 48|8@1+ (1,0) [0|0] "" Vector__XXX
 SG_ APP_sw205_rrRight m205 : 48|8@1+ (1,0) [0|0] "" Vector__XXX
 SG_ APP_sw213_takeoverDuration m213 : 48|8@1+ (0.5,0) [0|0] "" Vector__XXX
 SG_ APP_sw257_driver_reaction_time m257 : 48|8@1+ (0.02,0) [0|0] "" Vector__XXX
 SG_ APP_sw258_ego_acceleration m258 : 48|8@1+ (0.1,-15.5) [0|0] "" Vector__XXX
 SG_ APP_sw259_unusedB02 m259 : 48|8@1+ (1,0) [0|0] "" Vector__XXX
 SG_ APP_sw260_driver_reaction_time m260 : 48|8@1+ (0.02,0) [0|0] "" Vector__XXX
 SG_ APP_sw269_blindspot m269 : 48|5@1+ (1,0) [0|0] "" Vector__XXX
 SG_ APP_sw270_blindspot m270 : 48|5@1+ (1,0) [0|0] "" Vector__XXX
 SG_ APP_sw274_minTemperature m274 : 48|8@1+ (1,-60) [0|0] "" Vector__XXX
 SG_ APP_sw275_minTemperature m275 : 48|8@1+ (1,-60) [0|0] "" Vector__XXX
 SG_ APP_sw276_minTemperature m276 : 48|8@1+ (1,-60) [0|0] "" Vector__XXX
 SG_ APP_sw277_minTemperature m277 : 48|8@1+ (1,-60) [0|0] "" Vector__XXX
 SG_ APP_sw278_minTemperature m278 : 48|8@1+ (1,-60) [0|0] "" Vector__XXX
 SG_ APP_sw279_minTemperature m279 : 48|8@1+ (1,-60) [0|0] "" Vector__XXX
 SG_ APP_sw280_minTemperature m280 : 48|8@1+ (1,-60) [0|0] "" Vector__XXX
 SG_ APP_sw281_minTemperature m281 : 48|8@1+ (1,-60) [0|0] "" Vector__XXX
 SG_ APP_sw282_minTemperature m282 : 48|8@1+ (1,-60) [0|0] "" Vector__XXX
 SG_ APP_sw286_gpsSetCfgNoAck m286 : 48|1@1+ (1,0) [0|0] "" Vector__XXX
 SG_ APP_sw328_ussTemporaryFault m328 : 48|1@1+ (1,0) [0|0] "" Vector__XXX
 SG_ APP_sw329_rightLaneChngBehStatus m329 : 48|5@1+ (1,0) [0|0] "" Vector__XXX
 SG_ APP_sw335_RfSensorMia m335 : 48|1@1+ (1,0) [0|0] "" Vector__XXX
 SG_ APP_sw337_outCurr m337 : 48|16@1+ (1,0) [0|0] "" Vector__XXX
 SG_ APP_sw339_rfSensor1Temp m339 : 48|16@1- (0.1,50) [0|0] "" Vector__XXX
 SG_ APP_sw343_statsDoaMseEl m343 : 48|1@1+ (1,0) [0|0] "" Vector__XXX
 SG_ APP_sw346_excessiveGpsSwEvent m346 : 48|1@1+ (1,0) [0|0] "" Vector__XXX
 SG_ APP_sw350_misalignmentOutOfTrackerBounds m350 : 48|1@1+ (1,0) [0|0] "" Vector__XXX
 SG_ APP_sw354_avgObjPerFrame m354 : 48|12@1+ (1,0) [0|0] "" Vector__XXX
 SG_ APP_sw387_rangeSquaredCdf m387 : 48|7@1+ (0.02,-1) [0|0] "" Vector__XXX
 SG_ APP_sw407_notPowerStateDrive m407 : 48|1@1+ (1,0) [0|0] "" Vector__XXX
 SG_ APP_sw408_diLosingPropulsion m408 : 48|1@1+ (1,0) [0|0] "" Vector__XXX
 SG_ APP_sw409_coolantSystemUnhealthy m409 : 48|1@1+ (1,0) [0|0] "" Vector__XXX
 SG_ APP_sw410_allWheelSpeedsSensorsFaulted m410 : 48|1@1+ (1,0) [0|0] "" Vector__XXX
 SG_ APP_sw004_Splashes m4 : 49|1@1+ (1,0) [0|0] "" Vector__XXX
 SG_ APP_sw006_camObjHeader m6 : 49|1@1+ (1,0) [0|0] "" Vector__XXX
 SG_ APP_sw011_egoLeftOfCenter m11 : 49|1@1+ (1,0) [0|0] "" Vector__XXX
 SG_ APP_sw027_ESR1 m27 : 49|1@1+ (1,0) [0|0] "" Vector__XXX
 SG_ APP_sw042_cam_FullBlock m42 : 49|1@1+ (1,0) [0|0] "" Vector__XXX
 SG_ APP_sw053_a43yawOffValidity m53 : 49|1@1+ (1,0) [0|0] "" Vector__XXX
 SG_ APP_sw080_min_speed_check m80 : 49|1@1+ (1,0) [0|0] "" Vector__XXX
 SG_ APP_sw199_internalState m199 : 49|4@1+ (1,0) [0|0] "" Vector__XXX
 SG_ APP_sw273_timeToLaneExit m273 : 49|7@1+ (0.02,0) [0|0] "" Vector__XXX
 SG_ APP_sw286_gpsReadCfgNoResponse m286 : 49|1@1+ (1,0) [0|0] "" Vector__XXX
 SG_ APP_sw328_ussSystemError m328 : 49|1@1+ (1,0) [0|0] "" Vector__XXX
 SG_ APP_sw335_txBallbreakMonErr m335 : 49|1@1+ (1,0) [0|0] "" Vector__XXX
 SG_ APP_sw343_genObjRadarLoc m343 : 49|1@1+ (1,0) [0|0] "" Vector__XXX
 SG_ APP_sw350_trackerCannotEstimateMisalignment m350 : 49|1@1+ (1,0) [0|0] "" Vector__XXX
 SG_ APP_sw407_cruiseUnavailable m407 : 49|1@1+ (1,0) [0|0] "" Vector__XXX
 SG_ APP_sw408_diVdcStateNotNormal m408 : 49|1@1+ (1,0) [0|0] "" Vector__XXX
 SG_ APP_sw409_defogSystemUnhealthy m409 : 49|1@1+ (1,0) [0|0] "" Vector__XXX
 SG_ APP_sw410_diAutonomyHealthCanMessageMia m410 : 49|1@1+ (1,0) [0|0] "" Vector__XXX
 SG_ APP_sw004_BlurredImage m4 : 50|1@1+ (1,0) [0|0] "" Vector__XXX
 SG_ APP_sw006_camCommonMsg m6 : 50|1@1+ (1,0) [0|0] "" Vector__XXX
 SG_ APP_sw011_egoMovingLeft m11 : 50|1@1+ (1,0) [0|0] "" Vector__XXX
 SG_ APP_sw012_mespDDRTempStatus m12 : 50|3@1+ (1,0) [0|0] "" Vector__XXX
 SG_ APP_sw015_MainCameraLowLight m15 : 50|2@1+ (1,0) [0|0] "" Vector__XXX
 SG_ APP_sw026_mob_mean_utilization m26 : 50|7@1+ (1,0) [0|0] "" Vector__XXX
 SG_ APP_sw027_SW m27 : 50|1@1+ (1,0) [0|0] "" Vector__XXX
 SG_ APP_sw042_cam_SmearedHalos m42 : 50|1@1+ (1,0) [0|0] "" Vector__XXX
 SG_ APP_sw053_a44yawValidity m53 : 50|1@1+ (1,0) [0|0] "" Vector__XXX
 SG_ APP_sw080_cruise_lever_state m80 : 50|3@1+ (1,0) [0|0] "" Vector__XXX
 SG_ APP_sw286_ubxErrorReported m286 : 50|1@1+ (1,0) [0|0] "" Vector__XXX
 SG_ APP_sw328_ussFault m328 : 50|1@1+ (1,0) [0|0] "" Vector__XXX
 SG_ APP_sw335_txGainPhaseMonErr m335 : 50|1@1+ (1,0) [0|0] "" Vector__XXX
 SG_ APP_sw343_genObjWriteLUT m343 : 50|1@1+ (1,0) [0|0] "" Vector__XXX
 SG_ APP_sw350_radarAlignmentAccessStatus m350 : 50|2@1+ (1,3) [0|0] "" Vector__XXX
 SG_ APP_sw407_cruiseNotActive m407 : 50|1@1+ (1,0) [0|0] "" Vector__XXX
 SG_ APP_sw408_diBrakingDecelerationUnavailable m408 : 50|1@1+ (1,0) [0|0] "" Vector__XXX
 SG_ APP_sw409_diSpeedCanMessageMia m409 : 50|1@1+ (1,0) [0|0] "" Vector__XXX
 SG_ APP_sw410_devPulloverOverrideActive m410 : 50|1@1+ (1,0) [0|0] "" Vector__XXX
 SG_ APP_sw004_LowSun m4 : 51|1@1+ (1,0) [0|0] "" Vector__XXX
 SG_ APP_sw006_camFcwPcwMsg m6 : 51|1@1+ (1,0) [0|0] "" Vector__XXX
 SG_ APP_sw011_polyValid m11 : 51|1@1+ (1,0) [0|0] "" Vector__XXX
 SG_ APP_sw027_STM0 m27 : 51|1@1+ (1,0) [0|0] "" Vector__XXX
 SG_ APP_sw042_cam_FoggySpots m42 : 51|1@1+ (1,0) [0|0] "" Vector__XXX
 SG_ APP_sw053_a48steerAngOffSanity m53 : 51|1@1+ (1,0) [0|0] "" Vector__XXX
 SG_ APP_sw060_RadarAssociationAge m60 : 51|4@1+ (100,0) [0|0] "" Vector__XXX
 SG_ APP_sw086_activeBraking m86 : 51|1@1+ (1,0) [0|0] "" Vector__XXX
 SG_ APP_sw191_referenceHealth m191 : 51|2@1+ (1,0) [0|0] "" Vector__XXX
 SG_ APP_sw263_vdcActive m263 : 51|1@1+ (1,0) [0|0] "" Vector__XXX
 SG_ APP_sw328_ussStatusOutOfDate m328 : 51|1@1+ (1,0) [0|0] "" Vector__XXX
 SG_ APP_sw335_rxGainPhaseMonErr m335 : 51|1@1+ (1,0) [0|0] "" Vector__XXX
 SG_ APP_sw343_invalidEgoSpeed m343 : 51|1@1+ (1,0) [0|0] "" Vector__XXX
 SG_ APP_sw386_egoSpeed m386 : 51|6@1+ (1,8) [0|0] "" Vector__XXX
 SG_ APP_sw407_cruiseFault m407 : 51|1@1+ (1,0) [0|0] "" Vector__XXX
 SG_ APP_sw408_apRedundancyUnavailable m408 : 51|1@1+ (1,0) [0|0] "" Vector__XXX
 SG_ APP_sw409_cameraRedundancyNotReady m409 : 51|1@1+ (1,0) [0|0] "" Vector__XXX
 SG_ APP_sw410_imuRedundancyLost m410 : 51|1@1+ (1,0) [0|0] "" Vector__XXX
 SG_ APP_sw004_SmearedSpots m4 : 52|1@1+ (1,0) [0|0] "" Vector__XXX
 SG_ APP_sw006_longAccel m6 : 52|1@1+ (1,0) [0|0] "" Vector__XXX
 SG_ APP_sw011_egoCentered m11 : 52|1@1+ (1,0) [0|0] "" Vector__XXX
 SG_ APP_sw015_NarrowCameraLowLight m15 : 52|2@1+ (1,0) [0|0] "" Vector__XXX
 SG_ APP_sw027_STM1 m27 : 52|1@1+ (1,0) [0|0] "" Vector__XXX
 SG_ APP_sw042_cam_SelfGlare m42 : 52|1@1+ (1,0) [0|0] "" Vector__XXX
 SG_ APP_sw053_a49tireSizeSanity m53 : 52|1@1+ (1,0) [0|0] "" Vector__XXX
 SG_ APP_sw203_vehicleSkew m203 : 52|12@1+ (0.002,0) [0|0] "" Vector__XXX
 SG_ APP_sw263_construction m263 : 52|1@1+ (1,0) [0|0] "" Vector__XXX
 SG_ APP_sw328_perceptionUnhealthy m328 : 52|1@1+ (1,0) [0|0] "" Vector__XXX
 SG_ APP_sw335_sync20GPowerMonErr m335 : 52|1@1+ (1,0) [0|0] "" Vector__XXX
 SG_ APP_sw343_genObjElInvalidObj m343 : 52|1@1+ (1,0) [0|0] "" Vector__XXX
 SG_ APP_sw407_epasEacUnavailable m407 : 52|1@1+ (1,0) [0|0] "" Vector__XXX
 SG_ APP_sw408_headlightsNotAimed m408 : 52|1@1+ (1,0) [0|0] "" Vector__XXX
 SG_ APP_sw409_audioBusDown m409 : 52|1@1+ (1,0) [0|0] "" Vector__XXX
 SG_ APP_sw410_noImuSourcesAvailable m410 : 52|1@1+ (1,0) [0|0] "" Vector__XXX
 SG_ APP_sw004_PartialBlockage m4 : 53|1@1+ (1,0) [0|0] "" Vector__XXX
 SG_ APP_sw006_yawRate m6 : 53|1@1+ (1,0) [0|0] "" Vector__XXX
 SG_ APP_sw011_scaReasonEldw m11 : 53|1@1+ (1,0) [0|0] "" Vector__XXX
 SG_ APP_sw012_freescaleTemp m12 : 53|8@1- (1,0) [0|0] "" Vector__XXX
 SG_ APP_sw027_STM2 m27 : 53|1@1+ (1,0) [0|0] "" Vector__XXX
 SG_ APP_sw042_cam_OutofFocus m42 : 53|1@1+ (1,0) [0|0] "" Vector__XXX
 SG_ APP_sw053_a50velocitySanity m53 : 53|1@1+ (1,0) [0|0] "" Vector__XXX
 SG_ APP_sw080_cruise_speed_check m80 : 53|1@1+ (1,0) [0|0] "" Vector__XXX
 SG_ APP_sw085_freeSpaceC0Left m85 : 53|5@1+ (1,-15) [0|0] "" Vector__XXX
 SG_ APP_sw143_targetIsACar m143 : 53|1@1+ (1,0) [0|0] "" Vector__XXX
 SG_ APP_sw191_solverHealth m191 : 53|2@1+ (1,0) [0|0] "" Vector__XXX
 SG_ APP_sw199_maxSpeed m199 : 53|7@1+ (0.2,-12.2) [0|0] "" Vector__XXX
 SG_ APP_sw231_targetIsACar m231 : 53|1@1+ (1,0) [0|0] "" Vector__XXX
 SG_ APP_sw263_snowyRoad m263 : 53|1@1+ (1,0) [0|0] "" Vector__XXX
 SG_ APP_sw328_drivableSpaceUnhealthy m328 : 53|1@1+ (1,0) [0|0] "" Vector__XXX
 SG_ APP_sw335_rfTempMonErr m335 : 53|1@1+ (1,0) [0|0] "" Vector__XXX
 SG_ APP_sw343_genObjElMaxNumObjHit m343 : 53|1@1+ (1,0) [0|0] "" Vector__XXX
 SG_ APP_sw407_epasEacNotActive m407 : 53|1@1+ (1,0) [0|0] "" Vector__XXX
 SG_ APP_sw408_lowBeamLightFaulted m408 : 53|1@1+ (1,0) [0|0] "" Vector__XXX
 SG_ APP_sw409_autonomousBehaviorsTaskSuspending m409 : 53|1@1+ (1,0) [0|0] "" Vector__XXX
 SG_ APP_sw410_tamperingDetected m410 : 53|1@1+ (1,0) [0|0] "" Vector__XXX
 SG_ APP_sw004_AutofixOutOfCalib m4 : 54|1@1+ (1,0) [0|0] "" Vector__XXX
 SG_ APP_sw006_DIaebState_SNA m6 : 54|1@1+ (1,0) [0|0] "" Vector__XXX
 SG_ APP_sw015_MainCameraBadAssoc m15 : 54|2@1+ (1,0) [0|0] "" Vector__XXX
 SG_ APP_sw027_CBS_SYSTEM m27 : 54|1@1+ (1,0) [0|0] "" Vector__XXX
 SG_ APP_sw042_road_match m42 : 54|1@1+ (1,0) [0|0] "" Vector__XXX
 SG_ APP_sw053_a51yawSanity m53 : 54|1@1+ (1,0) [0|0] "" Vector__XXX
 SG_ APP_sw069_drivingLaneRight m69 : 54|8@1+ (1,0) [0|0] "" Vector__XXX
 SG_ APP_sw074_ipsowExist m74 : 54|5@1+ (1,0) [0|0] "" Vector__XXX
 SG_ APP_sw077_oocOffCourseDist_cm m77 : 54|10@1- (1,0) [0|0] "" Vector__XXX
 SG_ APP_sw083_Targ5_wObj m83 : 54|5@1+ (0.03125,0) [0|0] "" Vector__XXX
 SG_ APP_sw143_egoVehicleSpeed m143 : 54|5@1+ (5,0) [0|0] "" Vector__XXX
 SG_ APP_sw231_egoVehicleSpeed m231 : 54|5@1+ (5,0) [0|0] "" Vector__XXX
 SG_ APP_sw263_sideObstacle m263 : 54|1@1+ (1,0) [0|0] "" Vector__XXX
 SG_ APP_sw328_uiDisplayNotOk m328 : 54|1@1+ (1,0) [0|0] "" Vector__XXX
 SG_ APP_sw343_arrProcInvalidNum m343 : 54|1@1+ (1,0) [0|0] "" Vector__XXX
 SG_ APP_sw407_epasDriverlessModeNotActive m407 : 54|1@1+ (1,0) [0|0] "" Vector__XXX
 SG_ APP_sw408_highBeamLightFaulted m408 : 54|1@1+ (1,0) [0|0] "" Vector__XXX
 SG_ APP_sw409_hvDriveNoRestart m409 : 54|1@1+ (1,0) [0|0] "" Vector__XXX
 SG_ APP_sw410_cabinCameraIrLedFaulted m410 : 54|1@1+ (1,0) [0|0] "" Vector__XXX
 SG_ APP_sw004_AutofixOutOfCalibHorzn m4 : 55|1@1+ (1,0) [0|0] "" Vector__XXX
 SG_ APP_sw006_DIaebStateUnavailable m6 : 55|1@1+ (1,0) [0|0] "" Vector__XXX
 SG_ APP_sw016_driverPressedAccelPed m16 : 55|1@1+ (1,0) [0|0] "" Vector__XXX
 SG_ APP_sw027_CBS_DEBUG m27 : 55|1@1+ (1,0) [0|0] "" Vector__XXX
 SG_ APP_sw042_controlled_access m42 : 55|1@1+ (1,0) [0|0] "" Vector__XXX
 SG_ APP_sw050_driverPressedAccelPed m50 : 55|1@1+ (1,0) [0|0] "" Vector__XXX
 SG_ APP_sw053_a53espmodValidity m53 : 55|1@1+ (1,0) [0|0] "" Vector__XXX
 SG_ APP_sw060_driverPressedBrakePed m60 : 55|1@1+ (1,0) [0|0] "" Vector__XXX
 SG_ APP_sw076_driverPressedAccelPed m76 : 55|1@1+ (1,0) [0|0] "" Vector__XXX
 SG_ APP_sw191_roadEstHealth m191 : 55|2@1+ (1,0) [0|0] "" Vector__XXX
 SG_ APP_sw263_frontObstacle m263 : 55|1@1+ (1,0) [0|0] "" Vector__XXX
 SG_ APP_sw328_externalLightsOff m328 : 55|1@1+ (1,0) [0|0] "" Vector__XXX
 SG_ APP_sw343_exceedEstTargets m343 : 55|1@1+ (1,0) [0|0] "" Vector__XXX
 SG_ APP_sw407_epasRedundancyLost m407 : 55|1@1+ (1,0) [0|0] "" Vector__XXX
 SG_ APP_sw408_lowBeamLightFaultedInLowVis m408 : 55|1@1+ (1,0) [0|0] "" Vector__XXX
 SG_ APP_sw409_vehicleLosingHv m409 : 55|1@1+ (1,0) [0|0] "" Vector__XXX
 SG_ APP_sw410_cameraExposureMismatch m410 : 55|1@1+ (1,0) [0|0] "" Vector__XXX
 SG_ APP_sw004_AutofixOutOfCalibYaw m4 : 56|1@1+ (1,0) [0|0] "" Vector__XXX
 SG_ APP_sw006_brakeLights m6 : 56|1@1+ (1,0) [0|0] "" Vector__XXX
 SG_ APP_sw011_laneWidth m11 : 56|8@1+ (0.025,0) [0|0] "" Vector__XXX
 SG_ APP_sw015_NarrowCameraBadAssoc m15 : 56|2@1+ (1,0) [0|0] "" Vector__XXX
 SG_ APP_sw016_driverPressedBrakePed m16 : 56|1@1+ (1,0) [0|0] "" Vector__XXX
 SG_ APP_sw027_CBS_APP m27 : 56|1@1+ (1,0) [0|0] "" Vector__XXX
 SG_ APP_sw040_view_range m40 : 56|8@1+ (1,0) [0|0] "" Vector__XXX
 SG_ APP_sw042_road_class m42 : 56|3@1+ (1,0) [0|0] "" Vector__XXX
 SG_ APP_sw047_edrLoggerBuffer m47 : 56|2@1+ (1,0) [0|0] "" Vector__XXX
 SG_ APP_sw050_driverPressedBrakePed m50 : 56|1@1+ (1,0) [0|0] "" Vector__XXX
 SG_ APP_sw053_a54gtwmodValidity m53 : 56|1@1+ (1,0) [0|0] "" Vector__XXX
 SG_ APP_sw060_overrideAccelPed m60 : 56|1@1+ (1,0) [0|0] "" Vector__XXX
 SG_ APP_sw063_detectedSubMinorVer m63 : 56|8@1+ (1,0) [0|0] "" Vector__XXX
 SG_ APP_sw067_offsetEstimator m67 : 56|8@1+ (0.1,-12.8) [0|0] "" Vector__XXX
 SG_ APP_sw071_activationType m71 : 56|2@1+ (1,0) [0|0] "" Vector__XXX
 SG_ APP_sw072_guidanceComplete m72 : 56|1@1+ (1,0) [0|0] "" Vector__XXX
 SG_ APP_sw073_freespaceLeftFarZ m73 : 56|4@1+ (4,0) [0|0] "" Vector__XXX
 SG_ APP_sw076_driverPressedBrakePed m76 : 56|1@1+ (1,0) [0|0] "" Vector__XXX
 SG_ APP_sw078_radarTarg1_VxRel m78 : 56|8@1+ (0.2,-25.6) [0|0] "" Vector__XXX
 SG_ APP_sw103_ipsoApproved m103 : 56|1@1+ (1,0) [0|0] "" Vector__XXX
 SG_ APP_sw182_maxTemperature m182 : 56|8@1+ (1,-60) [0|0] "" Vector__XXX
 SG_ APP_sw183_maxTemperature m183 : 56|8@1+ (1,-60) [0|0] "" Vector__XXX
 SG_ APP_sw184_maxTemperature m184 : 56|8@1+ (1,-60) [0|0] "" Vector__XXX
 SG_ APP_sw185_maxTemperature m185 : 56|8@1+ (1,-60) [0|0] "" Vector__XXX
 SG_ APP_sw186_maxTemperature m186 : 56|8@1+ (1,-60) [0|0] "" Vector__XXX
 SG_ APP_sw187_maxTemperature m187 : 56|8@1+ (1,-60) [0|0] "" Vector__XXX
 SG_ APP_sw188_maxTemperature m188 : 56|8@1+ (1,-60) [0|0] "" Vector__XXX
 SG_ APP_sw189_maxTemperature m189 : 56|8@1+ (1,-60) [0|0] "" Vector__XXX
 SG_ APP_sw190_maxTemperature m190 : 56|8@1+ (1,-60) [0|0] "" Vector__XXX
 SG_ APP_sw204_maxSpeed m204 : 56|8@1+ (0.1,-12.2) [0|0] "" Vector__XXX
 SG_ APP_sw205_rrRightMiddle m205 : 56|8@1+ (1,0) [0|0] "" Vector__XXX
 SG_ APP_sw257_driver_reqd_accel m257 : 56|6@1+ (0.2,-12.6) [0|0] "" Vector__XXX
 SG_ APP_sw258_driver_reqd_accel m258 : 56|8@1+ (0.05,-12.75) [0|0] "" Vector__XXX
 SG_ APP_sw259_unusedB03 m259 : 56|8@1+ (1,0) [0|0] "" Vector__XXX
 SG_ APP_sw260_driver_reqd_accel m260 : 56|6@1+ (0.2,-12.6) [0|0] "" Vector__XXX
 SG_ APP_sw263_turnIndicatorOn m263 : 56|1@1+ (1,0) [0|0] "" Vector__XXX
 SG_ APP_sw269_laneDepartureWarning m269 : 56|5@1+ (1,0) [0|0] "" Vector__XXX
 SG_ APP_sw270_laneDepartureWarning m270 : 56|5@1+ (1,0) [0|0] "" Vector__XXX
 SG_ APP_sw273_distanceToLaneExit m273 : 56|8@1- (0.02,0) [0|0] "" Vector__XXX
 SG_ APP_sw274_maxTemperature m274 : 56|8@1+ (1,-60) [0|0] "" Vector__XXX
 SG_ APP_sw275_maxTemperature m275 : 56|8@1+ (1,-60) [0|0] "" Vector__XXX
 SG_ APP_sw276_maxTemperature m276 : 56|8@1+ (1,-60) [0|0] "" Vector__XXX
 SG_ APP_sw277_maxTemperature m277 : 56|8@1+ (1,-60) [0|0] "" Vector__XXX
 SG_ APP_sw278_maxTemperature m278 : 56|8@1+ (1,-60) [0|0] "" Vector__XXX
 SG_ APP_sw279_maxTemperature m279 : 56|8@1+ (1,-60) [0|0] "" Vector__XXX
 SG_ APP_sw280_maxTemperature m280 : 56|8@1+ (1,-60) [0|0] "" Vector__XXX
 SG_ APP_sw281_maxTemperature m281 : 56|8@1+ (1,-60) [0|0] "" Vector__XXX
 SG_ APP_sw282_maxTemperature m282 : 56|8@1+ (1,-60) [0|0] "" Vector__XXX
 SG_ APP_sw283_mainCam m283 : 56|1@1+ (1,0) [0|0] "" Vector__XXX
 SG_ APP_sw328_forwardCamerasBlinded m328 : 56|1@1+ (1,0) [0|0] "" Vector__XXX
 SG_ APP_sw343_runtimeCalibDataInvalid m343 : 56|1@1+ (1,0) [0|0] "" Vector__XXX
 SG_ APP_sw407_epasSystemTorqueReduced m407 : 56|1@1+ (1,0) [0|0] "" Vector__XXX
 SG_ APP_sw408_highBeamLightFaultedInLowVis m408 : 56|1@1+ (1,0) [0|0] "" Vector__XXX
 SG_ APP_sw409_bmsCanMessagesMia m409 : 56|1@1+ (1,0) [0|0] "" Vector__XXX
 SG_ APP_sw410_ssdClipLoggingInactive m410 : 56|1@1+ (1,0) [0|0] "" Vector__XXX
 SG_ APP_sw004_FullBlockage m4 : 57|1@1+ (1,0) [0|0] "" Vector__XXX
 SG_ APP_sw006_trailerMode m6 : 57|1@1+ (1,0) [0|0] "" Vector__XXX
 SG_ APP_sw016_overrideAccelPed m16 : 57|1@1+ (1,0) [0|0] "" Vector__XXX
 SG_ APP_sw026_veh_mean_utilization m26 : 57|7@1+ (1,0) [0|0] "" Vector__XXX
 SG_ APP_sw027_EVR13 m27 : 57|1@1+ (1,0) [0|0] "" Vector__XXX
 SG_ APP_sw050_overrideAccelPed m50 : 57|1@1+ (1,0) [0|0] "" Vector__XXX
 SG_ APP_sw053_a55stwmodValidity m53 : 57|1@1+ (1,0) [0|0] "" Vector__XXX
 SG_ APP_sw060_overrideBlinker m60 : 57|1@1+ (1,0) [0|0] "" Vector__XXX
 SG_ APP_sw072_guidanceRunaway m72 : 57|1@1+ (1,0) [0|0] "" Vector__XXX
 SG_ APP_sw076_overrideAccelPed m76 : 57|1@1+ (1,0) [0|0] "" Vector__XXX
 SG_ APP_sw103_constArea m103 : 57|2@1+ (1,0) [0|0] "" Vector__XXX
 SG_ APP_sw191_roadEstMode m191 : 57|2@1+ (1,0) [0|0] "" Vector__XXX
 SG_ APP_sw263_vehicleMuLow m263 : 57|1@1+ (1,0) [0|0] "" Vector__XXX
 SG_ APP_sw283_narrowCam m283 : 57|1@1+ (1,0) [0|0] "" Vector__XXX
 SG_ APP_sw328_backupCameraBlinded m328 : 57|1@1+ (1,0) [0|0] "" Vector__XXX
 SG_ APP_sw343_cfarInvalidSM m343 : 57|1@1+ (1,0) [0|0] "" Vector__XXX
 SG_ APP_sw386_radarSenseMode m386 : 57|2@1+ (1,3) [0|0] "" Vector__XXX
 SG_ APP_sw407_navGoalInvalid m407 : 57|1@1+ (1,0) [0|0] "" Vector__XXX
 SG_ APP_sw408_brakeLightFaulted m408 : 57|1@1+ (1,0) [0|0] "" Vector__XXX
 SG_ APP_sw409_cameraPreconditioningIncomplete m409 : 57|1@1+ (1,0) [0|0] "" Vector__XXX
 SG_ APP_sw410_selfNetworkDecryptionNotReady m410 : 57|1@1+ (1,0) [0|0] "" Vector__XXX
 SG_ APP_sw004_SmearedHalos m4 : 58|1@1+ (1,0) [0|0] "" Vector__XXX
 SG_ APP_sw006_timeOfDay m6 : 58|2@1+ (1,0) [0|0] "" Vector__XXX
 SG_ APP_sw016_overrideBlinker m16 : 58|1@1+ (1,0) [0|0] "" Vector__XXX
 SG_ APP_sw027_EVR33 m27 : 58|1@1+ (1,0) [0|0] "" Vector__XXX
 SG_ APP_sw047_unused m47 : 58|6@1+ (1,0) [0|0] "" Vector__XXX
 SG_ APP_sw050_overrideBlinker m50 : 58|1@1+ (1,0) [0|0] "" Vector__XXX
 SG_ APP_sw053_a56bcmodValidity m53 : 58|1@1+ (1,0) [0|0] "" Vector__XXX
 SG_ APP_sw060_overrideBrake m60 : 58|1@1+ (1,0) [0|0] "" Vector__XXX
 SG_ APP_sw072_guidanceTimer m72 : 58|1@1+ (1,0) [0|0] "" Vector__XXX
 SG_ APP_sw076_overrideBlinker m76 : 58|1@1+ (1,0) [0|0] "" Vector__XXX
 SG_ APP_sw085_freeSpaceC0Right m85 : 58|5@1+ (1,-15) [0|0] "" Vector__XXX
 SG_ APP_sw263_lssAbortReason m263 : 58|5@1+ (1,0) [0|0] "" Vector__XXX
 SG_ APP_sw283_fisheyeCam m283 : 58|1@1+ (1,0) [0|0] "" Vector__XXX
 SG_ APP_sw328_extComputeNotActive m328 : 58|1@1+ (1,0) [0|0] "" Vector__XXX
 SG_ APP_sw407_noFixedRoute m407 : 58|1@1+ (1,0) [0|0] "" Vector__XXX
 SG_ APP_sw408_allBrakeLightsFaulted m408 : 58|1@1+ (1,0) [0|0] "" Vector__XXX
 SG_ APP_sw409_safetyOperatorNotPresent m409 : 58|1@1+ (1,0) [0|0] "" Vector__XXX
 SG_ APP_sw410_uiCenterDisplayUnavailable m410 : 58|1@1+ (1,0) [0|0] "" Vector__XXX
 SG_ APP_sw004_FoggyLights m4 : 59|1@1+ (1,0) [0|0] "" Vector__XXX
 SG_ APP_sw016_overrideBrake m16 : 59|1@1+ (1,0) [0|0] "" Vector__XXX
 SG_ APP_sw027_SWD m27 : 59|1@1+ (1,0) [0|0] "" Vector__XXX
 SG_ APP_sw050_overrideBrake m50 : 59|1@1+ (1,0) [0|0] "" Vector__XXX
 SG_ APP_sw053_a57dimodValidity m53 : 59|1@1+ (1,0) [0|0] "" Vector__XXX
 SG_ APP_sw060_overrideSteer m60 : 59|1@1+ (1,0) [0|0] "" Vector__XXX
 SG_ APP_sw072_handlePress m72 : 59|1@1+ (1,0) [0|0] "" Vector__XXX
 SG_ APP_sw074_roadClass m74 : 59|3@1+ (1,0) [0|0] "" Vector__XXX
 SG_ APP_sw076_overrideBrake m76 : 59|1@1+ (1,0) [0|0] "" Vector__XXX
 SG_ APP_sw083_Targ5_wNonObj m83 : 59|5@1+ (0.03125,0) [0|0] "" Vector__XXX
 SG_ APP_sw103_radAlignment m103 : 59|5@1+ (0.015625,-0.2343) [0|0] "" Vector__XXX
 SG_ APP_sw143_steeringOverride m143 : 59|1@1+ (1,0) [0|0] "" Vector__XXX
 SG_ APP_sw191_radarFault m191 : 59|1@1+ (1,0) [0|0] "" Vector__XXX
 SG_ APP_sw231_steeringOverride m231 : 59|1@1+ (1,0) [0|0] "" Vector__XXX
 SG_ APP_sw283_leftRepeaterCam m283 : 59|1@1+ (1,0) [0|0] "" Vector__XXX
 SG_ APP_sw386_minEgoAcceleration m386 : 59|4@1- (1,-4) [0|0] "" Vector__XXX
 SG_ APP_sw407_notInParkNoTakeover m407 : 59|1@1+ (1,0) [0|0] "" Vector__XXX
 SG_ APP_sw408_leftTurnLightFaulted m408 : 59|1@1+ (1,0) [0|0] "" Vector__XXX
 SG_ APP_sw409_unsupervisedRtNotAllowed m409 : 59|1@1+ (1,0) [0|0] "" Vector__XXX
 SG_ APP_sw410_uiConnectivityOffline m410 : 59|1@1+ (1,0) [0|0] "" Vector__XXX
 SG_ APP_sw004_SelfGlare m4 : 60|1@1+ (1,0) [0|0] "" Vector__XXX
 SG_ APP_sw013_numTransportErrors m13 : 60|4@1+ (1,0) [0|0] "" Vector__XXX
 SG_ APP_sw016_overrideSteer m16 : 60|1@1+ (1,0) [0|0] "" Vector__XXX
 SG_ APP_sw017_Any_Tsr_Msg_Recd m17 : 60|1@1+ (1,0) [0|0] "" Vector__XXX
 SG_ APP_sw027_STDBY_WDG m27 : 60|1@1+ (1,0) [0|0] "" Vector__XXX
 SG_ APP_sw050_overrideSteer m50 : 60|1@1+ (1,0) [0|0] "" Vector__XXX
 SG_ APP_sw053_a59drmiInvalidChkSm m53 : 60|1@1+ (1,0) [0|0] "" Vector__XXX
 SG_ APP_sw060_collisionWarningSource m60 : 60|3@1+ (1,0) [0|0] "" Vector__XXX
 SG_ APP_sw072_keyfobPress m72 : 60|1@1+ (1,0) [0|0] "" Vector__XXX
 SG_ APP_sw073_freespaceRightFarZ m73 : 60|4@1+ (4,0) [0|0] "" Vector__XXX
 SG_ APP_sw076_overrideSteer m76 : 60|1@1+ (1,0) [0|0] "" Vector__XXX
 SG_ APP_sw143_predOverlap m143 : 60|4@1+ (10,0) [0|0] "" Vector__XXX
 SG_ APP_sw191_radarBlind m191 : 60|1@1+ (1,0) [0|0] "" Vector__XXX
 SG_ APP_sw199_numShifts m199 : 60|4@1+ (1,0) [0|0] "" Vector__XXX
 SG_ APP_sw231_predOverlap m231 : 60|4@1+ (10,0) [0|0] "" Vector__XXX
 SG_ APP_sw283_rightRepeaterCam m283 : 60|1@1+ (1,0) [0|0] "" Vector__XXX
 SG_ APP_sw354_udpDisconnected m354 : 60|1@1+ (1,0) [0|0] "" Vector__XXX
 SG_ APP_sw407_extendedComputeInactive m407 : 60|1@1+ (1,0) [0|0] "" Vector__XXX
 SG_ APP_sw408_rightTurnLightFaulted m408 : 60|1@1+ (1,0) [0|0] "" Vector__XXX
 SG_ APP_sw409_driverPresentNotAllowed m409 : 60|1@1+ (1,0) [0|0] "" Vector__XXX
 SG_ APP_sw410_uiConnectivityHwUnhealthy m410 : 60|1@1+ (1,0) [0|0] "" Vector__XXX
 SG_ APP_sw004_visionNotRunning m4 : 61|1@1+ (1,0) [0|0] "" Vector__XXX
 SG_ APP_sw016_fcmModeAtEvent m16 : 61|2@1+ (1,0) [0|0] "" Vector__XXX
 SG_ APP_sw017_Any_Hlb_Msg_Recd m17 : 61|1@1+ (1,0) [0|0] "" Vector__XXX
 SG_ APP_sw027_PORST m27 : 61|1@1+ (1,0) [0|0] "" Vector__XXX
 SG_ APP_sw050_fcmModeAtEvent m50 : 61|2@1+ (1,0) [0|0] "" Vector__XXX
 SG_ APP_sw053_a60drmiInvalidCount m53 : 61|1@1+ (1,0) [0|0] "" Vector__XXX
 SG_ APP_sw072_garageOpened m72 : 61|1@1+ (1,0) [0|0] "" Vector__XXX
 SG_ APP_sw076_fcmModeAtEvent m76 : 61|2@1+ (1,0) [0|0] "" Vector__XXX
 SG_ APP_sw191_cameraFailsafes m191 : 61|3@1+ (1,0) [0|0] "" Vector__XXX
 SG_ APP_sw283_leftPillarCam m283 : 61|1@1+ (1,0) [0|0] "" Vector__XXX
 SG_ APP_sw354_tcpDisconnected m354 : 61|1@1+ (1,0) [0|0] "" Vector__XXX
 SG_ APP_sw407_epbRedundantBrakingStatus m407 : 61|1@1+ (1,0) [0|0] "" Vector__XXX
 SG_ APP_sw408_reverseLightFaulted m408 : 61|1@1+ (1,0) [0|0] "" Vector__XXX
 SG_ APP_sw409_apThermalDegradedBlockActivation m409 : 61|1@1+ (1,0) [0|0] "" Vector__XXX
 SG_ APP_sw410_uiQtCarUnavailable m410 : 61|1@1+ (1,0) [0|0] "" Vector__XXX
 SG_ APP_sw017_Any_Common_Msg_Recd m17 : 62|1@1+ (1,0) [0|0] "" Vector__XXX
 SG_ APP_sw027_Unused_word m27 : 62|2@1+ (1,0) [0|0] "" Vector__XXX
 SG_ APP_sw053_a61radPositionMismatch m53 : 62|1@1+ (1,0) [0|0] "" Vector__XXX
 SG_ APP_sw072_userTimeout m72 : 62|1@1+ (1,0) [0|0] "" Vector__XXX
 SG_ APP_sw074_cruiseActive m74 : 62|1@1+ (1,0) [0|0] "" Vector__XXX
 SG_ APP_sw257_user_sensitivity m257 : 62|2@1+ (1,0) [0|0] "" Vector__XXX
 SG_ APP_sw260_user_sensitivity m260 : 62|2@1+ (1,0) [0|0] "" Vector__XXX
 SG_ APP_sw283_rightPillarCam m283 : 62|1@1+ (1,0) [0|0] "" Vector__XXX
 SG_ APP_sw407_cruiseStackMismatch m407 : 62|1@1+ (1,0) [0|0] "" Vector__XXX
 SG_ APP_sw408_tailLightFaulted m408 : 62|1@1+ (1,0) [0|0] "" Vector__XXX
 SG_ APP_sw409_apThermalDegradedPulloverReq m409 : 62|1@1+ (1,0) [0|0] "" Vector__XXX
 SG_ APP_sw410_gnssUartFaulted m410 : 62|1@1+ (1,0) [0|0] "" Vector__XXX
 SG_ APP_sw016_accActive m16 : 63|1@1+ (1,0) [0|0] "" Vector__XXX
 SG_ APP_sw017_Any_FCW_PCW_Msg_Recd m17 : 63|1@1+ (1,0) [0|0] "" Vector__XXX
 SG_ APP_sw050_accActive m50 : 63|1@1+ (1,0) [0|0] "" Vector__XXX
 SG_ APP_sw053_a62strRackMismatch m53 : 63|1@1+ (1,0) [0|0] "" Vector__XXX
 SG_ APP_sw060_accActive m60 : 63|1@1+ (1,0) [0|0] "" Vector__XXX
 SG_ APP_sw074_autopilotActive m74 : 63|1@1+ (1,0) [0|0] "" Vector__XXX
 SG_ APP_sw076_accActive m76 : 63|1@1+ (1,0) [0|0] "" Vector__XXX
 SG_ APP_sw283_bucCam m283 : 63|1@1+ (1,0) [0|0] "" Vector__XXX
 SG_ APP_sw407_vehicleAutonomyBehaviorMismatch m407 : 63|1@1+ (1,0) [0|0] "" Vector__XXX
 SG_ APP_sw408_allTailLightsFaultedInLowVis m408 : 63|1@1+ (1,0) [0|0] "" Vector__XXX
 SG_ APP_sw409_autonomousBehaviorsLinkNotEstablished m409 : 63|1@1+ (1,0) [0|0] "" Vector__XXX
 SG_ APP_sw410_gnssAntennaFaulted m410 : 63|1@1+ (1,0) [0|0] "" Vector__XXX

BO_ 1519 TPMS_info: 8 Vector__XXX
 SG_ TPMS_infoIndex M : 0|8@1+ (1,0) [0|0] "" Vector__XXX
 SG_ TPMS_infoBootUdsProtoVersion m20 : 8|8@1+ (1,0) [0|0] "" Vector__XXX
 SG_ TPMS_infoPcbaID m11 : 16|8@1+ (1,0) [0|0] "" Vector__XXX
 SG_ TPMS_infoAssemblyID m11 : 24|8@1+ (1,0) [0|0] "" Vector__XXX
 SG_ TPMS_infoApplicationCRC m13 : 32|32@1+ (1,0) [0|0] "" Vector__XXX
 SG_ TPMS_infoBootloaderCRC m20 : 32|32@1+ (1,0) [0|0] "" Vector__XXX
 SG_ TPMS_infoUsageID m11 : 32|16@1+ (1,0) [0|0] "" Vector__XXX
 SG_ TPMS_infoComponentID m10 : 48|16@1+ (1,0) [0|0] "" Vector__XXX

VAL_ 1513 APP_alertID 0 "ALERT_DO_NOT_USE_ZERO" 1 "a001_DriverDoorOpen" 2 "a002_DoorOpen" 3 "a003_TrunkOpen" 4 "a004_FrunkOpen" 5 "a005_HeadlightsOnDoorOpen" 6 "a006_RemoteServiceAlert" 7 "a007_SoftPackConfigMismatch" 8 "a008_TouchScreenError" 9 "a009_SquashfsError" 10 "a010_MapsMissing" 11 "a011_IncorrectMap" 12 "a012_NotOnPrivateProperty" 13 "a013_TPMSHardWarning" 14 "a014_TPMSSoftWarning" 15 "a015_TPMSOverPressureWarning" 16 "a016_TPMSTemperatureWarning" 17 "a017_TPMSSystemFault" 18 "a018_SlipStartOn" 19 "a019_ParkBrakeFault" 20 "a020_SteeringReduced" 21 "a021_RearSeatbeltUnbuckled" 22 "a022_ApeFusesEtc" 23 "a023_CellInternetCheckFailed" 24 "a024_WifiInternetCheckFailed" 25 "a025_WifiOnlineCheckFailed" 26 "a026_ModemResetLoopDetected" 27 "a027_AutoSteerMIA" 28 "a028_FrontTrunkPopupClosed" 29 "a029_ModemMIA" 30 "a030_ModemVMCrash" 31 "a031_BrakeFluidLow" 32 "a032_CellModemRecoveryResets" 33 "a033_ApTrialExpired" 34 "a034_WakeupProblem" 35 "a035_AudioWatchdogKernelError" 36 "a036_AudioWatchdogHfpError" 37 "a037_AudioWatchdogXrunStormError" 38 "a038_AudioWatchdogA2bI2cLockupError" 39 "a039_AudioA2bNeedRediscovery" 40 "a040_HomelinkTransmit" 41 "a041_AudioDmesgXrun" 42 "a042_AudioDmesgRtThrottling" 43 "a043_InvalidMapDataOverride" 44 "a044_AudioDmesgDspException" 45 "a045_ECallNeedsService" 46 "a046_BackupCameraStreamError" 47 "a047_CellRoamingDisallowed" 48 "a048_AudioPremiumAmpCheckFailed" 49 "a049_BrakeShiftRequired" 50 "a050_BackupCameraIPUTimeout" 51 "a051_BackupCameraFrameTimeout" 52 "a052_KernelPanicReported" 53 "a053_QtCarExitError" 54 "a054_AudioBoostPowerBad" 55 "a055_ManualECallDisabled" 56 "a056_ManualECallButtonDisconnected" 57 "a057_CellAntennaDisconnected" 58 "a058_GPSAntennaDisconnected" 59 "a059_ECallSpeakerDisconnected" 60 "a060_ECallMicDisconnected" 61 "a061_SIMTestFailed" 62 "a062_ENSTestFailed" 63 "a063_CellularTestFailed" 64 "a064_ModemFirmwareTestFailed" 65 "a065_WiFiRecoveryReset" 66 "a066_GpuHangDetected" 67 "a067_WarnOnI915" 68 "a068_VideoUnexpectedExit" 69 "a069_VideoUDPTimeout" 70 "a070_VideoPipelineWarning" 71 "a071_VideoPipelineError" 72 "a072_ECallAnalogMicFailed" 73 "a073_ECallDigitalMicFailed" 74 "a074_EMMCHangDetected" 75 "a075_BackupCameraInitError" 76 "a076_NumFalseManualECalls" 77 "a077_AudioA2bMicChannelSwap" 78 "a078_DashcamUsbDriveUnmountable" 79 "a079_DashcamUsbDriveFull" 80 "a080_DashcamUsbDriveSlow" 81 "a081_CellModemSearchExpired" 82 "a082_NumModemRebootStuckInECall" 83 "a083_ECallProxyWatchdogTriggered" 84 "a084_SerializerError" 85 "a085_DeserializerError" 86 "a086_TouchEnumerationError" 87 "a087_BmpReset" 88 "a088_CellRemovableSimMissing" 89 "a089_RadioSoftResetError" 90 "a090_RadioPingFailError" 91 "a091_VehicleLinkStall" 92 "a092_updateStarted" 93 "a093_updateEnded" 94 "a094_ModemPowerOnFailure" 95 "a095_CidStorageRunningLow" 96 "a096_VideodPipelineIssueDetected" 97 "a097_AudiodRestarted" 98 "a098_DiskCheckFailure" 99 "a099_eMMCStatusError" 100 "a100_eMMCFTLError" 101 "a101_wifiStackProblem" 102 "a102_A2bDiscoveryFailed" 103 "a103_UsbHubNotEnumerating" 104 "a104_DashcamUsbDriveMissing" 105 "a105_firmwareReinstallRequested" 106 "a106_rebootBackstopTriggered" 107 "a107_DashcamUsbDriveTooBigForVfatFsck" 108 "a108_DashcamUsbDriveGettingFull" 109 "a109_DashcamUsbDriveTooSmall" 110 "a110_DashcamUsbDriveCorrupt" 111 "a111_DashcamUsbDriveWrongPort" 112 "a112_badUSBDevice" 113 "a113_DashcamHasOnboardSentryClips" ;
VAL_ 1513 APP_alertState 0 "CLEARED" 1 "SET" ;
VAL_ 1513 APP_sw030_heaterState 0 "OFF_SNA" 1 "ON" ;
VAL_ 1513 APP_sw035_status 0 "DISABLED" 1 "ENABLED" 2 "TEMPORARY_FAILURE" 3 "SNA" ;
VAL_ 1513 APP_sw042_health_state 0 "STANDBY" 1 "DRIVE" 2 "SUPPORT" 3 "CHARGE" 4 "FEIM" 5 "CLEAR_FAULT" 6 "FAULT" 7 "WELD" 8 "TEST" 9 "SNA" 10 "DIAG" ;
VAL_ 1513 APP_sw043_mobileye_status 0 "DISABLED" 1 "ENABLED" 2 "TEMPORARY_FAILURE" 3 "SNA" ;
VAL_ 1513 APP_sw065_app_mobileye_status 0 "DISABLED" 1 "ENABLED" 2 "TEMPORARY_FAILURE" 3 "SNA" ;
VAL_ 1513 APP_sw066_app_mobileye_status 0 "DISABLED" 1 "ENABLED" 2 "TEMPORARY_FAILURE" 3 "SNA" ;
VAL_ 1513 APP_sw078_camCipv_dx 255 "SNA" ;
VAL_ 1513 APP_sw131_mainCamExtPitchCal 511 "SNA" ;
VAL_ 1513 APP_sw132_narrowCamExtPitchCal 511 "SNA" ;
VAL_ 1513 APP_sw152_status 0 "DISABLED" 1 "ENABLED" 2 "TEMPORARY_FAILURE" 3 "SNA" ;
VAL_ 1513 APP_sw156_status 0 "DISABLED" 1 "ENABLED" 2 "TEMPORARY_FAILURE" 3 "SNA" ;
VAL_ 1513 APP_sw177_fisheyeCamExtPitchCal 511 "SNA" ;
VAL_ 1513 APP_sw178_lPillarCamExtPitchCal 511 "SNA" ;
VAL_ 1513 APP_sw179_rPillarCamExtPitchCal 511 "SNA" ;
VAL_ 1513 APP_sw180_lRepeatCamExtPitchCal 511 "SNA" ;
VAL_ 1513 APP_sw181_rRepeatCamExtPitchCal 511 "SNA" ;
VAL_ 1513 APP_sw257_target_dx 255 "SNA" ;
VAL_ 1513 APP_sw258_target_dx 255 "SNA" ;
VAL_ 1513 APP_sw260_target_dx 255 "SNA" ;
VAL_ 1513 APP_sw273_eventType 0 "NONE" 1 "DRIVER_INTERVENTION" 2 "AUTOSTEER_ABORT" 3 "ANGLE_SATURATION" 4 "ANGLE_RATE_SATURATION" 5 "LDW_LEFT" 6 "LDW_RIGHT" 7 "ALC_ABORT_LEFT" 8 "ALC_ABORT_RIGHT" 9 "SCA_LEFT" 10 "SCA_RIGHT" 11 "TM_EVENT_IPSO" 12 "TM_EVENT_CRASH" 13 "TM_EVENT_AEB" 14 "TM_EVENT_ROB" ;
VAL_ 1513 APP_sw308_IBST_status 0 "DISABLED" 1 "ENABLED" 2 "TEMPORARY_FAILURE" 3 "SNA" ;
VAL_ 1513 APP_sw324_state 0 "STANDBY" 1 "DRIVE" 2 "SUPPORT" 3 "CHARGE" 4 "FEIM" 5 "CLEAR_FAULT" 6 "FAULT" 7 "WELD" 8 "TEST" 9 "SNA" 10 "DIAG" ;
VAL_ 1513 APP_sw399_status 0 "DISABLED" 1 "ENABLED" 2 "TEMPORARY_FAILURE" 3 "SNA" ;
VAL_ 1513 APP_sw404_status 0 "DISABLED" 1 "ENABLED" 2 "TEMPORARY_FAILURE" 3 "SNA" ;
VAL_ 1513 APP_sw405_status 0 "DISABLED" 1 "ENABLED" 2 "TEMPORARY_FAILURE" 3 "SNA" ;
VAL_ 1513 APP_sw423_type 0 "US_TESLA" 1 "EURO_IEC" 2 "GB" 3 "IEC_CCS" ;
VAL_ 1513 APP_sw424_type 0 "US_TESLA" 1 "EURO_IEC" 2 "GB" 3 "IEC_CCS" ;
VAL_ 1513 APP_sw425_type 0 "US_TESLA" 1 "EURO_IEC" 2 "GB" 3 "IEC_CCS" ;
VAL_ 1513 APP_sw426_type 0 "US_TESLA" 1 "EURO_IEC" 2 "GB" 3 "IEC_CCS" ;
VAL_ 1513 APP_sw427_type 0 "US_TESLA" 1 "EURO_IEC" 2 "GB" 3 "IEC_CCS" ;
VAL_ 1513 APP_sw428_type 0 "US_TESLA" 1 "EURO_IEC" 2 "GB" 3 "IEC_CCS" ;
VAL_ 1513 APP_sw429_type 0 "US_TESLA" 1 "EURO_IEC" 2 "GB" 3 "IEC_CCS" ;
VAL_ 1513 APP_sw064_status 0 "DISABLED" 1 "ENABLED" 2 "TEMPORARY_FAILURE" 3 "SNA" ;
VAL_ 1513 APP_sw151_status 0 "DISABLED" 1 "ENABLED" 2 "TEMPORARY_FAILURE" 3 "SNA" ;
VAL_ 1513 APP_sw219_roadClass 0 "UNKNOWN_INVALID_SNA" 1 "CLASS_1_MAJOR" 2 "CLASS_2" 3 "CLASS_3" 4 "CLASS_4" 5 "CLASS_5" 6 "CLASS_6_MINOR" ;
VAL_ 1513 APP_sw220_roadClass 0 "UNKNOWN_INVALID_SNA" 1 "CLASS_1_MAJOR" 2 "CLASS_2" 3 "CLASS_3" 4 "CLASS_4" 5 "CLASS_5" 6 "CLASS_6_MINOR" ;
VAL_ 1513 APP_sw321_status 0 "DISABLED" 1 "ENABLED" 2 "TEMPORARY_FAILURE" 3 "SNA" ;
VAL_ 1513 APP_sw027_Unused_Bit_0 0 "0" 1 "1" 2 "2" 3 "3" 4 "4" 5 "5" 6 "6" 7 "7" 8 "8" 9 "9" 10 "10" 11 "11" 12 "12" 13 "13" 14 "14" 15 "15" 16 "16" 17 "17" 18 "18" 19 "19" 20 "20" 21 "21" 22 "22" 23 "23" 24 "24" 25 "25" 26 "26" 27 "27" 28 "28" 29 "29" 30 "30" 31 "31" ;
VAL_ 1513 APP_sw150_systemStatus 0 "UNKNOWN" 1 "RELEASED" 2 "PARKED" 3 "DYNAMIC" 4 "PARKING" 5 "RELEASING" 6 "FAULT" 7 "FAULT_SECURE" 8 "MISMATCH" ;
VAL_ 1513 APP_sw158_status 0 "DISABLED" 1 "ENABLED" 2 "TEMPORARY_FAILURE" 3 "SNA" ;
VAL_ 1513 APP_sw227_vehicleSpeed 8191 "SNA" ;
VAL_ 1513 APP_sw192_chassisType 2 "3_CHASSIS" 3 "Y_CHASSIS" ;
VAL_ 1513 APP_sw025_road_class 0 "SNA" 1 "SUPERCHARGER" 2 "URBANCHARGER" ;
VAL_ 1513 APP_sw047_roadClass 0 "UNKNOWN_INVALID_SNA" 1 "CLASS_1_MAJOR" 2 "CLASS_2" 3 "CLASS_3" 4 "CLASS_4" 5 "CLASS_5" 6 "CLASS_6_MINOR" ;
VAL_ 1513 APP_sw219_vehicleSpeed 8191 "SNA" ;
VAL_ 1513 APP_sw220_vehicleSpeed 8191 "SNA" ;
VAL_ 1513 APP_sw069_eacStatus 0 "INHIBITED" 1 "AVAILABLE" 2 "ACTIVE" 3 "FAULT" 4 "LKA_ELK_AVAILABLE" 5 "LKA_ACTIVE" 6 "ELK_AVAILABLE" 7 "ELK_ACTIVE" ;
VAL_ 1513 APP_sw203_roadClass 0 "UNKNOWN_INVALID_SNA" 1 "CLASS_1_MAJOR" 2 "CLASS_2" 3 "CLASS_3" 4 "CLASS_4" 5 "CLASS_5" 6 "CLASS_6_MINOR" ;
VAL_ 1513 APP_sw004_accState 0 "ACC_CANCEL_GENERIC" 3 "ACC_HOLD" 4 "ACC_ON" 5 "APC_BACKWARD" 6 "APC_FORWARD" 7 "APC_COMPLETE" 8 "APC_ABORT" 9 "APC_PAUSE" 10 "APC_UNPARK_COMPLETE" 11 "APC_SELFPARK_START" 13 "ACC_CANCEL_GENERIC_SILENT" 15 "FAULT_SNA" ;
VAL_ 1513 APP_sw065_mobileye_main_state 0 "STANDBY" 1 "DRIVE" 2 "SUPPORT" 3 "CHARGE" 4 "FEIM" 5 "CLEAR_FAULT" 6 "FAULT" 7 "WELD" 8 "TEST" 9 "SNA" 10 "DIAG" ;
VAL_ 1513 APP_sw066_mobileye_main_state 0 "STANDBY" 1 "DRIVE" 2 "SUPPORT" 3 "CHARGE" 4 "FEIM" 5 "CLEAR_FAULT" 6 "FAULT" 7 "WELD" 8 "TEST" 9 "SNA" 10 "DIAG" ;
VAL_ 1513 APP_sw059_status 0 "DISABLED" 1 "ENABLED" 2 "TEMPORARY_FAILURE" 3 "SNA" ;
VAL_ 1513 APP_sw191_cruiseState 0 "UNAVAILABLE" 1 "STANDBY" 2 "ENABLED" 3 "STANDSTILL" 4 "OVERRIDE" 5 "FAULT" 6 "PRE_FAULT" 7 "PRE_CANCEL" ;
VAL_ 1513 APP_sw005_steeringAngle 16383 "SNA" ;
VAL_ 1513 APP_sw408_passengerUnbuckled 0 "NONE" 1 "OCCUPIED_AND_UNBUCKLED" 2 "SNA" ;
VAL_ 1513 APP_sw043_mesp_health_main_state 0 "STANDBY" 1 "DRIVE" 2 "SUPPORT" 3 "CHARGE" 4 "FEIM" 5 "CLEAR_FAULT" 6 "FAULT" 7 "WELD" 8 "TEST" 9 "SNA" 10 "DIAG" ;
VAL_ 1513 APP_sw078_radarTarg5_dx 255 "SNA" ;
VAL_ 1513 APP_sw083_Targ5_dx 255 "SNA" ;
VAL_ 1513 APP_sw085_roadClass 0 "UNKNOWN_INVALID_SNA" 1 "CLASS_1_MAJOR" 2 "CLASS_2" 3 "CLASS_3" 4 "CLASS_4" 5 "CLASS_5" 6 "CLASS_6_MINOR" ;
VAL_ 1513 APP_sw005_gear 0 "INVALID" 1 "P" 2 "R" 3 "N" 4 "D" 7 "SNA" ;
VAL_ 1513 APP_sw131_mainCamExtYawCal 511 "SNA" ;
VAL_ 1513 APP_sw132_narrowCamExtYawCal 511 "SNA" ;
VAL_ 1513 APP_sw177_fisheyeCamExtYawCal 511 "SNA" ;
VAL_ 1513 APP_sw178_lPillarCamExtYawCal 511 "SNA" ;
VAL_ 1513 APP_sw179_rPillarCamExtYawCal 511 "SNA" ;
VAL_ 1513 APP_sw180_lRepeatCamExtYawCal 511 "SNA" ;
VAL_ 1513 APP_sw181_rRepeatCamExtYawCal 511 "SNA" ;
VAL_ 1513 APP_sw077_vehicleSpeed 8191 "SNA" ;
VAL_ 1513 APP_sw025_offsetSide 0 "NO_OFFSET" 1 "OFFSET_RIGHT_OBJECT" 2 "OFFSET_LEFT_OBJECT" 3 "OFFSET_BOTH_OBJECTS" ;
VAL_ 1513 APP_sw071_roadClass 0 "UNKNOWN_INVALID_SNA" 1 "CLASS_1_MAJOR" 2 "CLASS_2" 3 "CLASS_3" 4 "CLASS_4" 5 "CLASS_5" 6 "CLASS_6_MINOR" ;
VAL_ 1513 APP_sw078_radarTarg5_VxRel 0 "NO_TARGET" ;
VAL_ 1513 APP_sw080_road_class 0 "SNA" 1 "SUPERCHARGER" 2 "URBANCHARGER" ;
VAL_ 1513 APP_sw195_vehicleSpeed 8191 "SNA" ;
VAL_ 1513 APP_sw202_vehicleSpeed 8191 "SNA" ;
VAL_ 1513 APP_sw259_previous_lcm_app_state 0 "STANDBY" 1 "DRIVE" 2 "SUPPORT" 3 "CHARGE" 4 "FEIM" 5 "CLEAR_FAULT" 6 "FAULT" 7 "WELD" 8 "TEST" 9 "SNA" 10 "DIAG" ;
VAL_ 1513 APP_sw006_steeringAngle 16383 "SNA" ;
VAL_ 1513 APP_sw069_roadClass 0 "UNKNOWN_INVALID_SNA" 1 "CLASS_1_MAJOR" 2 "CLASS_2" 3 "CLASS_3" 4 "CLASS_4" 5 "CLASS_5" 6 "CLASS_6_MINOR" ;
VAL_ 1513 APP_sw006_gear 0 "INVALID" 1 "P" 2 "R" 3 "N" 4 "D" 7 "SNA" ;
VAL_ 1513 APP_sw071_airSuspension 0 "NONE" ;
VAL_ 1513 APP_sw025_torsionBarTorque 4094 "UNDEFINABLE_DATA" 4095 "SNA" ;
VAL_ 1513 APP_sw078_radarTarg1_dx 255 "SNA" ;
VAL_ 1513 APP_sw082_road_class 0 "SNA" 1 "SUPERCHARGER" 2 "URBANCHARGER" ;
VAL_ 1513 APP_sw191_roadClass 0 "UNKNOWN_INVALID_SNA" 1 "CLASS_1_MAJOR" 2 "CLASS_2" 3 "CLASS_3" 4 "CLASS_4" 5 "CLASS_5" 6 "CLASS_6_MINOR" ;
VAL_ 1513 APP_sw199_internalState 0 "NO_MODE_ACTIVE" 1 "PRE_DRIVE_CHECK" 2 "LOCAL_BRAKE_REQUEST" 3 "EXTERNAL_BRAKE_REQUEST" 4 "DIAGNOSTIC" 5 "TRANSITION_TO_IDLE" 6 "POST_DRIVE_CHECK" ;
VAL_ 1513 APP_sw080_cruise_lever_state 0 "STANDBY" 1 "DRIVE" 2 "SUPPORT" 3 "CHARGE" 4 "FEIM" 5 "CLEAR_FAULT" 6 "FAULT" 7 "WELD" 8 "TEST" 9 "SNA" 10 "DIAG" ;
VAL_ 1513 APP_sw006_yawRate 4294934528 "SNA" ;
VAL_ 1513 APP_sw077_oocOffCourseDist_cm 255 "MAX_DOOR_HEIGHT_SNA" ;
VAL_ 1513 APP_sw042_road_class 0 "SNA" 1 "SUPERCHARGER" 2 "URBANCHARGER" ;
VAL_ 1513 APP_sw078_radarTarg1_VxRel 0 "NO_TARGET" ;
VAL_ 1513 APP_sw269_laneDepartureWarning 0 "NONE" 1 "LEFT_WARNING" 2 "RIGHT_WARNING" 3 "LEFT_WARNING_SEVERE" 4 "RIGHT_WARNING_SEVERE" 5 "SNA" ;
VAL_ 1513 APP_sw270_laneDepartureWarning 0 "NONE" 1 "LEFT_WARNING" 2 "RIGHT_WARNING" 3 "LEFT_WARNING_SEVERE" 4 "RIGHT_WARNING_SEVERE" 5 "SNA" ;
VAL_ 1513 APP_sw006_trailerMode 0 "OFF" 1 "ON" ;
VAL_ 1513 APP_sw074_roadClass 0 "UNKNOWN_INVALID_SNA" 1 "CLASS_1_MAJOR" 2 "CLASS_2" 3 "CLASS_3" 4 "CLASS_4" 5 "CLASS_5" 6 "CLASS_6_MINOR" ;
VAL_ 1519 TPMS_infoIndex 0 "DEPRECATED_0" 1 "DEPRECATED_1" 2 "DEPRECATED_2" 3 "DEPRECATED_3" 4 "DEPRECATED_4" 5 "DEPRECATED_5" 6 "DEPRECATED_6" 7 "DEPRECATED_7" 8 "DEPRECATED_8" 9 "DEPRECATED_9" 10 "BUILD_HWID_COMPONENTID" 11 "PCBAID_ASSYID_USAGEID" 13 "APP_CRC" 14 "BOOTLOADER_SVN" 15 "BOOTLOADER_CRC" 16 "SUBCOMPONENT" 17 "APP_GITHASH" 18 "BOOTLOADER_GITHASH" 19 "VERSION_DEPRECATED" 20 "UDS_PROTOCOL_BOOTCRC" 22 "VARIANTCRC" 25 "PACKAGE_PN_1_7" 26 "PACKAGE_PN_8_14" 27 "PACKAGE_PN_15_20" 29 "PACKAGE_SN_1_7" 30 "PACKAGE_SN_8_14" 31 "SUBCOMPONENT_GITHASH" 255 "END" ;
