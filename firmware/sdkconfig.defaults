## firmware/sdkconfig.defaults
```kconfig
# Project-level sdkconfig overrides. Applied on top of IDF defaults when
# PlatformIO regenerates the per-env sdkconfig (sdkconfig.esp32-c6).
# Keep this file minimal — only values we want to lock in.

# Route ESP_LOG / printf / stdout to the hardware USB-Serial-JTAG
# peripheral so log output appears on /dev/ttyACM0. UART0 (GPIO16/17) is
# not broken out on the ESP32-C6-SuperMini, so UART console is useless.
CONFIG_ESP_CONSOLE_USB_SERIAL_JTAG=y
# CONFIG_ESP_CONSOLE_UART_DEFAULT is not set
CONFIG_ESP_CONSOLE_SECONDARY_NONE=y
# CONFIG_ESP_CONSOLE_SECONDARY_USB_SERIAL_JTAG is not set

# LittleFS for scripts, DBC binaries, and web UI assets.
CONFIG_ESP_PARTITION_TABLE_CUSTOM=y
CONFIG_ESP_PARTITION_TABLE_CUSTOM_FILENAME="partitions.csv"

# Match the ESP32-C6-SuperMini module flash size. PlatformIO's board setting
# also says 4 MB, but ESP-IDF's generated sdkconfig otherwise defaults to 2 MB.
CONFIG_ESPTOOLPY_FLASHSIZE_4MB=y
CONFIG_ESPTOOLPY_FLASHSIZE="4MB"

# BLE (NimBLE — the only stack supported on ESP32-C6).
CONFIG_BT_ENABLED=y
CONFIG_BT_NIMBLE_ENABLED=y
CONFIG_BT_NIMBLE_MAX_CONNECTIONS=2
CONFIG_BT_NIMBLE_NVS_PERSIST=y
CONFIG_BT_NIMBLE_ATT_PREFERRED_MTU=512
CONFIG_BT_NIMBLE_HOST_TASK_STACK_SIZE=16384
# SC-only: drop Legacy pairing support. All centrals from BLE 4.2+ (≈2014)
# do Secure Connections; refusing Legacy avoids a downgrade attack surface
# and trims a few KB of unused SMP code. If a very old central can't pair,
# this is the flag to re-enable.
# CONFIG_BT_NIMBLE_SM_LEGACY is not set

# Compile debug and verbose log calls so the WebUI verbosity selector
# (log.set_level) can actually show them at runtime. Default level stays info.
CONFIG_LOG_MAXIMUM_LEVEL_DEBUG=y
# CONFIG_LOG_MAXIMUM_EQUALS_DEFAULT is not set

# NimBLE uses its own log system (not ESP_LOG), so esp_log_level_set("NimBLE")
# has no effect. Squelch its INFO-level GATT notify / att_handle spam.
CONFIG_BT_NIMBLE_LOG_LEVEL_ERROR=y
# CONFIG_BT_NIMBLE_LOG_LEVEL_INFO is not set

# FreeRTOS runtime stats (for CPU usage reporting)
CONFIG_FREERTOS_GENERATE_RUN_TIME_STATS=y
CONFIG_FREERTOS_USE_TRACE_FACILITY=y
CONFIG_FREERTOS_HZ=1000

CONFIG_ESP_SYSTEM_USE_FRAME_POINTER=y

# Berry VM + LittleFS dir traversal + DBC decode saturate the 3584-byte
# default main_task stack. 16 KB gives comfortable headroom.
CONFIG_ESP_MAIN_TASK_STACK_SIZE=16384

# WiFi STA — second transport (after BLE) for the web UI. Credentials are
# stored in NVS via the wifi.* protocol ops; if none, the STA driver just
# stays idle.
CONFIG_ESP_WIFI_ENABLED=y
CONFIG_ESP_COEX_SW_COEXIST_ENABLE=y
```

## firmware/sdkconfig.defaults.release
```kconfig
# Production-only sdkconfig overlay (applied on top of sdkconfig.defaults).
# Used by [env:esp32-c6] via board_build.cmake_extra_args. The debug env
# keeps the IDF default (INFO) because DEBUG floods the console.

# Compile-time strip: anything below ERROR is removed from the binary,
# which also drops the matching rodata format strings. Saves ~50–80 KB.
CONFIG_LOG_MAXIMUM_LEVEL_ERROR=y
# Runtime default. (Same as max above, but explicit.)
CONFIG_LOG_DEFAULT_LEVEL_ERROR=y
```
